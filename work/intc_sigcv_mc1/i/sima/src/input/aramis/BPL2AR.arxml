[part 1 of 3: packages /AUTOSAR_Platform/ImplementationDataTypes to /Continental_08/PowerSAR/DataDictionary/UnitGroups]
AUTOSAR XML (schema 00044)
standard types defined: boolean, float32, sint32, sint8, uint16, uint32, uint8, void
package /AUTOSAR_Platform/ImplementationDataTypes  # AUTOSAR Platform types for TC1796
package /AUTOSAR_Platform/SwBaseTypes  # AUTOSAR Base Types for AUTOSAR Platform types for TC1796
package /Continental_08/PowerSAR/DataDictionary/Units/CubmPers_lPermin
  unit CubmPers: display-name=(m^3)/s, factor-si-to-unit=1, offset-si-to-unit=0, physical-dimension=PD_CubmPers  # Volumetric Flow
  unit lPermin: display-name=l/min, factor-si-to-unit=60000, offset-si-to-unit=0, physical-dimension=PD_CubmPers  # Volumetric Flow
  physical dimension PD_CubmPers: length-exp=3, mass-exp=0, time-exp=-1, current-exp=0, temperature-exp=0, molar-amount-exp=0, luminous-intensity-exp=0
package /Continental_08/PowerSAR/DataDictionary/Units/K_C
  unit C: display-name=°C, factor-si-to-unit=1, offset-si-to-unit=-273.15, physical-dimension=PD_K  # Temperature
  unit K: display-name=K, factor-si-to-unit=1, offset-si-to-unit=0, physical-dimension=PD_K  # Temperature
  physical dimension PD_K: length-exp=0, mass-exp=0, time-exp=0, current-exp=0, temperature-exp=1, molar-amount-exp=0, luminous-intensity-exp=0
package /Continental_08/PowerSAR/DataDictionary/Units/Nm
  unit Nm: display-name=Nm, factor-si-to-unit=1, offset-si-to-unit=0, physical-dimension=PD_Nm  # Torque
  physical dimension PD_Nm: length-exp=2, mass-exp=1, time-exp=-2, current-exp=0, temperature-exp=0, molar-amount-exp=0, luminous-intensity-exp=0
package /Continental_08/PowerSAR/DataDictionary/Units/NmMuls_NmPerrpm
  unit NmMuls: display-name=Nm*s, factor-si-to-unit=1, offset-si-to-unit=0, physical-dimension=PD_NmMuls  # Angular Momentum, Integral of Torque
  unit NmPerrpm: display-name=Nm/rpm, factor-si-to-unit=0.016666666666666666, offset-si-to-unit=0, physical-dimension=PD_NmMuls  # Torque per Rotational Speed
  physical dimension PD_NmMuls: length-exp=2, mass-exp=1, time-exp=-1, current-exp=0, temperature-exp=0, molar-amount-exp=0, luminous-intensity-exp=0
package /Continental_08/PowerSAR/DataDictionary/Units/NoUnit
  unit NoUnit: display-name=-, factor-si-to-unit=1, offset-si-to-unit=0, physical-dimension=PD_NoUnit  # No Unit
  physical dimension PD_NoUnit: length-exp=0, mass-exp=0, time-exp=0, current-exp=0, temperature-exp=0, molar-amount-exp=0, luminous-intensity-exp=0
package /Continental_08/PowerSAR/DataDictionary/Units/Pers_rpm
  physical dimension PD_Pers: length-exp=0, mass-exp=0, time-exp=-1, current-exp=0, temperature-exp=0, molar-amount-exp=0, luminous-intensity-exp=0
  unit Pers: display-name=1/s, factor-si-to-unit=1, offset-si-to-unit=0, physical-dimension=PD_Pers  # Inverse of Time
  unit rpm: display-name=rpm, factor-si-to-unit=60, offset-si-to-unit=0, physical-dimension=PD_Pers  # Rotational Speed
package /Continental_08/PowerSAR/DataDictionary/DataTypeMappings
  data type mapping set DefaultDataTypeMapping
    data-type-maps:
      application-data-type=Boolean, implementation-data-type=boolean
      application-data-type=CubmPers_lPermin_Lnr_0_0d0039061307907104492_float32, implementation-data-type=float32
      application-data-type=K_C_Lnr_0_511d9921875_0_FFFF_uint16, implementation-data-type=uint16
      application-data-type=Nm_Lnr_m1024_1023d96875_float32, implementation-data-type=float32
      application-data-type=Nm_Lnr_m4096_4095d875_float32, implementation-data-type=float32
      application-data-type=NmMuls_NmPerrpm_Lnr_m524288_524272_float32, implementation-data-type=float32
      application-data-type=NoUnit_Lnr_0_255_0_FF_uint8, implementation-data-type=uint8
      application-data-type=NoUnit_Lnr_0_65535_0_FFFF_uint16, implementation-data-type=uint16
      application-data-type=NoUnit_Lnr_1_65535_1_FFFF_uint16, implementation-data-type=uint16
      application-data-type=Pers_rpm_Lnr_m512_511d984375_float32, implementation-data-type=float32
      application-data-type=TxtStOpmCluEm2, implementation-data-type=uint8
      application-data-type=TxtStSelTqEmLim, implementation-data-type=uint8
package /Continental_08/PowerSAR/DataDictionary/SwSystemConsts/V1_0_0
  sw systemconst ScNrByteBufFrfDem: compu {phys=raw}, range phys 1..65535, display-format=%1.0f, unit=-
package /Continental_08/PowerSAR/DataDictionary/PortInterfaces/V1_0_0
  23 x sender receiver interface:
    FacKpTqEmDynAjExt  # External amplification factor for dynamic electrical machine torque path of anti-jerk
      data FacKpTqEmDynAjExt: sw-addr-method=VAR_INIT_QM, sw-calibration-access=READ-ONLY, type=NmMuls_NmPerrpm_Lnr_m524288_524272_float32  # External amplification factor for dynamic electrical machine torque path of anti-jerk
    LvAjActExt  # External anti-jerk active
      data LvAjActExt: sw-addr-method=VAR_INIT_QM, sw-calibration-access=READ-ONLY, type=Boolean  # External anti-jerk active
    LvSleepReqVeh  # Sleep requested from vehicle
      data LvSleepReqVeh: sw-addr-method=VAR_INIT_QM, sw-calibration-access=READ-ONLY, type=Boolean  # Sleep requested from vehicle
    LvStOpmEmCtlNActReqClu  # Clutch is requesting to activate speed control
      data LvStOpmEmCtlNActReqClu: sw-addr-method=VAR_INIT_QM, sw-calibration-access=READ-ONLY, type=Boolean  # Clutch is requesting to activate speed control
    LvStOpmEmCtlTqActReqClu  # Clutch is requesting to activate torque control
      data LvStOpmEmCtlTqActReqClu: sw-addr-method=VAR_INIT_QM, sw-calibration-access=READ-ONLY, type=Boolean  # Clutch is requesting to activate torque control
    LvUHvsReqExtEna  # External request to enable high voltage
      data LvUHvsReqExtEna: sw-addr-method=VAR_INIT_QM, sw-calibration-access=READ-ONLY, type=Boolean  # External request to enable high voltage
    NEmOscAjThdExt  # External electrical machine speed oscillation threshold for anti-jerk
      data NEmOscAjThdExt: sw-addr-method=VAR_INIT_QM, sw-calibration-access=READ-ONLY, type=Pers_rpm_Lnr_m512_511d984375_float32  # External electrical machine speed oscillation threshold for anti-jerk
    NEmReqClu  # Electrical machine torque requested from clutch control
      data NEmReqClu: sw-addr-method=VAR_INIT_QM, sw-calibration-access=READ-ONLY, type=Pers_rpm_Lnr_m512_511d984375_float32  # Electrical machine torque requested from clutch control
    NEmReqExtMain  # Electrical machine speed requested by main external function
      data NEmReqExtMain: sw-addr-method=VAR_INIT_QM, sw-calibration-access=READ-ONLY, type=Pers_rpm_Lnr_m512_511d984375_float32  # Electrical machine speed requested by main external function
    StOpmEmReqMain  # Electrical machine state requested by main external function
      data StOpmEmReqMain: sw-addr-method=VAR_INIT_QM, sw-calibration-access=READ-ONLY, type=NoUnit_Lnr_0_255_0_FF_uint8  # Electrical machine state requested by main external function
    StSelTqEmLimReq  # State of electric machine torque limitation selection according to ACU control
      data StSelTqEmLimReq: sw-addr-method=VAR_INIT_QM, sw-calibration-access=READ-ONLY, type=TxtStSelTqEmLim  # State of electric machine torque limitation selection according to ACU control
    TqEmMaxReqAj  # Requested maximum electric machine torque limit for anti-jerk
      data TqEmMaxReqAj: sw-addr-method=VAR_INIT_QM, sw-calibration-access=READ-ONLY, type=Nm_Lnr_m1024_1023d96875_float32  # Requested maximum electric machine torque limit for anti-jerk
    TqEmMinReqAj  # Requested minimum electric machine torque limit for anti-jerk
      data TqEmMinReqAj: sw-addr-method=VAR_INIT_QM, sw-calibration-access=READ-ONLY, type=Nm_Lnr_m1024_1023d96875_float32  # Requested minimum electric machine torque limit for anti-jerk
    TqEmReqClu  # Electrical machine torque requested by clutch
      data TqEmReqClu: sw-addr-method=VAR_INIT_QM, sw-calibration-access=READ-ONLY, type=Nm_Lnr_m1024_1023d96875_float32  # Electrical machine torque requested by clutch
    TqEmReqCluMax  # Maximum electrical machine torque requested from clutch control
      data TqEmReqCluMax: sw-addr-method=VAR_INIT_QM, sw-calibration-access=READ-ONLY, type=Nm_Lnr_m1024_1023d96875_float32  # Maximum electrical machine torque requested from clutch control
    TqEmReqCluMin  # Minimum electrical machine torque requested from clutch control
      data TqEmReqCluMin: sw-addr-method=VAR_INIT_QM, sw-calibration-access=READ-ONLY, type=Nm_Lnr_m1024_1023d96875_float32  # Minimum electrical machine torque requested from clutch control
    TqEmReqExtMain  # Electrical machine torque requested by main external function
      data TqEmReqExtMain: sw-addr-method=VAR_INIT_QM, sw-calibration-access=READ-ONLY, type=Nm_Lnr_m4096_4095d875_float32  # Electrical machine torque requested by main external function
    TqEmReqExtMainMax  # Maximum electrical machine torque requested by main external function
      data TqEmReqExtMainMax: sw-addr-method=VAR_INIT_QM, sw-calibration-access=READ-ONLY, type=Nm_Lnr_m4096_4095d875_float32  # Maximum electrical machine torque requested by main external function
    TqEmReqExtMainMin  # Minimum electrical machine torque requested by main external function
      data TqEmReqExtMainMin: sw-addr-method=VAR_INIT_QM, sw-calibration-access=READ-ONLY, type=Nm_Lnr_m4096_4095d875_float32  # Minimum electrical machine torque requested by main external function
    TWtrCoolInExt  # Inlet water coolant temperature from external source
      data TWtrCoolInExt: sw-addr-method=VAR_INIT_QM, sw-calibration-access=READ-ONLY, type=K_C_Lnr_0_511d9921875_0_FFFF_uint16  # Inlet water coolant temperature from external source
    ValRawIHvsDcvMaxReqPred  # Signal representing predicted maximum DC link current coming from the communication
      data ValRawIHvsDcvMaxReqPred: sw-addr-method=VAR_INIT_QM, sw-calibration-access=READ-ONLY, type=NoUnit_Lnr_0_65535_0_FFFF_uint16  # Signal representing predicted maximum DC link current coming from the communication
    ValRawIHvsDcvMinReqPred  # Signal representing predicted minimum DC link current coming from the communication
      data ValRawIHvsDcvMinReqPred: sw-addr-method=VAR_INIT_QM, sw-calibration-access=READ-ONLY, type=NoUnit_Lnr_0_65535_0_FFFF_uint16  # Signal representing predicted minimum DC link current coming from the communication
    VfCool  # Coolant volume flow
      data VfCool: sw-addr-method=VAR_INIT_QM, sw-calibration-access=READ-ONLY, type=CubmPers_lPermin_Lnr_0_0d0039061307907104492_float32  # Coolant volume flow
package /Continental_08/PowerSAR/DataDictionary/PortInterfaces/V2_0_0
  sender receiver interface StOpmCluEm  # Operational state of electrical machine clutch
    data StOpmCluEm: sw-addr-method=VAR_INIT_QM, sw-calibration-access=READ-ONLY, type=TxtStOpmCluEm2  # Operational state of electrical machine clutch
package /Continental_08/PowerSAR/DataDictionary/ApplicationDataTypes
  12 x app type:
    Boolean: category=BOOLEAN, compu {0=FALSE, 1=TRUE}, range raw 0..1, display-format=%s, unit=-
    CubmPers_lPermin_Lnr_0_0d0039061307907104492_float32: category=VALUE, compu {phys=raw; unit (m^3)/s}, range phys 0..0.0039061307907104492 (m^3)/s, display-format=%7.3f, unit=(m^3)/s
    K_C_Lnr_0_511d9921875_0_FFFF_uint16: category=VALUE, compu {phys=raw/128; unit K}, range phys 0..511.9921875 K, display-format=%8.3f, unit=K
    Nm_Lnr_m1024_1023d96875_float32: category=VALUE, compu {phys=raw; unit Nm}, range phys -1024..1023.96875 Nm, display-format=%8.2f, unit=Nm
    Nm_Lnr_m4096_4095d875_float32: category=VALUE, compu {phys=raw; unit Nm}, range phys -4096..4095.875 Nm, display-format=%7.1f, unit=Nm  # Torque on gearbox entry level (engine, clutch, electrical machine, dual mass flywheel etc)
    NmMuls_NmPerrpm_Lnr_m524288_524272_float32: category=VALUE, compu {phys=raw; unit Nm*s}, range phys -524288..524272 Nm*s, display-format=%8.2f, unit=Nm*s
    NoUnit_Lnr_0_255_0_FF_uint8: category=VALUE, compu {phys=raw}, range phys 0..255, display-format=%3.0f, unit=-
    NoUnit_Lnr_0_65535_0_FFFF_uint16: category=VALUE, compu {phys=raw}, range phys 0..65535, display-format=%5.0f, unit=-
    NoUnit_Lnr_1_65535_1_FFFF_uint16: category=VALUE, compu {phys=raw}, range phys 1..65535, display-format=%1.0f, unit=-
    Pers_rpm_Lnr_m512_511d984375_float32: category=VALUE, compu {phys=raw; unit 1/s}, range phys -512..511.984375 1/s, display-format=%8.1f, unit=1/s  # (engine) rotational speed unit
    TxtStOpmCluEm2: category=VALUE, compu {0=INI, 1=DISCNCT, 2=TRAN, 3=CNCT, 4=ERR}, range raw 0..15, display-format=%s, unit=-  # Operational state of electrical machine clutch
    TxtStSelTqEmLim: category=VALUE, compu {0=EXT, 1=CLU}, range raw 0..2, display-format=%s, unit=-
package /Continental_08/PowerSAR/DataDictionary/UnitGroups
  unit group CalculationUnits: category=COUNTRY, unit=[CubmPers, K, Nm, NmMuls, NoUnit, Pers]
  unit group DisplayUnits: category=COUNTRY, unit=[lPermin, C, Nm, NmPerrpm, NoUnit, rpm]
