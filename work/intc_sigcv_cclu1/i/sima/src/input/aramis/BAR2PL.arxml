[part 1 of 3: packages /AUTOSAR_Platform/ImplementationDataTypes to /Continental_08/PowerSAR/DataDictionary/UnitGroups]
AUTOSAR XML (schema 00044)
standard types defined: boolean, float32, sint16, sint32, sint8, uint16, uint32, uint8, void
package /AUTOSAR_Platform/ImplementationDataTypes  # AUTOSAR Platform types for TC1796
package /AUTOSAR_Platform/SwBaseTypes  # AUTOSAR Base Types for AUTOSAR Platform types for TC1796
package /Continental_08/PowerSAR/DataDictionary/Units/A
  unit A: display-name=A, factor-si-to-unit=1, offset-si-to-unit=0, physical-dimension=PD_A  # Current
  physical dimension PD_A: length-exp=0, mass-exp=0, time-exp=0, current-exp=1, temperature-exp=0, molar-amount-exp=0, luminous-intensity-exp=0
package /Continental_08/PowerSAR/DataDictionary/Units/K_C
  unit C: display-name=°C, factor-si-to-unit=1, offset-si-to-unit=-273.15, physical-dimension=PD_K  # Temperature
  unit K: display-name=K, factor-si-to-unit=1, offset-si-to-unit=0, physical-dimension=PD_K  # Temperature
  physical dimension PD_K: length-exp=0, mass-exp=0, time-exp=0, current-exp=0, temperature-exp=1, molar-amount-exp=0, luminous-intensity-exp=0
package /Continental_08/PowerSAR/DataDictionary/Units/Nm
  unit Nm: display-name=Nm, factor-si-to-unit=1, offset-si-to-unit=0, physical-dimension=PD_Nm  # Torque
  physical dimension PD_Nm: length-exp=2, mass-exp=1, time-exp=-2, current-exp=0, temperature-exp=0, molar-amount-exp=0, luminous-intensity-exp=0
package /Continental_08/PowerSAR/DataDictionary/Units/NoUnit
  unit NoUnit: display-name=-, factor-si-to-unit=1, offset-si-to-unit=0, physical-dimension=PD_NoUnit  # No Unit
  physical dimension PD_NoUnit: length-exp=0, mass-exp=0, time-exp=0, current-exp=0, temperature-exp=0, molar-amount-exp=0, luminous-intensity-exp=0
package /Continental_08/PowerSAR/DataDictionary/Units/V
  physical dimension PD_V: length-exp=2, mass-exp=1, time-exp=-3, current-exp=-1, temperature-exp=0, molar-amount-exp=0, luminous-intensity-exp=0
  unit V: display-name=V, factor-si-to-unit=1, offset-si-to-unit=0, physical-dimension=PD_V  # Voltage
package /Continental_08/PowerSAR/DataDictionary/Units/W
  physical dimension PD_W: length-exp=2, mass-exp=1, time-exp=-3, current-exp=0, temperature-exp=0, molar-amount-exp=0, luminous-intensity-exp=0
  unit W: display-name=W, factor-si-to-unit=1, offset-si-to-unit=0, physical-dimension=PD_W  # Power
package /Continental_08/PowerSAR/DataDictionary/DataTypeMappings
  data type mapping set DefaultDataTypeMapping
    data-type-maps:
      application-data-type=A_Lnr_m2048_2047d9375_float32, implementation-data-type=float32
      application-data-type=Boolean, implementation-data-type=boolean
      application-data-type=K_C_Lnr_0_511d9921875_0_FFFF_uint16, implementation-data-type=uint16
      application-data-type=K_C_Lnr_0_511d9921875_float32, implementation-data-type=float32
      application-data-type=Nm_Lnr_m1024_1023d96875_float32, implementation-data-type=float32
      application-data-type=Nm_Lnr_m4096_4095d875_float32, implementation-data-type=float32
      application-data-type=NoUnit_Lnr_0_11_0_B_uint8, implementation-data-type=uint8
      application-data-type=NoUnit_Lnr_0_255_0_FF_uint8, implementation-data-type=uint8
      application-data-type=NoUnit_Lnr_1_65535_1_FFFF_uint16, implementation-data-type=uint16
      application-data-type=NoUnit_Lnr_m1_1_float32, implementation-data-type=float32
      application-data-type=NoUnit_Lnr_m2_2_float32, implementation-data-type=float32
      application-data-type=TxtLfStOpmEm, implementation-data-type=uint16
      application-data-type=TxtStOpmEmCom, implementation-data-type=uint8
      application-data-type=TxtStTqNEmCtlCfm, implementation-data-type=uint8
      application-data-type=V_Lnr_m2048_2047d9375_8000_7FFF_sint16, implementation-data-type=sint16
      application-data-type=W_Lnr_m67108864_67108863d96875_float32, implementation-data-type=float32
package /Continental_08/PowerSAR/DataDictionary/SwSystemConsts/V1_0_0
  sw systemconst ScNrByteBufFrfDem: compu {phys=raw}, range phys 1..65535, display-format=%1.0f, unit=-
package /Continental_08/PowerSAR/DataDictionary/PortInterfaces/V1_0_0
  24 x sender receiver interface:
    FacPwrInvtFil  # Filtered power factor value of inverter
      data FacPwrInvtFil: sw-addr-method=VAR_INIT_QM, sw-calibration-access=READ-ONLY, type=NoUnit_Lnr_m1_1_float32  # Filtered power factor value of inverter
    IDcvLinkFil  # Filtered DC link current
      data IDcvLinkFil: sw-addr-method=VAR_INIT_QM, sw-calibration-access=READ-ONLY, type=A_Lnr_m2048_2047d9375_float32  # Filtered DC link current
    IRmsPha3FilInvt  # Filtered root mean square current of phase 3 of inverter
      data IRmsPha3FilInvt: sw-addr-method=VAR_INIT_QM, sw-calibration-access=READ-ONLY, type=A_Lnr_m2048_2047d9375_float32  # Filtered root mean square current of phase 3 of inverter
    LvActDchaEna  # Active discharge enabled
      data LvActDchaEna: sw-addr-method=VAR_INIT_QM, sw-calibration-access=READ-ONLY, type=Boolean  # Active discharge enabled
    LvNEmOverDet  # Electrical machine rotor overspeed detected
      data LvNEmOverDet: sw-addr-method=VAR_INIT_QM, sw-calibration-access=READ-ONLY, type=Boolean  # Electrical machine rotor overspeed detected
    PwrLossElInvt  # Electrical power losses from inverter
      data PwrLossElInvt: sw-addr-method=VAR_INIT_QM, sw-calibration-access=READ-ONLY, type=W_Lnr_m67108864_67108863d96875_float32  # Electrical power losses from inverter
    PwrLossInvtMaxEstim  # Maximum estimated electric power losses on IGBT and diode for inverter
      data PwrLossInvtMaxEstim: sw-addr-method=VAR_INIT_QM, sw-calibration-access=READ-ONLY, type=W_Lnr_m67108864_67108863d96875_float32  # Maximum estimated electric power losses on IGBT and diode for inverter
    StEmRedMax  # State showing the most dominant maximum machine derating 0: No derating 1: DC voltage derating 2: DC current derating 3: Speed derating 4: External electrical machine derating 5: Stator temperature derating 6: Rotor temperature derating 7: Inverter derating 8: Generator power and current derating in voltage control mode
      data StEmRedMax: sw-addr-method=VAR_INIT_QM, sw-calibration-access=READ-ONLY, type=NoUnit_Lnr_0_255_0_FF_uint8  # State showing the most dominant maximum machine derating 0: No derating 1: DC voltage derating 2: DC current derating 3: Speed derating 4: External electrical machine derating 5: Stator temperature derating 6: Rotor temperature derating 7: Inverter derating 8: Generator power and current derating in voltage control mode
    StEmRedMin  # State showing the most dominant minimum machine derating: 0: No derating 1: DC voltage derating 2: DC current derating 3: Speed derating 4: External electrical machine derating 5: Stator temperature derating 6: Rotor temperature derating 7: Inverter derating 8: Generator power and current derating in voltage control mode
      data StEmRedMin: sw-addr-method=VAR_INIT_QM, sw-calibration-access=READ-ONLY, type=NoUnit_Lnr_0_255_0_FF_uint8  # State showing the most dominant minimum machine derating: 0: No derating 1: DC voltage derating 2: DC current derating 3: Speed derating 4: External electrical machine derating 5: Stator temperature derating 6: Rotor temperature derating 7: Inverter derating 8: Generator power and current derating in voltage control mode
    StNEmCtlCfm  # Electrical machine speed control confirmation status
      data StNEmCtlCfm: sw-addr-method=VAR_INIT_QM, sw-calibration-access=READ-ONLY, type=TxtStTqNEmCtlCfm  # Electrical machine speed control confirmation status
    StOpmEmCom  # Actual inverter mode reported back to vehicle
      data StOpmEmCom: sw-addr-method=VAR_INIT_QM, sw-calibration-access=READ-ONLY, type=TxtStOpmEmCom  # Actual inverter mode reported back to vehicle
    StTqEmCtlCfm  # Electrical machine torque control confirmation status
      data StTqEmCtlCfm: sw-addr-method=VAR_INIT_QM, sw-calibration-access=READ-ONLY, type=TxtStTqNEmCtlCfm  # Electrical machine torque control confirmation status
    TqEmEstim  # Filtered estimated electrical machine torque
      data TqEmEstim: sw-addr-method=VAR_INIT_QM, sw-calibration-access=READ-ONLY, type=Nm_Lnr_m1024_1023d96875_float32  # Filtered estimated electrical machine torque
    TqEmWhlActAvl  # Actual available torque at wheels considering limitation of electrical machine.
      data TqEmWhlActAvl: sw-addr-method=VAR_INIT_QM, sw-calibration-access=READ-ONLY, type=Nm_Lnr_m4096_4095d875_float32  # Actual available torque at wheels considering limitation of electrical machine.
    TqEmWhlMaxAvl  # Maximum available torque at wheels considering limitation of electrical machine.
      data TqEmWhlMaxAvl: sw-addr-method=VAR_INIT_QM, sw-calibration-access=READ-ONLY, type=Nm_Lnr_m4096_4095d875_float32  # Maximum available torque at wheels considering limitation of electrical machine.
    TqEmWhlMinAvl  # Minimum available torque at wheels considering limitation of electrical machine.
      data TqEmWhlMinAvl: sw-addr-method=VAR_INIT_QM, sw-calibration-access=READ-ONLY, type=Nm_Lnr_m4096_4095d875_float32  # Minimum available torque at wheels considering limitation of electrical machine.
    TRotorSynMagPermEstim  # Permanent Magnet Synchronous Machine rotor temperature value for protection of electric machine
      data TRotorSynMagPermEstim: sw-addr-method=VAR_INIT_QM, sw-calibration-access=READ-ONLY, type=K_C_Lnr_0_511d9921875_float32  # Permanent Magnet Synchronous Machine rotor temperature value for protection of electric machine
    TSemcdDiodeInvtMax  # Maximum semiconductor temperature of diodes for inverter
      data TSemcdDiodeInvtMax: sw-addr-method=VAR_INIT_QM, sw-calibration-access=READ-ONLY, type=K_C_Lnr_0_511d9921875_float32  # Maximum semiconductor temperature of diodes for inverter
    TSemcdPwrSwiDiodeInvtMax  # Maximum semiconductor temperature of power switches and diodes for inverter
      data TSemcdPwrSwiDiodeInvtMax: sw-addr-method=VAR_INIT_QM, sw-calibration-access=READ-ONLY, type=K_C_Lnr_0_511d9921875_float32  # Maximum semiconductor temperature of power switches and diodes for inverter
    TSemcdPwrSwiInvtMax  # Maximum semiconductor temperature of power switch for inverter
      data TSemcdPwrSwiInvtMax: sw-addr-method=VAR_INIT_QM, sw-calibration-access=READ-ONLY, type=K_C_Lnr_0_511d9921875_float32  # Maximum semiconductor temperature of power switch for inverter
    TStatorEstimFil  # Filtered estimated stator temperature
      data TStatorEstimFil: sw-addr-method=VAR_INIT_QM, sw-calibration-access=READ-ONLY, type=K_C_Lnr_0_511d9921875_float32  # Filtered estimated stator temperature
    TWtrCoolIn  # Inlet water coolant temperature
      data TWtrCoolIn: sw-addr-method=VAR_INIT_QM, sw-calibration-access=READ-ONLY, type=K_C_Lnr_0_511d9921875_0_FFFF_uint16  # Inlet water coolant temperature
    TypPwmInvtOppReq  # Inverter PWM modulation type request
      data TypPwmInvtOppReq: sw-addr-method=VAR_INIT_QM, sw-calibration-access=READ-ONLY, type=NoUnit_Lnr_0_11_0_B_uint8  # Inverter PWM modulation type request
    UHvsDcvLinkPrimFil2  # Second low pass filtered of primary voltage sensor
      data UHvsDcvLinkPrimFil2: sw-addr-method=VAR_INIT_QM, sw-calibration-access=READ-ONLY, type=V_Lnr_m2048_2047d9375_8000_7FFF_sint16  # Second low pass filtered of primary voltage sensor
package /Continental_08/PowerSAR/DataDictionary/PortInterfaces/V1_1_0
  sender receiver interface FacMduInvtFil  # Filtered modulation factor for inverter
    data FacMduInvtFil: sw-addr-method=VAR_INIT_QM, sw-calibration-access=READ-ONLY, type=NoUnit_Lnr_m2_2_float32  # Filtered modulation factor for inverter
  sender receiver interface StEmInvtReq  # Requested electrical machine state for the inverter
    data StEmInvtReq: sw-addr-method=VAR_INIT_QM, sw-calibration-access=READ-ONLY, type=TxtLfStOpmEm  # Requested electrical machine state for the inverter
package /Continental_08/PowerSAR/DataDictionary/ApplicationDataTypes
  16 x app type:
    A_Lnr_m2048_2047d9375_float32: category=VALUE, compu {phys=raw; unit A}, range phys -2048..2047.9375 A, display-format=%10.4f, unit=A  # high current
    Boolean: category=BOOLEAN, compu {0=FALSE, 1=TRUE}, range raw 0..1, display-format=%s, unit=-
    K_C_Lnr_0_511d9921875_0_FFFF_uint16: category=VALUE, compu {phys=raw/128; unit K}, range phys 0..511.9921875 K, display-format=%8.3f, unit=K
    K_C_Lnr_0_511d9921875_float32: category=VALUE, compu {phys=raw; unit K}, range phys 0..511.9921875 K, display-format=%8.3f, unit=K
    Nm_Lnr_m1024_1023d96875_float32: category=VALUE, compu {phys=raw; unit Nm}, range phys -1024..1023.96875 Nm, display-format=%8.2f, unit=Nm
    Nm_Lnr_m4096_4095d875_float32: category=VALUE, compu {phys=raw; unit Nm}, range phys -4096..4095.875 Nm, display-format=%7.1f, unit=Nm  # Torque on gearbox entry level (engine, clutch, electrical machine, dual mass flywheel etc)
    NoUnit_Lnr_0_11_0_B_uint8: category=VALUE, compu {phys=raw}, range phys 0..11, display-format=%2.0f, unit=-
    NoUnit_Lnr_0_255_0_FF_uint8: category=VALUE, compu {phys=raw}, range phys 0..255, display-format=%3.0f, unit=-
    NoUnit_Lnr_1_65535_1_FFFF_uint16: category=VALUE, compu {phys=raw}, range phys 1..65535, display-format=%1.0f, unit=-
    NoUnit_Lnr_m1_1_float32: category=VALUE, compu {phys=raw}, range phys -1..1, display-format=%8.5f, unit=-
    NoUnit_Lnr_m2_2_float32: category=VALUE, compu {phys=raw}, range phys -2..2, display-format=%8.5f, unit=-
    TxtLfStOpmEm:
      category=VALUE
      compu {mask 57344: 57344=ERR (ST_EM_MAIN__ERR) (Error), mask 57344: 49152=UKWN_6 (ST_EM_MAIN__UKWN_6), mask 57344: 40960=UKWN_5 (ST_EM_MAIN__UKWN_5), mask 57344: 32768=EM_CHA (ST_EM_MAIN__EM_CHA) (Electrical machine charging), mask 57344: 24576=POSN_CAL (ST_EM_MAIN__POSN_CAL) (Position calibration), mask 57344: 16384=CTL (ST_EM_MAIN__CTL) (Control), mask 57344: 8192=IDLE (ST_EM_MAIN__IDLE) (Idle), mask 57344: 0=NOT_AVL (ST_EM_MAIN__NOT_AVL) (Not available), mask 7936: 7936=UKWN_31 (ST_EM_1__UKWN_31), mask 7936: 7680=UKWN_30 (ST_EM_1__UKWN_30), mask 7936: 7424=UKWN_29 (ST_EM_1__UKWN_29), mask 7936: 7168=UKWN_28 (ST_EM_1__UKWN_28), mask 7936: 6912=UKWN_27 (ST_EM_1__UKWN_27), mask 7936: 6656=UKWN_26 (ST_EM_1__UKWN_26), mask 7936: 6400=UKWN_25 (ST_EM_1__UKWN_25), mask 7936: 6144=UKWN_24 (ST_EM_1__UKWN_24), mask 7936: 5888=UKWN_23 (ST_EM_1__UKWN_23), mask 7936: 5632=UKWN_22 (ST_EM_1__UKWN_22), mask 7936: 5376=UKWN_21 (ST_EM_1__UKWN_21), mask 7936: 5120=UKWN_20 (ST_EM_1__UKWN_20), mask 7936: 4864=UKWN_19 (ST_EM_1__UKWN_19), mask 7936: 4608=ERR_CTL_TQ_0 (ST_EM_1__ERR_CTL_TQ_0) (Error in torque zero control), mask 7936: 4352=ERR_FW (ST_EM_1__ERR_FW) (Error in free wheeling), mask 7936: 4096=ERR_SHO_ACT (ST_EM_1__ERR_SHO_ACT) (Error in active short cut), mask 7936: 3840=POSN_CAL_UKWN (ST_EM_1__POSN_CAL_UKWN) (Position calibration status unknown), mask 7936: 3584=POSN_CAL_INI (ST_EM_1__POSN_CAL_INI) (Initialize position calibration), mask 7936: 3328=POSN_CAL_PAS (ST_EM_1__POSN_CAL_PAS) (Passive position calibration), mask 7936: 3072=POSN_CAL_ACT (ST_EM_1__POSN_CAL_ACT) (Active position calibration), mask 7936: 2816=CTL_TRAN_IDLE (ST_EM_1__CTL_TRAN_IDLE) (Coordinate transition to idle), mask 7936: 2560=CTL_TQ_0 (ST_EM_1__CTL_TQ_0) (Torque zero control), mask 7936: 2304=CTL_DCHA_DCV (ST_EM_1__CTL_DCHA_DCV) (DC link discharging), mask 7936: 2048=CTL_I_DCV (ST_EM_1__CTL_I_DCV) (DC link current control), mask 7936: 1792=CTL_U_DCV (ST_EM_1__CTL_U_DCV) (DC link voltage control), mask 7936: 1536=CTL_N (ST_EM_1__CTL_N) (Speed control), mask 7936: 1280=CTL_TQ (ST_EM_1__CTL_TQ) (Torque control), mask 7936: 1024=IDLE_INI_CTL (ST_EM_1__IDLE_INI_CTL) (Idle initialize control), mask 7936: 768=IDLE_WAIT_REQ (ST_EM_1__IDLE_WAIT_REQ) (Idle wait for request), mask 7936: 512=IDLE_FW (ST_EM_1__IDLE_FW) (Idle free wheeling), mask 7936: 256=IDLE_SHO_ACT (ST_EM_1__IDLE_SHO_ACT) (Idle active short cut), mask 7936: 0=NOT_AVL (ST_EM_1__NOT_AVL) (Not available), mask 96: 96=UKWN (ST_EM_2__UKWN) (Unknown), mask 96: 64=N_CTL_EXT (ST_EM_2__N_CTL_EXT) (External speed control), mask 96: 32=N_CTL_IT (ST_EM_2__N_CTL_IT) (Internal speed control), mask 96: 0=NOT_AVL (ST_EM_2__NOT_AVL) (Not available), mask 12: 12=INVT_ACT (ST_INVT_1__INVT_ACT) (Inverter active), mask 12: 8=INVT_FW (ST_INVT_1__INVT_FW) (Inverter free wheeling), mask 12: 4=INVT_SHO_ACT (ST_INVT_1__INVT_SHO_ACT) (Inverter in active short cut), mask 12: 0=INVT_WAIT_REQ (ST_INVT_1__INVT_WAIT_REQ) (Inverter waiting for request), mask 3: 3=SHO_ACT (ST_INVT_2__SHO_ACT) (Active short cut any side), mask 3: 2=SHO_ACT_HI_SIDE (ST_INVT_2__SHO_ACT_HI_SIDE) (Active short cut high side), mask 3: 1=SHO_ACT_LO_SIDE (ST_INVT_2__SHO_ACT_LO_SIDE) (Active short cut low side), mask 3: 0=NOT_AVL (ST_INVT_2__NOT_AVL) (Not available)}
      range raw 0..65535
      display-format=%s
      unit=-
    TxtStOpmEmCom: category=VALUE, compu {0=FCT_RDY, 1=COM_RDY, 2=TQ_CTL, 3=N_CTL, 4=SHO_ACT, 5=POSN_CAL, 6=ERR, 7=CTL_DCHA_DCV}, range raw 0..7, display-format=%s, unit=-  # Text table to represent the main modes of inverter sent via COM
    TxtStTqNEmCtlCfm: category=VALUE, compu {0=NOT_AVL, 1=AVL, 2=CFM, 3=CNCL}, range raw 0..3, display-format=%s, unit=-
    V_Lnr_m2048_2047d9375_8000_7FFF_sint16: category=VALUE, compu {phys=raw*0.0625; unit V}, range phys -2048..2047.9375 V, display-format=%8.2f, unit=V
    W_Lnr_m67108864_67108863d96875_float32: category=VALUE, compu {phys=raw; unit W}, range phys -67108864..67108863.96875 W, display-format=%12.2f, unit=W  # electric power
package /Continental_08/PowerSAR/DataDictionary/UnitGroups
  unit group CalculationUnits: category=COUNTRY, unit=[A, K, Nm, NoUnit, V, W]
  unit group DisplayUnits: category=COUNTRY, unit=[A, C, Nm, NoUnit, V, W]
