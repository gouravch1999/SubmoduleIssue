[part 2 of 3: package /Continental_08/PowerSAR/DataDictionary/TimingExtensions/V1_0_0]
AUTOSAR XML (schema 00044)
package /Continental_08/PowerSAR/DataDictionary/TimingExtensions/V1_0_0
  53 x system timing, all with category=SYSTEM_EVENT:
    SysTran_ClrFmy  # This event is triggered on a request to clear the failure memory (e.g. by a diagnosis tool).
      timing-descriptions:
        6 x td event complex:
          Start
          SEV  # System Event Validation: Due to a delay between the detection of the system event and the execution of the system event implementation the conditions for the system event might disappear. In this case, runnables called after this phase can be informed or even skipped. Note: This phase is available on any event. Warning: This phase shall be used by the event producer only !
          PRD  # PRe-initialization of Diagnosis: Some functions need to be initialized before their diagnostic event is initialized in the Dem. The phase PRD corresponds to the old ""end_dc"" event.
          COD  # COre initialization of Diagnosis: Reserved for the core activity of diagnosis functions Dem/FiM. Do not use it without control of Dem/FiM ! Many transverse diagnostics are initialized at that point.
          POD  # POst-initialization of Diagnosis: Some functions need to be initialized after their diagnostic event is initialized in the Dem. The phase POD corresponds to the old ""st_dc"" event.
          End
        6 x timing description event chain:
          Start_SEV: stimulus=SysTran_ClrFmy/Start, response=SysTran_ClrFmy/SEV, segment=SysTran_ClrFmy/Start_SEV
          SEV_PRD: stimulus=SysTran_ClrFmy/SEV, response=SysTran_ClrFmy/PRD, segment=SysTran_ClrFmy/SEV_PRD
          PRD_COD: stimulus=SysTran_ClrFmy/PRD, response=SysTran_ClrFmy/COD, segment=SysTran_ClrFmy/PRD_COD
          COD_POD: stimulus=SysTran_ClrFmy/COD, response=SysTran_ClrFmy/POD, segment=SysTran_ClrFmy/COD_POD
          POD_End: stimulus=SysTran_ClrFmy/POD, response=SysTran_ClrFmy/End, segment=SysTran_ClrFmy/POD_End
          SysTran_ClrFmy: stimulus=SysTran_ClrFmy/Start, response=SysTran_ClrFmy/End, segment=[SysTran_ClrFmy/Start_SEV, SysTran_ClrFmy/SEV_PRD, SysTran_ClrFmy/PRD_COD, SysTran_ClrFmy/COD_POD, SysTran_ClrFmy/POD_End]
      timing-guarantees:
        latency timing constraint Deadline: latency-constraint-type=REACTION, scope=SysTran_ClrFmy, maximum={cse-code=0, cse-code-factor=250000}
      timing-requirements:
        sporadic event triggering ActivationPattern: event=SysTran_ClrFmy/Start, minimum-inter-arrival-time={cse-code=0, cse-code-factor=500000}, maximum-inter-arrival-time={cse-code=0, cse-code-factor=1000000000}
    SysTran_ClrNvm  # This event is Dcm internal to perform calls to software components to initialize RAM blocks of non-volatile data. It is fired by Dcm depending on different event diagnostic service or calibration data change during development.
      timing-descriptions:
        4 x td event complex:
          Start
          SEV  # System Event Validation: Due to a delay between the detection of the system event and the execution of the system event implementation the conditions for the system event might disappear. In this case, runnables called after this phase can be informed or even skipped. Note: This phase is available on any event. Warning: This phase shall be used by the event producer only !
          DPN  # Data Processing for Next cycle: Data needed for next event occurence or for other events are calculated. Computations that have no «internal deadline» are located here. The data produced here and consumed in the same event will have a delay of one period in the next occurence of the event.
          End
        4 x timing description event chain:
          Start_SEV: stimulus=SysTran_ClrNvm/Start, response=SysTran_ClrNvm/SEV, segment=SysTran_ClrNvm/Start_SEV
          SEV_DPN: stimulus=SysTran_ClrNvm/SEV, response=SysTran_ClrNvm/DPN, segment=SysTran_ClrNvm/SEV_DPN
          DPN_End: stimulus=SysTran_ClrNvm/DPN, response=SysTran_ClrNvm/End, segment=SysTran_ClrNvm/DPN_End
          SysTran_ClrNvm: stimulus=SysTran_ClrNvm/Start, response=SysTran_ClrNvm/End, segment=[SysTran_ClrNvm/Start_SEV, SysTran_ClrNvm/SEV_DPN, SysTran_ClrNvm/DPN_End]
      timing-guarantees:
        latency timing constraint Deadline: latency-constraint-type=REACTION, scope=SysTran_ClrNvm, maximum={cse-code=0, cse-code-factor=250000}
      timing-requirements:
        sporadic event triggering ActivationPattern: event=SysTran_ClrNvm/Start, minimum-inter-arrival-time={cse-code=0, cse-code-factor=500000}, maximum-inter-arrival-time={cse-code=0, cse-code-factor=1000000000}
    SysTran_DemIt  # This event is Dem internal and used to fire Dem and FiM events (used to fire e.g. CycObdEnd from timing conditions).
      timing-descriptions:
        6 x td event complex:
          Start
          SEV  # System Event Validation: Due to a delay between the detection of the system event and the execution of the system event implementation the conditions for the system event might disappear. In this case, runnables called after this phase can be informed or even skipped. Note: This phase is available on any event. Warning: This phase shall be used by the event producer only !
          PRD  # PRe-initialization of Diagnosis: Some functions need to be initialized before their diagnostic event is initialized in the Dem. The phase PRD corresponds to the old ""end_dc"" event.
          COD  # COre initialization of Diagnosis: Reserved for the core activity of diagnosis functions Dem/FiM. Do not use it without control of Dem/FiM ! Many transverse diagnostics are initialized at that point.
          POD  # POst-initialization of Diagnosis: Some functions need to be initialized after their diagnostic event is initialized in the Dem. The phase POD corresponds to the old ""st_dc"" event.
          End
        6 x timing description event chain:
          Start_SEV: stimulus=SysTran_DemIt/Start, response=SysTran_DemIt/SEV, segment=SysTran_DemIt/Start_SEV
          SEV_PRD: stimulus=SysTran_DemIt/SEV, response=SysTran_DemIt/PRD, segment=SysTran_DemIt/SEV_PRD
          PRD_COD: stimulus=SysTran_DemIt/PRD, response=SysTran_DemIt/COD, segment=SysTran_DemIt/PRD_COD
          COD_POD: stimulus=SysTran_DemIt/COD, response=SysTran_DemIt/POD, segment=SysTran_DemIt/COD_POD
          POD_End: stimulus=SysTran_DemIt/POD, response=SysTran_DemIt/End, segment=SysTran_DemIt/POD_End
          SysTran_DemIt: stimulus=SysTran_DemIt/Start, response=SysTran_DemIt/End, segment=[SysTran_DemIt/Start_SEV, SysTran_DemIt/SEV_PRD, SysTran_DemIt/PRD_COD, SysTran_DemIt/COD_POD, SysTran_DemIt/POD_End]
      timing-guarantees:
        latency timing constraint Deadline: latency-constraint-type=REACTION, scope=SysTran_DemIt, maximum={cse-code=0, cse-code-factor=10000}
      timing-requirements:
        sporadic event triggering ActivationPattern: event=SysTran_DemIt/Start, minimum-inter-arrival-time={cse-code=0, cse-code-factor=500000}, maximum-inter-arrival-time={cse-code=0, cse-code-factor=1000000000}
    SysTran_EnterEnro  # This event occurs when engine rotation is confirmed.
      timing-descriptions:
        6 x td event complex:
          Start
          SEV  # System Event Validation: Due to a delay between the detection of the system event and the execution of the system event implementation the conditions for the system event might disappear. In this case, runnables called after this phase can be informed or even skipped. Note: This phase is available on any event. Warning: This phase shall be used by the event producer only !
          PST  # Preparation of System Transition: Acquisitions, related diagnoses and any computation needed to prepare the detection of a system transition are done.
          DST  # Detection of System Transition: Major system transitions are detected as soon as possible so that nominal computations benefit from the initialization, instead of being overwritten.
          DPN  # Data Processing for Next cycle: Data needed for next event occurence or for other events are calculated. Computations that have no «internal deadline» are located here. The data produced here and consumed in the same event will have a delay of one period in the next occurence of the event.
          End
        6 x timing description event chain:
          Start_SEV: stimulus=SysTran_EnterEnro/Start, response=SysTran_EnterEnro/SEV, segment=SysTran_EnterEnro/Start_SEV
          SEV_PST: stimulus=SysTran_EnterEnro/SEV, response=SysTran_EnterEnro/PST, segment=SysTran_EnterEnro/SEV_PST
          PST_DST: stimulus=SysTran_EnterEnro/PST, response=SysTran_EnterEnro/DST, segment=SysTran_EnterEnro/PST_DST
          DST_DPN: stimulus=SysTran_EnterEnro/DST, response=SysTran_EnterEnro/DPN, segment=SysTran_EnterEnro/DST_DPN
          DPN_End: stimulus=SysTran_EnterEnro/DPN, response=SysTran_EnterEnro/End, segment=SysTran_EnterEnro/DPN_End
          SysTran_EnterEnro: stimulus=SysTran_EnterEnro/Start, response=SysTran_EnterEnro/End, segment=[SysTran_EnterEnro/Start_SEV, SysTran_EnterEnro/SEV_PST, SysTran_EnterEnro/PST_DST, SysTran_EnterEnro/DST_DPN, SysTran_EnterEnro/DPN_End]
      timing-guarantees:
        latency timing constraint Deadline: latency-constraint-type=REACTION, scope=SysTran_EnterEnro, maximum={cse-code=0, cse-code-factor=10000}
      timing-requirements:
        sporadic event triggering ActivationPattern: event=SysTran_EnterEnro/Start, minimum-inter-arrival-time={cse-code=0, cse-code-factor=500000}, maximum-inter-arrival-time={cse-code=0, cse-code-factor=1000000000}
    SysTran_EnterEs  # This event occurs as soon a physical engine stop can be assumed.
      timing-descriptions:
        4 x td event complex:
          Start
          SEV  # System Event Validation: Due to a delay between the detection of the system event and the execution of the system event implementation the conditions for the system event might disappear. In this case, runnables called after this phase can be informed or even skipped. Note: This phase is available on any event. Warning: This phase shall be used by the event producer only !
          DPN  # Data Processing for Next cycle: Data needed for next event occurence or for other events are calculated. Computations that have no «internal deadline» are located here. The data produced here and consumed in the same event will have a delay of one period in the next occurence of the event.
          End
        4 x timing description event chain:
          Start_SEV: stimulus=SysTran_EnterEs/Start, response=SysTran_EnterEs/SEV, segment=SysTran_EnterEs/Start_SEV
          SEV_DPN: stimulus=SysTran_EnterEs/SEV, response=SysTran_EnterEs/DPN, segment=SysTran_EnterEs/SEV_DPN
          DPN_End: stimulus=SysTran_EnterEs/DPN, response=SysTran_EnterEs/End, segment=SysTran_EnterEs/DPN_End
          SysTran_EnterEs: stimulus=SysTran_EnterEs/Start, response=SysTran_EnterEs/End, segment=[SysTran_EnterEs/Start_SEV, SysTran_EnterEs/SEV_DPN, SysTran_EnterEs/DPN_End]
      timing-guarantees:
        latency timing constraint Deadline: latency-constraint-type=REACTION, scope=SysTran_EnterEs, maximum={cse-code=0, cse-code-factor=10000}
      timing-requirements:
        sporadic event triggering ActivationPattern: event=SysTran_EnterEs/Start, minimum-inter-arrival-time={cse-code=0, cse-code-factor=500000}, maximum-inter-arrival-time={cse-code=0, cse-code-factor=1000000000}
    SysTran_EnterSyn  # This event occurs as soon as engine synchronization is achieved.
      timing-descriptions:
        6 x td event complex:
          Start
          SEV  # System Event Validation: Due to a delay between the detection of the system event and the execution of the system event implementation the conditions for the system event might disappear. In this case, runnables called after this phase can be informed or even skipped. Note: This phase is available on any event. Warning: This phase shall be used by the event producer only !
          PST  # Preparation of System Transition: Acquisitions, related diagnoses and any computation needed to prepare the detection of a system transition are done.
          DST  # Detection of System Transition: Major system transitions are detected as soon as possible so that nominal computations benefit from the initialization, instead of being overwritten.
          DPN  # Data Processing for Next cycle: Data needed for next event occurence or for other events are calculated. Computations that have no «internal deadline» are located here. The data produced here and consumed in the same event will have a delay of one period in the next occurence of the event.
          End
        6 x timing description event chain:
          Start_SEV: stimulus=SysTran_EnterSyn/Start, response=SysTran_EnterSyn/SEV, segment=SysTran_EnterSyn/Start_SEV
          SEV_PST: stimulus=SysTran_EnterSyn/SEV, response=SysTran_EnterSyn/PST, segment=SysTran_EnterSyn/SEV_PST
          PST_DST: stimulus=SysTran_EnterSyn/PST, response=SysTran_EnterSyn/DST, segment=SysTran_EnterSyn/PST_DST
          DST_DPN: stimulus=SysTran_EnterSyn/DST, response=SysTran_EnterSyn/DPN, segment=SysTran_EnterSyn/DST_DPN
          DPN_End: stimulus=SysTran_EnterSyn/DPN, response=SysTran_EnterSyn/End, segment=SysTran_EnterSyn/DPN_End
          SysTran_EnterSyn: stimulus=SysTran_EnterSyn/Start, response=SysTran_EnterSyn/End, segment=[SysTran_EnterSyn/Start_SEV, SysTran_EnterSyn/SEV_PST, SysTran_EnterSyn/PST_DST, SysTran_EnterSyn/DST_DPN, SysTran_EnterSyn/DPN_End]
      timing-guarantees:
        latency timing constraint Deadline: latency-constraint-type=REACTION, scope=SysTran_EnterSyn, maximum={cse-code=0, cse-code-factor=10000}
      timing-requirements:
        sporadic event triggering ActivationPattern: event=SysTran_EnterSyn/Start, minimum-inter-arrival-time={cse-code=0, cse-code-factor=500000}, maximum-inter-arrival-time={cse-code=0, cse-code-factor=1000000000}
    SysTran_ExitEnro  # This event occurs when engine stalling is detected.
      timing-descriptions:
        6 x td event complex:
          Start
          SEV  # System Event Validation: Due to a delay between the detection of the system event and the execution of the system event implementation the conditions for the system event might disappear. In this case, runnables called after this phase can be informed or even skipped. Note: This phase is available on any event. Warning: This phase shall be used by the event producer only !
          PST  # Preparation of System Transition: Acquisitions, related diagnoses and any computation needed to prepare the detection of a system transition are done.
          DST  # Detection of System Transition: Major system transitions are detected as soon as possible so that nominal computations benefit from the initialization, instead of being overwritten.
          DPN  # Data Processing for Next cycle: Data needed for next event occurence or for other events are calculated. Computations that have no «internal deadline» are located here. The data produced here and consumed in the same event will have a delay of one period in the next occurence of the event.
          End
        6 x timing description event chain:
          Start_SEV: stimulus=SysTran_ExitEnro/Start, response=SysTran_ExitEnro/SEV, segment=SysTran_ExitEnro/Start_SEV
          SEV_PST: stimulus=SysTran_ExitEnro/SEV, response=SysTran_ExitEnro/PST, segment=SysTran_ExitEnro/SEV_PST
          PST_DST: stimulus=SysTran_ExitEnro/PST, response=SysTran_ExitEnro/DST, segment=SysTran_ExitEnro/PST_DST
          DST_DPN: stimulus=SysTran_ExitEnro/DST, response=SysTran_ExitEnro/DPN, segment=SysTran_ExitEnro/DST_DPN
          DPN_End: stimulus=SysTran_ExitEnro/DPN, response=SysTran_ExitEnro/End, segment=SysTran_ExitEnro/DPN_End
          SysTran_ExitEnro: stimulus=SysTran_ExitEnro/Start, response=SysTran_ExitEnro/End, segment=[SysTran_ExitEnro/Start_SEV, SysTran_ExitEnro/SEV_PST, SysTran_ExitEnro/PST_DST, SysTran_ExitEnro/DST_DPN, SysTran_ExitEnro/DPN_End]
      timing-guarantees:
        latency timing constraint Deadline: latency-constraint-type=REACTION, scope=SysTran_ExitEnro, maximum={cse-code=0, cse-code-factor=10000}
      timing-requirements:
        sporadic event triggering ActivationPattern: event=SysTran_ExitEnro/Start, minimum-inter-arrival-time={cse-code=0, cse-code-factor=500000}, maximum-inter-arrival-time={cse-code=0, cse-code-factor=1000000000}
    SysTran_ExitEs  # This event occurs as soon as any engine movement is detected.
      timing-descriptions:
        4 x td event complex:
          Start
          SEV  # System Event Validation: Due to a delay between the detection of the system event and the execution of the system event implementation the conditions for the system event might disappear. In this case, runnables called after this phase can be informed or even skipped. Note: This phase is available on any event. Warning: This phase shall be used by the event producer only !
          DPN  # Data Processing for Next cycle: Data needed for next event occurence or for other events are calculated. Computations that have no «internal deadline» are located here. The data produced here and consumed in the same event will have a delay of one period in the next occurence of the event.
          End
        4 x timing description event chain:
          Start_SEV: stimulus=SysTran_ExitEs/Start, response=SysTran_ExitEs/SEV, segment=SysTran_ExitEs/Start_SEV
          SEV_DPN: stimulus=SysTran_ExitEs/SEV, response=SysTran_ExitEs/DPN, segment=SysTran_ExitEs/SEV_DPN
          DPN_End: stimulus=SysTran_ExitEs/DPN, response=SysTran_ExitEs/End, segment=SysTran_ExitEs/DPN_End
          SysTran_ExitEs: stimulus=SysTran_ExitEs/Start, response=SysTran_ExitEs/End, segment=[SysTran_ExitEs/Start_SEV, SysTran_ExitEs/SEV_DPN, SysTran_ExitEs/DPN_End]
      timing-guarantees:
        latency timing constraint Deadline: latency-constraint-type=REACTION, scope=SysTran_ExitEs, maximum={cse-code=0, cse-code-factor=10000}
      timing-requirements:
        sporadic event triggering ActivationPattern: event=SysTran_ExitEs/Start, minimum-inter-arrival-time={cse-code=0, cse-code-factor=500000}, maximum-inter-arrival-time={cse-code=0, cse-code-factor=1000000000}
    SysTran_ExitSyn  # This event occurs when engine synchronization is lost.
      timing-descriptions:
        6 x td event complex:
          Start
          SEV  # System Event Validation: Due to a delay between the detection of the system event and the execution of the system event implementation the conditions for the system event might disappear. In this case, runnables called after this phase can be informed or even skipped. Note: This phase is available on any event. Warning: This phase shall be used by the event producer only !
          PST  # Preparation of System Transition: Acquisitions, related diagnoses and any computation needed to prepare the detection of a system transition are done.
          DST  # Detection of System Transition: Major system transitions are detected as soon as possible so that nominal computations benefit from the initialization, instead of being overwritten.
          DPN  # Data Processing for Next cycle: Data needed for next event occurence or for other events are calculated. Computations that have no «internal deadline» are located here. The data produced here and consumed in the same event will have a delay of one period in the next occurence of the event.
          End
        6 x timing description event chain:
          Start_SEV: stimulus=SysTran_ExitSyn/Start, response=SysTran_ExitSyn/SEV, segment=SysTran_ExitSyn/Start_SEV
          SEV_PST: stimulus=SysTran_ExitSyn/SEV, response=SysTran_ExitSyn/PST, segment=SysTran_ExitSyn/SEV_PST
          PST_DST: stimulus=SysTran_ExitSyn/PST, response=SysTran_ExitSyn/DST, segment=SysTran_ExitSyn/PST_DST
          DST_DPN: stimulus=SysTran_ExitSyn/DST, response=SysTran_ExitSyn/DPN, segment=SysTran_ExitSyn/DST_DPN
          DPN_End: stimulus=SysTran_ExitSyn/DPN, response=SysTran_ExitSyn/End, segment=SysTran_ExitSyn/DPN_End
          SysTran_ExitSyn: stimulus=SysTran_ExitSyn/Start, response=SysTran_ExitSyn/End, segment=[SysTran_ExitSyn/Start_SEV, SysTran_ExitSyn/SEV_PST, SysTran_ExitSyn/PST_DST, SysTran_ExitSyn/DST_DPN, SysTran_ExitSyn/DPN_End]
      timing-guarantees:
        latency timing constraint Deadline: latency-constraint-type=REACTION, scope=SysTran_ExitSyn, maximum={cse-code=0, cse-code-factor=10000}
      timing-requirements:
        sporadic event triggering ActivationPattern: event=SysTran_ExitSyn/Start, minimum-inter-arrival-time={cse-code=0, cse-code-factor=500000}, maximum-inter-arrival-time={cse-code=0, cse-code-factor=1000000000}
    SysTran_Off2On  # This event occurs when a key-off to key-on transition is detected. It is not triggered at reset, if the key wakes up the ECU.
      timing-descriptions:
        6 x td event complex:
          Start
          SEV  # System Event Validation: Due to a delay between the detection of the system event and the execution of the system event implementation the conditions for the system event might disappear. In this case, runnables called after this phase can be informed or even skipped. Note: This phase is available on any event. Warning: This phase shall be used by the event producer only !
          PRD  # PRe-initialization of Diagnosis: Some functions need to be initialized before their diagnostic event is initialized in the Dem. The phase PRD corresponds to the old ""end_dc"" event.
          COD  # COre initialization of Diagnosis: Reserved for the core activity of diagnosis functions Dem/FiM. Do not use it without control of Dem/FiM ! Many transverse diagnostics are initialized at that point.
          POD  # POst-initialization of Diagnosis: Some functions need to be initialized after their diagnostic event is initialized in the Dem. The phase POD corresponds to the old ""st_dc"" event.
          End
        6 x timing description event chain:
          Start_SEV: stimulus=SysTran_Off2On/Start, response=SysTran_Off2On/SEV, segment=SysTran_Off2On/Start_SEV
          SEV_PRD: stimulus=SysTran_Off2On/SEV, response=SysTran_Off2On/PRD, segment=SysTran_Off2On/SEV_PRD
          PRD_COD: stimulus=SysTran_Off2On/PRD, response=SysTran_Off2On/COD, segment=SysTran_Off2On/PRD_COD
          COD_POD: stimulus=SysTran_Off2On/COD, response=SysTran_Off2On/POD, segment=SysTran_Off2On/COD_POD
          POD_End: stimulus=SysTran_Off2On/POD, response=SysTran_Off2On/End, segment=SysTran_Off2On/POD_End
          SysTran_Off2On: stimulus=SysTran_Off2On/Start, response=SysTran_Off2On/End, segment=[SysTran_Off2On/Start_SEV, SysTran_Off2On/SEV_PRD, SysTran_Off2On/PRD_COD, SysTran_Off2On/COD_POD, SysTran_Off2On/POD_End]
      timing-guarantees:
        latency timing constraint Deadline: latency-constraint-type=REACTION, scope=SysTran_Off2On, maximum={cse-code=0, cse-code-factor=10000}
      timing-requirements:
        sporadic event triggering ActivationPattern: event=SysTran_Off2On/Start, minimum-inter-arrival-time={cse-code=0, cse-code-factor=500000}, maximum-inter-arrival-time={cse-code=0, cse-code-factor=1000000000}
    SysTran_On2Off  # This event occurs when a key-on to key-off transition is detected.
      timing-descriptions:
        4 x td event complex:
          Start
          SEV  # System Event Validation: Due to a delay between the detection of the system event and the execution of the system event implementation the conditions for the system event might disappear. In this case, runnables called after this phase can be informed or even skipped. Note: This phase is available on any event. Warning: This phase shall be used by the event producer only !
          DPN  # Data Processing for Next cycle: Data needed for next event occurence or for other events are calculated. Computations that have no «internal deadline» are located here. The data produced here and consumed in the same event will have a delay of one period in the next occurence of the event.
          End
        4 x timing description event chain:
          Start_SEV: stimulus=SysTran_On2Off/Start, response=SysTran_On2Off/SEV, segment=SysTran_On2Off/Start_SEV
          SEV_DPN: stimulus=SysTran_On2Off/SEV, response=SysTran_On2Off/DPN, segment=SysTran_On2Off/SEV_DPN
          DPN_End: stimulus=SysTran_On2Off/DPN, response=SysTran_On2Off/End, segment=SysTran_On2Off/DPN_End
          SysTran_On2Off: stimulus=SysTran_On2Off/Start, response=SysTran_On2Off/End, segment=[SysTran_On2Off/Start_SEV, SysTran_On2Off/SEV_DPN, SysTran_On2Off/DPN_End]
      timing-guarantees:
        latency timing constraint Deadline: latency-constraint-type=REACTION, scope=SysTran_On2Off, maximum={cse-code=0, cse-code-factor=10000}
      timing-requirements:
        sporadic event triggering ActivationPattern: event=SysTran_On2Off/Start, minimum-inter-arrival-time={cse-code=0, cse-code-factor=500000}, maximum-inter-arrival-time={cse-code=0, cse-code-factor=1000000000}
    SysTran_Opm2Pwl  # This event occurs when a transition from normal ECU operation mode to power latch phase is detected (Similar to Run to PostRun).
      timing-descriptions:
        4 x td event complex:
          Start
          SEV  # System Event Validation: Due to a delay between the detection of the system event and the execution of the system event implementation the conditions for the system event might disappear. In this case, runnables called after this phase can be informed or even skipped. Note: This phase is available on any event. Warning: This phase shall be used by the event producer only !
          DPN  # Data Processing for Next cycle: Data needed for next event occurence or for other events are calculated. Computations that have no «internal deadline» are located here. The data produced here and consumed in the same event will have a delay of one period in the next occurence of the event.
          End
        4 x timing description event chain:
          Start_SEV: stimulus=SysTran_Opm2Pwl/Start, response=SysTran_Opm2Pwl/SEV, segment=SysTran_Opm2Pwl/Start_SEV
          SEV_DPN: stimulus=SysTran_Opm2Pwl/SEV, response=SysTran_Opm2Pwl/DPN, segment=SysTran_Opm2Pwl/SEV_DPN
          DPN_End: stimulus=SysTran_Opm2Pwl/DPN, response=SysTran_Opm2Pwl/End, segment=SysTran_Opm2Pwl/DPN_End
          SysTran_Opm2Pwl: stimulus=SysTran_Opm2Pwl/Start, response=SysTran_Opm2Pwl/End, segment=[SysTran_Opm2Pwl/Start_SEV, SysTran_Opm2Pwl/SEV_DPN, SysTran_Opm2Pwl/DPN_End]
      timing-guarantees:
        latency timing constraint Deadline: latency-constraint-type=REACTION, scope=SysTran_Opm2Pwl, maximum={cse-code=0, cse-code-factor=10000}
      timing-requirements:
        sporadic event triggering ActivationPattern: event=SysTran_Opm2Pwl/Start, minimum-inter-arrival-time={cse-code=0, cse-code-factor=500000}, maximum-inter-arrival-time={cse-code=0, cse-code-factor=1000000000}
    SysTran_Pwl2Opm  # This event occurs when a transition from power latch phase back to normal ECU operation mode is detected (Similar to PostRun to Run).
      timing-descriptions:
        4 x td event complex:
          Start
          SEV  # System Event Validation: Due to a delay between the detection of the system event and the execution of the system event implementation the conditions for the system event might disappear. In this case, runnables called after this phase can be informed or even skipped. Note: This phase is available on any event. Warning: This phase shall be used by the event producer only !
          DPN  # Data Processing for Next cycle: Data needed for next event occurence or for other events are calculated. Computations that have no «internal deadline» are located here. The data produced here and consumed in the same event will have a delay of one period in the next occurence of the event.
          End
        4 x timing description event chain:
          Start_SEV: stimulus=SysTran_Pwl2Opm/Start, response=SysTran_Pwl2Opm/SEV, segment=SysTran_Pwl2Opm/Start_SEV
          SEV_DPN: stimulus=SysTran_Pwl2Opm/SEV, response=SysTran_Pwl2Opm/DPN, segment=SysTran_Pwl2Opm/SEV_DPN
          DPN_End: stimulus=SysTran_Pwl2Opm/DPN, response=SysTran_Pwl2Opm/End, segment=SysTran_Pwl2Opm/DPN_End
          SysTran_Pwl2Opm: stimulus=SysTran_Pwl2Opm/Start, response=SysTran_Pwl2Opm/End, segment=[SysTran_Pwl2Opm/Start_SEV, SysTran_Pwl2Opm/SEV_DPN, SysTran_Pwl2Opm/DPN_End]
      timing-guarantees:
        latency timing constraint Deadline: latency-constraint-type=REACTION, scope=SysTran_Pwl2Opm, maximum={cse-code=0, cse-code-factor=10000}
      timing-requirements:
        sporadic event triggering ActivationPattern: event=SysTran_Pwl2Opm/Start, minimum-inter-arrival-time={cse-code=0, cse-code-factor=500000}, maximum-inter-arrival-time={cse-code=0, cse-code-factor=1000000000}
    SysTran_Rst  # The reset event runs once at system startup to initialize application software.
      timing-descriptions:
        6 x td event complex:
          Start
          SEV  # System Event Validation: Due to a delay between the detection of the system event and the execution of the system event implementation the conditions for the system event might disappear. In this case, runnables called after this phase can be informed or even skipped. Note: This phase is available on any event. Warning: This phase shall be used by the event producer only !
          PST  # Preparation of System Transition: Acquisitions, related diagnoses and any computation needed to prepare the detection of a system transition are done.
          DST  # Detection of System Transition: Major system transitions are detected as soon as possible so that nominal computations benefit from the initialization, instead of being overwritten.
          DPN  # Data Processing for Next cycle: Data needed for next event occurence or for other events are calculated. Computations that have no «internal deadline» are located here. The data produced here and consumed in the same event will have a delay of one period in the next occurence of the event.
          End
        6 x timing description event chain:
          Start_SEV: stimulus=SysTran_Rst/Start, response=SysTran_Rst/SEV, segment=SysTran_Rst/Start_SEV
          SEV_PST: stimulus=SysTran_Rst/SEV, response=SysTran_Rst/PST, segment=SysTran_Rst/SEV_PST
          PST_DST: stimulus=SysTran_Rst/PST, response=SysTran_Rst/DST, segment=SysTran_Rst/PST_DST
          DST_DPN: stimulus=SysTran_Rst/DST, response=SysTran_Rst/DPN, segment=SysTran_Rst/DST_DPN
          DPN_End: stimulus=SysTran_Rst/DPN, response=SysTran_Rst/End, segment=SysTran_Rst/DPN_End
          SysTran_Rst: stimulus=SysTran_Rst/Start, response=SysTran_Rst/End, segment=[SysTran_Rst/Start_SEV, SysTran_Rst/SEV_PST, SysTran_Rst/PST_DST, SysTran_Rst/DST_DPN, SysTran_Rst/DPN_End]
      timing-guarantees:
        latency timing constraint Deadline: latency-constraint-type=REACTION, scope=SysTran_Rst, maximum={cse-code=0, cse-code-factor=100000}
      timing-requirements:
        sporadic event triggering ActivationPattern: event=SysTran_Rst/Start, minimum-inter-arrival-time={cse-code=0, cse-code-factor=500000}, maximum-inter-arrival-time={cse-code=0, cse-code-factor=1000000000}
    SysTran_Sdn  # This event occurs when a transition to shutdown phase is detected. IMPORTANT: The system will not return to the operating mode from this point on without a reset.
      timing-descriptions:
        6 x td event complex:
          Start
          SEV  # System Event Validation: Due to a delay between the detection of the system event and the execution of the system event implementation the conditions for the system event might disappear. In this case, runnables called after this phase can be informed or even skipped. Note: This phase is available on any event. Warning: This phase shall be used by the event producer only !
          PRD  # PRe-initialization of Diagnosis: Some functions need to be initialized before their diagnostic event is initialized in the Dem. The phase PRD corresponds to the old ""end_dc"" event.
          COD  # COre initialization of Diagnosis: Reserved for the core activity of diagnosis functions Dem/FiM. Do not use it without control of Dem/FiM ! Many transverse diagnostics are initialized at that point.
          POD  # POst-initialization of Diagnosis: Some functions need to be initialized after their diagnostic event is initialized in the Dem. The phase POD corresponds to the old ""st_dc"" event.
          End
        6 x timing description event chain:
          Start_SEV: stimulus=SysTran_Sdn/Start, response=SysTran_Sdn/SEV, segment=SysTran_Sdn/Start_SEV
          SEV_PRD: stimulus=SysTran_Sdn/SEV, response=SysTran_Sdn/PRD, segment=SysTran_Sdn/SEV_PRD
          PRD_COD: stimulus=SysTran_Sdn/PRD, response=SysTran_Sdn/COD, segment=SysTran_Sdn/PRD_COD
          COD_POD: stimulus=SysTran_Sdn/COD, response=SysTran_Sdn/POD, segment=SysTran_Sdn/COD_POD
          POD_End: stimulus=SysTran_Sdn/POD, response=SysTran_Sdn/End, segment=SysTran_Sdn/POD_End
          SysTran_Sdn: stimulus=SysTran_Sdn/Start, response=SysTran_Sdn/End, segment=[SysTran_Sdn/Start_SEV, SysTran_Sdn/SEV_PRD, SysTran_Sdn/PRD_COD, SysTran_Sdn/COD_POD, SysTran_Sdn/POD_End]
      timing-guarantees:
        latency timing constraint Deadline: latency-constraint-type=REACTION, scope=SysTran_Sdn, maximum={cse-code=0, cse-code-factor=10000}
      timing-requirements:
        sporadic event triggering ActivationPattern: event=SysTran_Sdn/Start, minimum-inter-arrival-time={cse-code=0, cse-code-factor=500000}, maximum-inter-arrival-time={cse-code=0, cse-code-factor=1000000000}
    SysTran_StuCnf  # This event occurs once at system startup to do configuration before ASW initialization.
      timing-descriptions:
        4 x td event complex:
          Start
          SEV  # System Event Validation: Due to a delay between the detection of the system event and the execution of the system event implementation the conditions for the system event might disappear. In this case, runnables called after this phase can be informed or even skipped. Note: This phase is available on any event. Warning: This phase shall be used by the event producer only !
          DPN  # Data Processing for Next cycle: Data needed for next event occurence or for other events are calculated. Computations that have no «internal deadline» are located here. The data produced here and consumed in the same event will have a delay of one period in the next occurence of the event.
          End
        4 x timing description event chain:
          Start_SEV: stimulus=SysTran_StuCnf/Start, response=SysTran_StuCnf/SEV, segment=SysTran_StuCnf/Start_SEV
          SEV_DPN: stimulus=SysTran_StuCnf/SEV, response=SysTran_StuCnf/DPN, segment=SysTran_StuCnf/SEV_DPN
          DPN_End: stimulus=SysTran_StuCnf/DPN, response=SysTran_StuCnf/End, segment=SysTran_StuCnf/DPN_End
          SysTran_StuCnf: stimulus=SysTran_StuCnf/Start, response=SysTran_StuCnf/End, segment=[SysTran_StuCnf/Start_SEV, SysTran_StuCnf/SEV_DPN, SysTran_StuCnf/DPN_End]
      timing-guarantees:
        latency timing constraint Deadline: latency-constraint-type=REACTION, scope=SysTran_StuCnf, maximum={cse-code=0, cse-code-factor=200000}
      timing-requirements:
        sporadic event triggering ActivationPattern: event=SysTran_StuCnf/Start, minimum-inter-arrival-time={cse-code=0, cse-code-factor=500000}, maximum-inter-arrival-time={cse-code=0, cse-code-factor=1000000000}
    SysTrig_1000msT0  # This is a periodic event with 1000ms recurrence and a deadline shorter than 1000ms.
      timing-descriptions:
        15 x td event complex:
          Start
          SEV  # System Event Validation: Due to a delay between the detection of the system event and the execution of the system event implementation the conditions for the system event might disappear. In this case, runnables called after this phase can be informed or even skipped. Note: This phase is available on any event. Warning: This phase shall be used by the event producer only !
          ADI  # Acquisition and associated Diagnoses: Acquisitions (and diagnosis) have to be done early in the event in order to get the results ready for the complete event.
          CCI  # Cross-Checking of Inputs: Input data crosschecking, high level diagnostic and input limp home actions are performed.
          SYV  # SYstem Variables computation: System variables are computed based on ECU inputs to be used in a high number of functions.
          POR  # Preparation Of Requests: Request data are elaborated based on inputs, which need a lot of logics. A request is not subject to control loop.
          CBS  # Calculation of Basic Setpoints: Basic setpoints are calculated based on system variables and requests.
          CCS  # Calculation of Complex Setpoints: Complex setpoints are based on system variables, requests and other setpoints.
          CSC  # Calculation of Setpoint Corrections: Setpoint corrections are done to align them with other setpoints.
          ROS  # Realisation Of Setpoints: BSW is informed about new ASW data. Basically actuating of the HW is done here.
          PAD  # Post Acquisition of Data: Additional acquisitions which were not relevant until the ASW to BSW communication point are performed now.
          PPC  # Post Processing Calculations: Postprocessing is performed.
          CCM  # Calibration CoMmunication: Data are sent to the calibration and communication system.
          DPN  # Data Processing for Next cycle: Data needed for next event occurence or for other events are calculated. Computations that have no «internal deadline» are located here. The data produced here and consumed in the same event will have a delay of one period in the next occurence of the event.
          End
        15 x timing description event chain:
          Start_SEV: stimulus=SysTrig_1000msT0/Start, response=SysTrig_1000msT0/SEV, segment=SysTrig_1000msT0/Start_SEV
          SEV_ADI: stimulus=SysTrig_1000msT0/SEV, response=SysTrig_1000msT0/ADI, segment=SysTrig_1000msT0/SEV_ADI
          ADI_CCI: stimulus=SysTrig_1000msT0/ADI, response=SysTrig_1000msT0/CCI, segment=SysTrig_1000msT0/ADI_CCI
          CCI_SYV: stimulus=SysTrig_1000msT0/CCI, response=SysTrig_1000msT0/SYV, segment=SysTrig_1000msT0/CCI_SYV
          SYV_POR: stimulus=SysTrig_1000msT0/SYV, response=SysTrig_1000msT0/POR, segment=SysTrig_1000msT0/SYV_POR
          POR_CBS: stimulus=SysTrig_1000msT0/POR, response=SysTrig_1000msT0/CBS, segment=SysTrig_1000msT0/POR_CBS
          CBS_CCS: stimulus=SysTrig_1000msT0/CBS, response=SysTrig_1000msT0/CCS, segment=SysTrig_1000msT0/CBS_CCS
          CCS_CSC: stimulus=SysTrig_1000msT0/CCS, response=SysTrig_1000msT0/CSC, segment=SysTrig_1000msT0/CCS_CSC
          CSC_ROS: stimulus=SysTrig_1000msT0/CSC, response=SysTrig_1000msT0/ROS, segment=SysTrig_1000msT0/CSC_ROS
          ROS_PAD: stimulus=SysTrig_1000msT0/ROS, response=SysTrig_1000msT0/PAD, segment=SysTrig_1000msT0/ROS_PAD
          PAD_PPC: stimulus=SysTrig_1000msT0/PAD, response=SysTrig_1000msT0/PPC, segment=SysTrig_1000msT0/PAD_PPC
          PPC_CCM: stimulus=SysTrig_1000msT0/PPC, response=SysTrig_1000msT0/CCM, segment=SysTrig_1000msT0/PPC_CCM
          CCM_DPN: stimulus=SysTrig_1000msT0/CCM, response=SysTrig_1000msT0/DPN, segment=SysTrig_1000msT0/CCM_DPN
          DPN_End: stimulus=SysTrig_1000msT0/DPN, response=SysTrig_1000msT0/End, segment=SysTrig_1000msT0/DPN_End
          SysTrig_1000msT0:
            stimulus=SysTrig_1000msT0/Start
            response=SysTrig_1000msT0/End
            segment=[SysTrig_1000msT0/Start_SEV, SysTrig_1000msT0/SEV_ADI, SysTrig_1000msT0/ADI_CCI, SysTrig_1000msT0/CCI_SYV, SysTrig_1000msT0/SYV_POR, SysTrig_1000msT0/POR_CBS, SysTrig_1000msT0/CBS_CCS, SysTrig_1000msT0/CCS_CSC, SysTrig_1000msT0/CSC_ROS, SysTrig_1000msT0/ROS_PAD, SysTrig_1000msT0/PAD_PPC, SysTrig_1000msT0/PPC_CCM, SysTrig_1000msT0/CCM_DPN, SysTrig_1000msT0/DPN_End]
      timing-guarantees:
        latency timing constraint Deadline: latency-constraint-type=REACTION, scope=SysTrig_1000msT0, maximum={cse-code=0, cse-code-factor=500000}
      timing-requirements:
        periodic event triggering ActivationPattern: event=SysTrig_1000msT0/Start, period={cse-code=0, cse-code-factor=1000000}
    SysTrig_100msT1  # This is a periodic event with 100ms recurrence and 100ms deadline.
      timing-descriptions:
        15 x td event complex:
          Start
          SEV  # System Event Validation: Due to a delay between the detection of the system event and the execution of the system event implementation the conditions for the system event might disappear. In this case, runnables called after this phase can be informed or even skipped. Note: This phase is available on any event. Warning: This phase shall be used by the event producer only !
          ADI  # Acquisition and associated Diagnoses: Acquisitions (and diagnosis) have to be done early in the event in order to get the results ready for the complete event.
          CCI  # Cross-Checking of Inputs: Input data crosschecking, high level diagnostic and input limp home actions are performed.
          SYV  # SYstem Variables computation: System variables are computed based on ECU inputs to be used in a high number of functions.
          POR  # Preparation Of Requests: Request data are elaborated based on inputs, which need a lot of logics. A request is not subject to control loop.
          CBS  # Calculation of Basic Setpoints: Basic setpoints are calculated based on system variables and requests.
          CCS  # Calculation of Complex Setpoints: Complex setpoints are based on system variables, requests and other setpoints.
          CSC  # Calculation of Setpoint Corrections: Setpoint corrections are done to align them with other setpoints.
          ROS  # Realisation Of Setpoints: BSW is informed about new ASW data. Basically actuating of the HW is done here.
          PAD  # Post Acquisition of Data: Additional acquisitions which were not relevant until the ASW to BSW communication point are performed now.
          PPC  # Post Processing Calculations: Postprocessing is performed.
          CCM  # Calibration CoMmunication: Data are sent to the calibration and communication system.
          DPN  # Data Processing for Next cycle: Data needed for next event occurence or for other events are calculated. Computations that have no «internal deadline» are located here. The data produced here and consumed in the same event will have a delay of one period in the next occurence of the event.
          End
        15 x timing description event chain:
          Start_SEV: stimulus=SysTrig_100msT1/Start, response=SysTrig_100msT1/SEV, segment=SysTrig_100msT1/Start_SEV
          SEV_ADI: stimulus=SysTrig_100msT1/SEV, response=SysTrig_100msT1/ADI, segment=SysTrig_100msT1/SEV_ADI
          ADI_CCI: stimulus=SysTrig_100msT1/ADI, response=SysTrig_100msT1/CCI, segment=SysTrig_100msT1/ADI_CCI
          CCI_SYV: stimulus=SysTrig_100msT1/CCI, response=SysTrig_100msT1/SYV, segment=SysTrig_100msT1/CCI_SYV
          SYV_POR: stimulus=SysTrig_100msT1/SYV, response=SysTrig_100msT1/POR, segment=SysTrig_100msT1/SYV_POR
          POR_CBS: stimulus=SysTrig_100msT1/POR, response=SysTrig_100msT1/CBS, segment=SysTrig_100msT1/POR_CBS
          CBS_CCS: stimulus=SysTrig_100msT1/CBS, response=SysTrig_100msT1/CCS, segment=SysTrig_100msT1/CBS_CCS
          CCS_CSC: stimulus=SysTrig_100msT1/CCS, response=SysTrig_100msT1/CSC, segment=SysTrig_100msT1/CCS_CSC
          CSC_ROS: stimulus=SysTrig_100msT1/CSC, response=SysTrig_100msT1/ROS, segment=SysTrig_100msT1/CSC_ROS
          ROS_PAD: stimulus=SysTrig_100msT1/ROS, response=SysTrig_100msT1/PAD, segment=SysTrig_100msT1/ROS_PAD
          PAD_PPC: stimulus=SysTrig_100msT1/PAD, response=SysTrig_100msT1/PPC, segment=SysTrig_100msT1/PAD_PPC
          PPC_CCM: stimulus=SysTrig_100msT1/PPC, response=SysTrig_100msT1/CCM, segment=SysTrig_100msT1/PPC_CCM
          CCM_DPN: stimulus=SysTrig_100msT1/CCM, response=SysTrig_100msT1/DPN, segment=SysTrig_100msT1/CCM_DPN
          DPN_End: stimulus=SysTrig_100msT1/DPN, response=SysTrig_100msT1/End, segment=SysTrig_100msT1/DPN_End
          SysTrig_100msT1:
            stimulus=SysTrig_100msT1/Start
            response=SysTrig_100msT1/End
            segment=[SysTrig_100msT1/Start_SEV, SysTrig_100msT1/SEV_ADI, SysTrig_100msT1/ADI_CCI, SysTrig_100msT1/CCI_SYV, SysTrig_100msT1/SYV_POR, SysTrig_100msT1/POR_CBS, SysTrig_100msT1/CBS_CCS, SysTrig_100msT1/CCS_CSC, SysTrig_100msT1/CSC_ROS, SysTrig_100msT1/ROS_PAD, SysTrig_100msT1/PAD_PPC, SysTrig_100msT1/PPC_CCM, SysTrig_100msT1/CCM_DPN, SysTrig_100msT1/DPN_End]
      timing-guarantees:
        latency timing constraint Deadline: latency-constraint-type=REACTION, scope=SysTrig_100msT1, maximum={cse-code=0, cse-code-factor=100000}
      timing-requirements:
        periodic event triggering ActivationPattern: event=SysTrig_100msT1/Start, period={cse-code=0, cse-code-factor=100000}
    SysTrig_10msT0  # This is a periodic event with 10ms recurrence and a deadline shorter than 10ms.
      timing-descriptions:
        15 x td event complex:
          Start
          SEV  # System Event Validation: Due to a delay between the detection of the system event and the execution of the system event implementation the conditions for the system event might disappear. In this case, runnables called after this phase can be informed or even skipped. Note: This phase is available on any event. Warning: This phase shall be used by the event producer only !
          ADI  # Acquisition and associated Diagnoses: Acquisitions (and diagnosis) have to be done early in the event in order to get the results ready for the complete event.
          CCI  # Cross-Checking of Inputs: Input data crosschecking, high level diagnostic and input limp home actions are performed.
          SYV  # SYstem Variables computation: System variables are computed based on ECU inputs to be used in a high number of functions.
          POR  # Preparation Of Requests: Request data are elaborated based on inputs, which need a lot of logics. A request is not subject to control loop.
          CBS  # Calculation of Basic Setpoints: Basic setpoints are calculated based on system variables and requests.
          CCS  # Calculation of Complex Setpoints: Complex setpoints are based on system variables, requests and other setpoints.
          CSC  # Calculation of Setpoint Corrections: Setpoint corrections are done to align them with other setpoints.
          ROS  # Realisation Of Setpoints: BSW is informed about new ASW data. Basically actuating of the HW is done here.
          PAD  # Post Acquisition of Data: Additional acquisitions which were not relevant until the ASW to BSW communication point are performed now.
          PPC  # Post Processing Calculations: Postprocessing is performed.
          CCM  # Calibration CoMmunication: Data are sent to the calibration and communication system.
          DPN  # Data Processing for Next cycle: Data needed for next event occurence or for other events are calculated. Computations that have no «internal deadline» are located here. The data produced here and consumed in the same event will have a delay of one period in the next occurence of the event.
          End
        15 x timing description event chain:
          Start_SEV: stimulus=SysTrig_10msT0/Start, response=SysTrig_10msT0/SEV, segment=SysTrig_10msT0/Start_SEV
          SEV_ADI: stimulus=SysTrig_10msT0/SEV, response=SysTrig_10msT0/ADI, segment=SysTrig_10msT0/SEV_ADI
          ADI_CCI: stimulus=SysTrig_10msT0/ADI, response=SysTrig_10msT0/CCI, segment=SysTrig_10msT0/ADI_CCI
          CCI_SYV: stimulus=SysTrig_10msT0/CCI, response=SysTrig_10msT0/SYV, segment=SysTrig_10msT0/CCI_SYV
          SYV_POR: stimulus=SysTrig_10msT0/SYV, response=SysTrig_10msT0/POR, segment=SysTrig_10msT0/SYV_POR
          POR_CBS: stimulus=SysTrig_10msT0/POR, response=SysTrig_10msT0/CBS, segment=SysTrig_10msT0/POR_CBS
          CBS_CCS: stimulus=SysTrig_10msT0/CBS, response=SysTrig_10msT0/CCS, segment=SysTrig_10msT0/CBS_CCS
          CCS_CSC: stimulus=SysTrig_10msT0/CCS, response=SysTrig_10msT0/CSC, segment=SysTrig_10msT0/CCS_CSC
          CSC_ROS: stimulus=SysTrig_10msT0/CSC, response=SysTrig_10msT0/ROS, segment=SysTrig_10msT0/CSC_ROS
          ROS_PAD: stimulus=SysTrig_10msT0/ROS, response=SysTrig_10msT0/PAD, segment=SysTrig_10msT0/ROS_PAD
          PAD_PPC: stimulus=SysTrig_10msT0/PAD, response=SysTrig_10msT0/PPC, segment=SysTrig_10msT0/PAD_PPC
          PPC_CCM: stimulus=SysTrig_10msT0/PPC, response=SysTrig_10msT0/CCM, segment=SysTrig_10msT0/PPC_CCM
          CCM_DPN: stimulus=SysTrig_10msT0/CCM, response=SysTrig_10msT0/DPN, segment=SysTrig_10msT0/CCM_DPN
          DPN_End: stimulus=SysTrig_10msT0/DPN, response=SysTrig_10msT0/End, segment=SysTrig_10msT0/DPN_End
          SysTrig_10msT0:
            stimulus=SysTrig_10msT0/Start
            response=SysTrig_10msT0/End
            segment=[SysTrig_10msT0/Start_SEV, SysTrig_10msT0/SEV_ADI, SysTrig_10msT0/ADI_CCI, SysTrig_10msT0/CCI_SYV, SysTrig_10msT0/SYV_POR, SysTrig_10msT0/POR_CBS, SysTrig_10msT0/CBS_CCS, SysTrig_10msT0/CCS_CSC, SysTrig_10msT0/CSC_ROS, SysTrig_10msT0/ROS_PAD, SysTrig_10msT0/PAD_PPC, SysTrig_10msT0/PPC_CCM, SysTrig_10msT0/CCM_DPN, SysTrig_10msT0/DPN_End]
      timing-guarantees:
        latency timing constraint Deadline: latency-constraint-type=REACTION, scope=SysTrig_10msT0, maximum={cse-code=0, cse-code-factor=3000}
      timing-requirements:
        periodic event triggering ActivationPattern: event=SysTrig_10msT0/Start, period={cse-code=0, cse-code-factor=10000}
    SysTrig_10msT1  # This is a periodic event with 10ms recurrence and 10ms deadline.
      timing-descriptions:
        17 x td event complex:
          Start
          SEV  # System Event Validation: Due to a delay between the detection of the system event and the execution of the system event implementation the conditions for the system event might disappear. In this case, runnables called after this phase can be informed or even skipped. Note: This phase is available on any event. Warning: This phase shall be used by the event producer only !
          PST  # Preparation of System Transition: Acquisitions, related diagnoses and any computation needed to prepare the detection of a system transition are done.
          DST  # Detection of System Transition: Major system transitions are detected as soon as possible so that nominal computations benefit from the initialization, instead of being overwritten.
          ADI  # Acquisition and associated Diagnoses: Acquisitions (and diagnosis) have to be done early in the event in order to get the results ready for the complete event.
          CCI  # Cross-Checking of Inputs: Input data crosschecking, high level diagnostic and input limp home actions are performed.
          SYV  # SYstem Variables computation: System variables are computed based on ECU inputs to be used in a high number of functions.
          POR  # Preparation Of Requests: Request data are elaborated based on inputs, which need a lot of logics. A request is not subject to control loop.
          CBS  # Calculation of Basic Setpoints: Basic setpoints are calculated based on system variables and requests.
          CCS  # Calculation of Complex Setpoints: Complex setpoints are based on system variables, requests and other setpoints.
          CSC  # Calculation of Setpoint Corrections: Setpoint corrections are done to align them with other setpoints.
          ROS  # Realisation Of Setpoints: BSW is informed about new ASW data. Basically actuating of the HW is done here.
          PAD  # Post Acquisition of Data: Additional acquisitions which were not relevant until the ASW to BSW communication point are performed now.
          PPC  # Post Processing Calculations: Postprocessing is performed.
          CCM  # Calibration CoMmunication: Data are sent to the calibration and communication system.
          DPN  # Data Processing for Next cycle: Data needed for next event occurence or for other events are calculated. Computations that have no «internal deadline» are located here. The data produced here and consumed in the same event will have a delay of one period in the next occurence of the event.
          End
        17 x timing description event chain:
          Start_SEV: stimulus=SysTrig_10msT1/Start, response=SysTrig_10msT1/SEV, segment=SysTrig_10msT1/Start_SEV
          SEV_PST: stimulus=SysTrig_10msT1/SEV, response=SysTrig_10msT1/PST, segment=SysTrig_10msT1/SEV_PST
          PST_DST: stimulus=SysTrig_10msT1/PST, response=SysTrig_10msT1/DST, segment=SysTrig_10msT1/PST_DST
          DST_ADI: stimulus=SysTrig_10msT1/DST, response=SysTrig_10msT1/ADI, segment=SysTrig_10msT1/DST_ADI
          ADI_CCI: stimulus=SysTrig_10msT1/ADI, response=SysTrig_10msT1/CCI, segment=SysTrig_10msT1/ADI_CCI
          CCI_SYV: stimulus=SysTrig_10msT1/CCI, response=SysTrig_10msT1/SYV, segment=SysTrig_10msT1/CCI_SYV
          SYV_POR: stimulus=SysTrig_10msT1/SYV, response=SysTrig_10msT1/POR, segment=SysTrig_10msT1/SYV_POR
          POR_CBS: stimulus=SysTrig_10msT1/POR, response=SysTrig_10msT1/CBS, segment=SysTrig_10msT1/POR_CBS
          CBS_CCS: stimulus=SysTrig_10msT1/CBS, response=SysTrig_10msT1/CCS, segment=SysTrig_10msT1/CBS_CCS
          CCS_CSC: stimulus=SysTrig_10msT1/CCS, response=SysTrig_10msT1/CSC, segment=SysTrig_10msT1/CCS_CSC
          CSC_ROS: stimulus=SysTrig_10msT1/CSC, response=SysTrig_10msT1/ROS, segment=SysTrig_10msT1/CSC_ROS
          ROS_PAD: stimulus=SysTrig_10msT1/ROS, response=SysTrig_10msT1/PAD, segment=SysTrig_10msT1/ROS_PAD
          PAD_PPC: stimulus=SysTrig_10msT1/PAD, response=SysTrig_10msT1/PPC, segment=SysTrig_10msT1/PAD_PPC
          PPC_CCM: stimulus=SysTrig_10msT1/PPC, response=SysTrig_10msT1/CCM, segment=SysTrig_10msT1/PPC_CCM
          CCM_DPN: stimulus=SysTrig_10msT1/CCM, response=SysTrig_10msT1/DPN, segment=SysTrig_10msT1/CCM_DPN
          DPN_End: stimulus=SysTrig_10msT1/DPN, response=SysTrig_10msT1/End, segment=SysTrig_10msT1/DPN_End
          SysTrig_10msT1:
            stimulus=SysTrig_10msT1/Start
            response=SysTrig_10msT1/End
            segment=[SysTrig_10msT1/Start_SEV, SysTrig_10msT1/SEV_PST, SysTrig_10msT1/PST_DST, SysTrig_10msT1/DST_ADI, SysTrig_10msT1/ADI_CCI, SysTrig_10msT1/CCI_SYV, SysTrig_10msT1/SYV_POR, SysTrig_10msT1/POR_CBS, SysTrig_10msT1/CBS_CCS, SysTrig_10msT1/CCS_CSC, SysTrig_10msT1/CSC_ROS, SysTrig_10msT1/ROS_PAD, SysTrig_10msT1/PAD_PPC, SysTrig_10msT1/PPC_CCM, SysTrig_10msT1/CCM_DPN, SysTrig_10msT1/DPN_End]
      timing-guarantees:
        latency timing constraint Deadline: latency-constraint-type=REACTION, scope=SysTrig_10msT1, maximum={cse-code=0, cse-code-factor=10000}
      timing-requirements:
        periodic event triggering ActivationPattern: event=SysTrig_10msT1/Start, period={cse-code=0, cse-code-factor=10000}
    SysTrig_10msT2  # This is a periodic event with 10ms recurrence and a deadline greater than 10ms.
      timing-descriptions:
        15 x td event complex:
          Start
          SEV  # System Event Validation: Due to a delay between the detection of the system event and the execution of the system event implementation the conditions for the system event might disappear. In this case, runnables called after this phase can be informed or even skipped. Note: This phase is available on any event. Warning: This phase shall be used by the event producer only !
          ADI  # Acquisition and associated Diagnoses: Acquisitions (and diagnosis) have to be done early in the event in order to get the results ready for the complete event.
          CCI  # Cross-Checking of Inputs: Input data crosschecking, high level diagnostic and input limp home actions are performed.
          SYV  # SYstem Variables computation: System variables are computed based on ECU inputs to be used in a high number of functions.
          POR  # Preparation Of Requests: Request data are elaborated based on inputs, which need a lot of logics. A request is not subject to control loop.
          CBS  # Calculation of Basic Setpoints: Basic setpoints are calculated based on system variables and requests.
          CCS  # Calculation of Complex Setpoints: Complex setpoints are based on system variables, requests and other setpoints.
          CSC  # Calculation of Setpoint Corrections: Setpoint corrections are done to align them with other setpoints.
          ROS  # Realisation Of Setpoints: BSW is informed about new ASW data. Basically actuating of the HW is done here.
          PAD  # Post Acquisition of Data: Additional acquisitions which were not relevant until the ASW to BSW communication point are performed now.
          PPC  # Post Processing Calculations: Postprocessing is performed.
          CCM  # Calibration CoMmunication: Data are sent to the calibration and communication system.
          DPN  # Data Processing for Next cycle: Data needed for next event occurence or for other events are calculated. Computations that have no «internal deadline» are located here. The data produced here and consumed in the same event will have a delay of one period in the next occurence of the event.
          End
        15 x timing description event chain:
          Start_SEV: stimulus=SysTrig_10msT2/Start, response=SysTrig_10msT2/SEV, segment=SysTrig_10msT2/Start_SEV
          SEV_ADI: stimulus=SysTrig_10msT2/SEV, response=SysTrig_10msT2/ADI, segment=SysTrig_10msT2/SEV_ADI
          ADI_CCI: stimulus=SysTrig_10msT2/ADI, response=SysTrig_10msT2/CCI, segment=SysTrig_10msT2/ADI_CCI
          CCI_SYV: stimulus=SysTrig_10msT2/CCI, response=SysTrig_10msT2/SYV, segment=SysTrig_10msT2/CCI_SYV
          SYV_POR: stimulus=SysTrig_10msT2/SYV, response=SysTrig_10msT2/POR, segment=SysTrig_10msT2/SYV_POR
          POR_CBS: stimulus=SysTrig_10msT2/POR, response=SysTrig_10msT2/CBS, segment=SysTrig_10msT2/POR_CBS
          CBS_CCS: stimulus=SysTrig_10msT2/CBS, response=SysTrig_10msT2/CCS, segment=SysTrig_10msT2/CBS_CCS
          CCS_CSC: stimulus=SysTrig_10msT2/CCS, response=SysTrig_10msT2/CSC, segment=SysTrig_10msT2/CCS_CSC
          CSC_ROS: stimulus=SysTrig_10msT2/CSC, response=SysTrig_10msT2/ROS, segment=SysTrig_10msT2/CSC_ROS
          ROS_PAD: stimulus=SysTrig_10msT2/ROS, response=SysTrig_10msT2/PAD, segment=SysTrig_10msT2/ROS_PAD
          PAD_PPC: stimulus=SysTrig_10msT2/PAD, response=SysTrig_10msT2/PPC, segment=SysTrig_10msT2/PAD_PPC
          PPC_CCM: stimulus=SysTrig_10msT2/PPC, response=SysTrig_10msT2/CCM, segment=SysTrig_10msT2/PPC_CCM
          CCM_DPN: stimulus=SysTrig_10msT2/CCM, response=SysTrig_10msT2/DPN, segment=SysTrig_10msT2/CCM_DPN
          DPN_End: stimulus=SysTrig_10msT2/DPN, response=SysTrig_10msT2/End, segment=SysTrig_10msT2/DPN_End
          SysTrig_10msT2:
            stimulus=SysTrig_10msT2/Start
            response=SysTrig_10msT2/End
            segment=[SysTrig_10msT2/Start_SEV, SysTrig_10msT2/SEV_ADI, SysTrig_10msT2/ADI_CCI, SysTrig_10msT2/CCI_SYV, SysTrig_10msT2/SYV_POR, SysTrig_10msT2/POR_CBS, SysTrig_10msT2/CBS_CCS, SysTrig_10msT2/CCS_CSC, SysTrig_10msT2/CSC_ROS, SysTrig_10msT2/ROS_PAD, SysTrig_10msT2/PAD_PPC, SysTrig_10msT2/PPC_CCM, SysTrig_10msT2/CCM_DPN, SysTrig_10msT2/DPN_End]
      timing-guarantees:
        latency timing constraint Deadline: latency-constraint-type=REACTION, scope=SysTrig_10msT2, maximum={cse-code=0, cse-code-factor=20000}
      timing-requirements:
        periodic event triggering ActivationPattern: event=SysTrig_10msT2/Start, period={cse-code=0, cse-code-factor=10000}
    SysTrig_1msT0  # This is a periodic event with 1ms recurrence and a deadline shorter than 1ms.
      timing-descriptions:
        14 x td event complex:
          Start
          SEV  # System Event Validation: Due to a delay between the detection of the system event and the execution of the system event implementation the conditions for the system event might disappear. In this case, runnables called after this phase can be informed or even skipped. Note: This phase is available on any event. Warning: This phase shall be used by the event producer only !
          ADI  # Acquisition and associated Diagnoses: Acquisitions (and diagnosis) have to be done early in the event in order to get the results ready for the complete event.
          CCI  # Cross-Checking of Inputs: Input data crosschecking, high level diagnostic and input limp home actions are performed.
          SYV  # SYstem Variables computation: System variables are computed based on ECU inputs to be used in a high number of functions.
          POR  # Preparation Of Requests: Request data are elaborated based on inputs, which need a lot of logics. A request is not subject to control loop.
          CBS  # Calculation of Basic Setpoints: Basic setpoints are calculated based on system variables and requests.
          CCS  # Calculation of Complex Setpoints: Complex setpoints are based on system variables, requests and other setpoints.
          CSC  # Calculation of Setpoint Corrections: Setpoint corrections are done to align them with other setpoints.
          ROS  # Realisation Of Setpoints: BSW is informed about new ASW data. Basically actuating of the HW is done here.
          PAD  # Post Acquisition of Data: Additional acquisitions which were not relevant until the ASW to BSW communication point are performed now.
          PPC  # Post Processing Calculations: Postprocessing is performed.
          DPN  # Data Processing for Next cycle: Data needed for next event occurence or for other events are calculated. Computations that have no «internal deadline» are located here. The data produced here and consumed in the same event will have a delay of one period in the next occurence of the event.
          End
        14 x timing description event chain:
          Start_SEV: stimulus=SysTrig_1msT0/Start, response=SysTrig_1msT0/SEV, segment=SysTrig_1msT0/Start_SEV
          SEV_ADI: stimulus=SysTrig_1msT0/SEV, response=SysTrig_1msT0/ADI, segment=SysTrig_1msT0/SEV_ADI
          ADI_CCI: stimulus=SysTrig_1msT0/ADI, response=SysTrig_1msT0/CCI, segment=SysTrig_1msT0/ADI_CCI
          CCI_SYV: stimulus=SysTrig_1msT0/CCI, response=SysTrig_1msT0/SYV, segment=SysTrig_1msT0/CCI_SYV
          SYV_POR: stimulus=SysTrig_1msT0/SYV, response=SysTrig_1msT0/POR, segment=SysTrig_1msT0/SYV_POR
          POR_CBS: stimulus=SysTrig_1msT0/POR, response=SysTrig_1msT0/CBS, segment=SysTrig_1msT0/POR_CBS
          CBS_CCS: stimulus=SysTrig_1msT0/CBS, response=SysTrig_1msT0/CCS, segment=SysTrig_1msT0/CBS_CCS
          CCS_CSC: stimulus=SysTrig_1msT0/CCS, response=SysTrig_1msT0/CSC, segment=SysTrig_1msT0/CCS_CSC
          CSC_ROS: stimulus=SysTrig_1msT0/CSC, response=SysTrig_1msT0/ROS, segment=SysTrig_1msT0/CSC_ROS
          ROS_PAD: stimulus=SysTrig_1msT0/ROS, response=SysTrig_1msT0/PAD, segment=SysTrig_1msT0/ROS_PAD
          PAD_PPC: stimulus=SysTrig_1msT0/PAD, response=SysTrig_1msT0/PPC, segment=SysTrig_1msT0/PAD_PPC
          PPC_DPN: stimulus=SysTrig_1msT0/PPC, response=SysTrig_1msT0/DPN, segment=SysTrig_1msT0/PPC_DPN
          DPN_End: stimulus=SysTrig_1msT0/DPN, response=SysTrig_1msT0/End, segment=SysTrig_1msT0/DPN_End
          SysTrig_1msT0: stimulus=SysTrig_1msT0/Start, response=SysTrig_1msT0/End, segment=[SysTrig_1msT0/Start_SEV, SysTrig_1msT0/SEV_ADI, SysTrig_1msT0/ADI_CCI, SysTrig_1msT0/CCI_SYV, SysTrig_1msT0/SYV_POR, SysTrig_1msT0/POR_CBS, SysTrig_1msT0/CBS_CCS, SysTrig_1msT0/CCS_CSC, SysTrig_1msT0/CSC_ROS, SysTrig_1msT0/ROS_PAD, SysTrig_1msT0/PAD_PPC, SysTrig_1msT0/PPC_DPN, SysTrig_1msT0/DPN_End]
      timing-guarantees:
        latency timing constraint Deadline: latency-constraint-type=REACTION, scope=SysTrig_1msT0, maximum={cse-code=0, cse-code-factor=200}
      timing-requirements:
        periodic event triggering ActivationPattern: event=SysTrig_1msT0/Start, period={cse-code=0, cse-code-factor=1000}
    SysTrig_1msT1  # This is a periodic event with 1ms recurrence and 1ms deadline.
      timing-descriptions:
        14 x td event complex:
          Start
          SEV  # System Event Validation: Due to a delay between the detection of the system event and the execution of the system event implementation the conditions for the system event might disappear. In this case, runnables called after this phase can be informed or even skipped. Note: This phase is available on any event. Warning: This phase shall be used by the event producer only !
          ADI  # Acquisition and associated Diagnoses: Acquisitions (and diagnosis) have to be done early in the event in order to get the results ready for the complete event.
          CCI  # Cross-Checking of Inputs: Input data crosschecking, high level diagnostic and input limp home actions are performed.
          SYV  # SYstem Variables computation: System variables are computed based on ECU inputs to be used in a high number of functions.
          POR  # Preparation Of Requests: Request data are elaborated based on inputs, which need a lot of logics. A request is not subject to control loop.
          CBS  # Calculation of Basic Setpoints: Basic setpoints are calculated based on system variables and requests.
          CCS  # Calculation of Complex Setpoints: Complex setpoints are based on system variables, requests and other setpoints.
          CSC  # Calculation of Setpoint Corrections: Setpoint corrections are done to align them with other setpoints.
          ROS  # Realisation Of Setpoints: BSW is informed about new ASW data. Basically actuating of the HW is done here.
          PAD  # Post Acquisition of Data: Additional acquisitions which were not relevant until the ASW to BSW communication point are performed now.
          PPC  # Post Processing Calculations: Postprocessing is performed.
          DPN  # Data Processing for Next cycle: Data needed for next event occurence or for other events are calculated. Computations that have no «internal deadline» are located here. The data produced here and consumed in the same event will have a delay of one period in the next occurence of the event.
          End
        14 x timing description event chain:
          Start_SEV: stimulus=SysTrig_1msT1/Start, response=SysTrig_1msT1/SEV, segment=SysTrig_1msT1/Start_SEV
          SEV_ADI: stimulus=SysTrig_1msT1/SEV, response=SysTrig_1msT1/ADI, segment=SysTrig_1msT1/SEV_ADI
          ADI_CCI: stimulus=SysTrig_1msT1/ADI, response=SysTrig_1msT1/CCI, segment=SysTrig_1msT1/ADI_CCI
          CCI_SYV: stimulus=SysTrig_1msT1/CCI, response=SysTrig_1msT1/SYV, segment=SysTrig_1msT1/CCI_SYV
          SYV_POR: stimulus=SysTrig_1msT1/SYV, response=SysTrig_1msT1/POR, segment=SysTrig_1msT1/SYV_POR
          POR_CBS: stimulus=SysTrig_1msT1/POR, response=SysTrig_1msT1/CBS, segment=SysTrig_1msT1/POR_CBS
          CBS_CCS: stimulus=SysTrig_1msT1/CBS, response=SysTrig_1msT1/CCS, segment=SysTrig_1msT1/CBS_CCS
          CCS_CSC: stimulus=SysTrig_1msT1/CCS, response=SysTrig_1msT1/CSC, segment=SysTrig_1msT1/CCS_CSC
          CSC_ROS: stimulus=SysTrig_1msT1/CSC, response=SysTrig_1msT1/ROS, segment=SysTrig_1msT1/CSC_ROS
          ROS_PAD: stimulus=SysTrig_1msT1/ROS, response=SysTrig_1msT1/PAD, segment=SysTrig_1msT1/ROS_PAD
          PAD_PPC: stimulus=SysTrig_1msT1/PAD, response=SysTrig_1msT1/PPC, segment=SysTrig_1msT1/PAD_PPC
          PPC_DPN: stimulus=SysTrig_1msT1/PPC, response=SysTrig_1msT1/DPN, segment=SysTrig_1msT1/PPC_DPN
          DPN_End: stimulus=SysTrig_1msT1/DPN, response=SysTrig_1msT1/End, segment=SysTrig_1msT1/DPN_End
          SysTrig_1msT1: stimulus=SysTrig_1msT1/Start, response=SysTrig_1msT1/End, segment=[SysTrig_1msT1/Start_SEV, SysTrig_1msT1/SEV_ADI, SysTrig_1msT1/ADI_CCI, SysTrig_1msT1/CCI_SYV, SysTrig_1msT1/SYV_POR, SysTrig_1msT1/POR_CBS, SysTrig_1msT1/CBS_CCS, SysTrig_1msT1/CCS_CSC, SysTrig_1msT1/CSC_ROS, SysTrig_1msT1/ROS_PAD, SysTrig_1msT1/PAD_PPC, SysTrig_1msT1/PPC_DPN, SysTrig_1msT1/DPN_End]
      timing-guarantees:
        latency timing constraint Deadline: latency-constraint-type=REACTION, scope=SysTrig_1msT1, maximum={cse-code=0, cse-code-factor=1000}
      timing-requirements:
        periodic event triggering ActivationPattern: event=SysTrig_1msT1/Start, period={cse-code=0, cse-code-factor=1000}
    SysTrig_20msT1  # This is a periodic event with 20ms recurrence and 20ms deadline.
      timing-descriptions:
        15 x td event complex:
          Start
          SEV  # System Event Validation: Due to a delay between the detection of the system event and the execution of the system event implementation the conditions for the system event might disappear. In this case, runnables called after this phase can be informed or even skipped. Note: This phase is available on any event. Warning: This phase shall be used by the event producer only !
          ADI  # Acquisition and associated Diagnoses: Acquisitions (and diagnosis) have to be done early in the event in order to get the results ready for the complete event.
          CCI  # Cross-Checking of Inputs: Input data crosschecking, high level diagnostic and input limp home actions are performed.
          SYV  # SYstem Variables computation: System variables are computed based on ECU inputs to be used in a high number of functions.
          POR  # Preparation Of Requests: Request data are elaborated based on inputs, which need a lot of logics. A request is not subject to control loop.
          CBS  # Calculation of Basic Setpoints: Basic setpoints are calculated based on system variables and requests.
          CCS  # Calculation of Complex Setpoints: Complex setpoints are based on system variables, requests and other setpoints.
          CSC  # Calculation of Setpoint Corrections: Setpoint corrections are done to align them with other setpoints.
          ROS  # Realisation Of Setpoints: BSW is informed about new ASW data. Basically actuating of the HW is done here.
          PAD  # Post Acquisition of Data: Additional acquisitions which were not relevant until the ASW to BSW communication point are performed now.
          PPC  # Post Processing Calculations: Postprocessing is performed.
          CCM  # Calibration CoMmunication: Data are sent to the calibration and communication system.
          DPN  # Data Processing for Next cycle: Data needed for next event occurence or for other events are calculated. Computations that have no «internal deadline» are located here. The data produced here and consumed in the same event will have a delay of one period in the next occurence of the event.
          End
        15 x timing description event chain:
          Start_SEV: stimulus=SysTrig_20msT1/Start, response=SysTrig_20msT1/SEV, segment=SysTrig_20msT1/Start_SEV
          SEV_ADI: stimulus=SysTrig_20msT1/SEV, response=SysTrig_20msT1/ADI, segment=SysTrig_20msT1/SEV_ADI
          ADI_CCI: stimulus=SysTrig_20msT1/ADI, response=SysTrig_20msT1/CCI, segment=SysTrig_20msT1/ADI_CCI
          CCI_SYV: stimulus=SysTrig_20msT1/CCI, response=SysTrig_20msT1/SYV, segment=SysTrig_20msT1/CCI_SYV
          SYV_POR: stimulus=SysTrig_20msT1/SYV, response=SysTrig_20msT1/POR, segment=SysTrig_20msT1/SYV_POR
          POR_CBS: stimulus=SysTrig_20msT1/POR, response=SysTrig_20msT1/CBS, segment=SysTrig_20msT1/POR_CBS
          CBS_CCS: stimulus=SysTrig_20msT1/CBS, response=SysTrig_20msT1/CCS, segment=SysTrig_20msT1/CBS_CCS
          CCS_CSC: stimulus=SysTrig_20msT1/CCS, response=SysTrig_20msT1/CSC, segment=SysTrig_20msT1/CCS_CSC
          CSC_ROS: stimulus=SysTrig_20msT1/CSC, response=SysTrig_20msT1/ROS, segment=SysTrig_20msT1/CSC_ROS
          ROS_PAD: stimulus=SysTrig_20msT1/ROS, response=SysTrig_20msT1/PAD, segment=SysTrig_20msT1/ROS_PAD
          PAD_PPC: stimulus=SysTrig_20msT1/PAD, response=SysTrig_20msT1/PPC, segment=SysTrig_20msT1/PAD_PPC
          PPC_CCM: stimulus=SysTrig_20msT1/PPC, response=SysTrig_20msT1/CCM, segment=SysTrig_20msT1/PPC_CCM
          CCM_DPN: stimulus=SysTrig_20msT1/CCM, response=SysTrig_20msT1/DPN, segment=SysTrig_20msT1/CCM_DPN
          DPN_End: stimulus=SysTrig_20msT1/DPN, response=SysTrig_20msT1/End, segment=SysTrig_20msT1/DPN_End
          SysTrig_20msT1:
            stimulus=SysTrig_20msT1/Start
            response=SysTrig_20msT1/End
            segment=[SysTrig_20msT1/Start_SEV, SysTrig_20msT1/SEV_ADI, SysTrig_20msT1/ADI_CCI, SysTrig_20msT1/CCI_SYV, SysTrig_20msT1/SYV_POR, SysTrig_20msT1/POR_CBS, SysTrig_20msT1/CBS_CCS, SysTrig_20msT1/CCS_CSC, SysTrig_20msT1/CSC_ROS, SysTrig_20msT1/ROS_PAD, SysTrig_20msT1/PAD_PPC, SysTrig_20msT1/PPC_CCM, SysTrig_20msT1/CCM_DPN, SysTrig_20msT1/DPN_End]
      timing-guarantees:
        latency timing constraint Deadline: latency-constraint-type=REACTION, scope=SysTrig_20msT1, maximum={cse-code=0, cse-code-factor=20000}
      timing-requirements:
        periodic event triggering ActivationPattern: event=SysTrig_20msT1/Start, period={cse-code=0, cse-code-factor=20000}
    SysTrig_40msT1  # This is a periodic event with 40ms recurrence and 40ms deadline.
      timing-descriptions:
        15 x td event complex:
          Start
          SEV  # System Event Validation: Due to a delay between the detection of the system event and the execution of the system event implementation the conditions for the system event might disappear. In this case, runnables called after this phase can be informed or even skipped. Note: This phase is available on any event. Warning: This phase shall be used by the event producer only !
          ADI  # Acquisition and associated Diagnoses: Acquisitions (and diagnosis) have to be done early in the event in order to get the results ready for the complete event.
          CCI  # Cross-Checking of Inputs: Input data crosschecking, high level diagnostic and input limp home actions are performed.
          SYV  # SYstem Variables computation: System variables are computed based on ECU inputs to be used in a high number of functions.
          POR  # Preparation Of Requests: Request data are elaborated based on inputs, which need a lot of logics. A request is not subject to control loop.
          CBS  # Calculation of Basic Setpoints: Basic setpoints are calculated based on system variables and requests.
          CCS  # Calculation of Complex Setpoints: Complex setpoints are based on system variables, requests and other setpoints.
          CSC  # Calculation of Setpoint Corrections: Setpoint corrections are done to align them with other setpoints.
          ROS  # Realisation Of Setpoints: BSW is informed about new ASW data. Basically actuating of the HW is done here.
          PAD  # Post Acquisition of Data: Additional acquisitions which were not relevant until the ASW to BSW communication point are performed now.
          PPC  # Post Processing Calculations: Postprocessing is performed.
          CCM  # Calibration CoMmunication: Data are sent to the calibration and communication system.
          DPN  # Data Processing for Next cycle: Data needed for next event occurence or for other events are calculated. Computations that have no «internal deadline» are located here. The data produced here and consumed in the same event will have a delay of one period in the next occurence of the event.
          End
        15 x timing description event chain:
          Start_SEV: stimulus=SysTrig_40msT1/Start, response=SysTrig_40msT1/SEV, segment=SysTrig_40msT1/Start_SEV
          SEV_ADI: stimulus=SysTrig_40msT1/SEV, response=SysTrig_40msT1/ADI, segment=SysTrig_40msT1/SEV_ADI
          ADI_CCI: stimulus=SysTrig_40msT1/ADI, response=SysTrig_40msT1/CCI, segment=SysTrig_40msT1/ADI_CCI
          CCI_SYV: stimulus=SysTrig_40msT1/CCI, response=SysTrig_40msT1/SYV, segment=SysTrig_40msT1/CCI_SYV
          SYV_POR: stimulus=SysTrig_40msT1/SYV, response=SysTrig_40msT1/POR, segment=SysTrig_40msT1/SYV_POR
          POR_CBS: stimulus=SysTrig_40msT1/POR, response=SysTrig_40msT1/CBS, segment=SysTrig_40msT1/POR_CBS
          CBS_CCS: stimulus=SysTrig_40msT1/CBS, response=SysTrig_40msT1/CCS, segment=SysTrig_40msT1/CBS_CCS
          CCS_CSC: stimulus=SysTrig_40msT1/CCS, response=SysTrig_40msT1/CSC, segment=SysTrig_40msT1/CCS_CSC
          CSC_ROS: stimulus=SysTrig_40msT1/CSC, response=SysTrig_40msT1/ROS, segment=SysTrig_40msT1/CSC_ROS
          ROS_PAD: stimulus=SysTrig_40msT1/ROS, response=SysTrig_40msT1/PAD, segment=SysTrig_40msT1/ROS_PAD
          PAD_PPC: stimulus=SysTrig_40msT1/PAD, response=SysTrig_40msT1/PPC, segment=SysTrig_40msT1/PAD_PPC
          PPC_CCM: stimulus=SysTrig_40msT1/PPC, response=SysTrig_40msT1/CCM, segment=SysTrig_40msT1/PPC_CCM
          CCM_DPN: stimulus=SysTrig_40msT1/CCM, response=SysTrig_40msT1/DPN, segment=SysTrig_40msT1/CCM_DPN
          DPN_End: stimulus=SysTrig_40msT1/DPN, response=SysTrig_40msT1/End, segment=SysTrig_40msT1/DPN_End
          SysTrig_40msT1:
            stimulus=SysTrig_40msT1/Start
            response=SysTrig_40msT1/End
            segment=[SysTrig_40msT1/Start_SEV, SysTrig_40msT1/SEV_ADI, SysTrig_40msT1/ADI_CCI, SysTrig_40msT1/CCI_SYV, SysTrig_40msT1/SYV_POR, SysTrig_40msT1/POR_CBS, SysTrig_40msT1/CBS_CCS, SysTrig_40msT1/CCS_CSC, SysTrig_40msT1/CSC_ROS, SysTrig_40msT1/ROS_PAD, SysTrig_40msT1/PAD_PPC, SysTrig_40msT1/PPC_CCM, SysTrig_40msT1/CCM_DPN, SysTrig_40msT1/DPN_End]
      timing-guarantees:
        latency timing constraint Deadline: latency-constraint-type=REACTION, scope=SysTrig_40msT1, maximum={cse-code=0, cse-code-factor=40000}
      timing-requirements:
        periodic event triggering ActivationPattern: event=SysTrig_40msT1/Start, period={cse-code=0, cse-code-factor=40000}
    SysTrig_50usT1  # This is a periodic event with 50us recurrence and 50us deadline.
      timing-descriptions:
        14 x td event complex:
          Start
          SEV  # System Event Validation: Due to a delay between the detection of the system event and the execution of the system event implementation the conditions for the system event might disappear. In this case, runnables called after this phase can be informed or even skipped. Note: This phase is available on any event. Warning: This phase shall be used by the event producer only !
          ADI  # Acquisition and associated Diagnoses: Acquisitions (and diagnosis) have to be done early in the event in order to get the results ready for the complete event.
          CCI  # Cross-Checking of Inputs: Input data crosschecking, high level diagnostic and input limp home actions are performed.
          SYV  # SYstem Variables computation: System variables are computed based on ECU inputs to be used in a high number of functions.
          POR  # Preparation Of Requests: Request data are elaborated based on inputs, which need a lot of logics. A request is not subject to control loop.
          CBS  # Calculation of Basic Setpoints: Basic setpoints are calculated based on system variables and requests.
          CCS  # Calculation of Complex Setpoints: Complex setpoints are based on system variables, requests and other setpoints.
          CSC  # Calculation of Setpoint Corrections: Setpoint corrections are done to align them with other setpoints.
          ROS  # Realisation Of Setpoints: BSW is informed about new ASW data. Basically actuating of the HW is done here.
          PAD  # Post Acquisition of Data: Additional acquisitions which were not relevant until the ASW to BSW communication point are performed now.
          PPC  # Post Processing Calculations: Postprocessing is performed.
          DPN  # Data Processing for Next cycle: Data needed for next event occurence or for other events are calculated. Computations that have no «internal deadline» are located here. The data produced here and consumed in the same event will have a delay of one period in the next occurence of the event.
          End
        14 x timing description event chain:
          Start_SEV: stimulus=SysTrig_50usT1/Start, response=SysTrig_50usT1/SEV, segment=SysTrig_50usT1/Start_SEV
          SEV_ADI: stimulus=SysTrig_50usT1/SEV, response=SysTrig_50usT1/ADI, segment=SysTrig_50usT1/SEV_ADI
          ADI_CCI: stimulus=SysTrig_50usT1/ADI, response=SysTrig_50usT1/CCI, segment=SysTrig_50usT1/ADI_CCI
          CCI_SYV: stimulus=SysTrig_50usT1/CCI, response=SysTrig_50usT1/SYV, segment=SysTrig_50usT1/CCI_SYV
          SYV_POR: stimulus=SysTrig_50usT1/SYV, response=SysTrig_50usT1/POR, segment=SysTrig_50usT1/SYV_POR
          POR_CBS: stimulus=SysTrig_50usT1/POR, response=SysTrig_50usT1/CBS, segment=SysTrig_50usT1/POR_CBS
          CBS_CCS: stimulus=SysTrig_50usT1/CBS, response=SysTrig_50usT1/CCS, segment=SysTrig_50usT1/CBS_CCS
          CCS_CSC: stimulus=SysTrig_50usT1/CCS, response=SysTrig_50usT1/CSC, segment=SysTrig_50usT1/CCS_CSC
          CSC_ROS: stimulus=SysTrig_50usT1/CSC, response=SysTrig_50usT1/ROS, segment=SysTrig_50usT1/CSC_ROS
          ROS_PAD: stimulus=SysTrig_50usT1/ROS, response=SysTrig_50usT1/PAD, segment=SysTrig_50usT1/ROS_PAD
          PAD_PPC: stimulus=SysTrig_50usT1/PAD, response=SysTrig_50usT1/PPC, segment=SysTrig_50usT1/PAD_PPC
          PPC_DPN: stimulus=SysTrig_50usT1/PPC, response=SysTrig_50usT1/DPN, segment=SysTrig_50usT1/PPC_DPN
          DPN_End: stimulus=SysTrig_50usT1/DPN, response=SysTrig_50usT1/End, segment=SysTrig_50usT1/DPN_End
          SysTrig_50usT1: stimulus=SysTrig_50usT1/Start, response=SysTrig_50usT1/End, segment=[SysTrig_50usT1/Start_SEV, SysTrig_50usT1/SEV_ADI, SysTrig_50usT1/ADI_CCI, SysTrig_50usT1/CCI_SYV, SysTrig_50usT1/SYV_POR, SysTrig_50usT1/POR_CBS, SysTrig_50usT1/CBS_CCS, SysTrig_50usT1/CCS_CSC, SysTrig_50usT1/CSC_ROS, SysTrig_50usT1/ROS_PAD, SysTrig_50usT1/PAD_PPC, SysTrig_50usT1/PPC_DPN, SysTrig_50usT1/DPN_End]
      timing-guarantees:
        latency timing constraint Deadline: latency-constraint-type=REACTION, scope=SysTrig_50usT1, maximum={cse-code=0, cse-code-factor=50}
      timing-requirements:
        periodic event triggering ActivationPattern: event=SysTrig_50usT1/Start, period={cse-code=0, cse-code-factor=50}
    SysTrig_5msSftyT0  # This event is specific for safety monitoring functionality. It is required because of the very early start of the function during start-up phase for pre-drive check.
      timing-descriptions:
        6 x td event complex:
          Start
          SEV  # System Event Validation: Due to a delay between the detection of the system event and the execution of the system event implementation the conditions for the system event might disappear. In this case, runnables called after this phase can be informed or even skipped. Note: This phase is available on any event. Warning: This phase shall be used by the event producer only !
          ADI  # Acquisition and associated Diagnoses: Acquisitions (and diagnosis) have to be done early in the event in order to get the results ready for the complete event.
          CCI  # Cross-Checking of Inputs: Input data crosschecking, high level diagnostic and input limp home actions are performed.
          DPN  # Data Processing for Next cycle: Data needed for next event occurence or for other events are calculated. Computations that have no «internal deadline» are located here. The data produced here and consumed in the same event will have a delay of one period in the next occurence of the event.
          End
        6 x timing description event chain:
          Start_SEV: stimulus=SysTrig_5msSftyT0/Start, response=SysTrig_5msSftyT0/SEV, segment=SysTrig_5msSftyT0/Start_SEV
          SEV_ADI: stimulus=SysTrig_5msSftyT0/SEV, response=SysTrig_5msSftyT0/ADI, segment=SysTrig_5msSftyT0/SEV_ADI
          ADI_CCI: stimulus=SysTrig_5msSftyT0/ADI, response=SysTrig_5msSftyT0/CCI, segment=SysTrig_5msSftyT0/ADI_CCI
          CCI_DPN: stimulus=SysTrig_5msSftyT0/CCI, response=SysTrig_5msSftyT0/DPN, segment=CCI_DPN
          DPN_End: stimulus=SysTrig_5msSftyT0/DPN, response=SysTrig_5msSftyT0/End, segment=SysTrig_5msSftyT0/DPN_End
          SysTrig_5msSftyT0: stimulus=SysTrig_5msSftyT0/Start, response=SysTrig_5msSftyT0/End, segment=[SysTrig_5msSftyT0/Start_SEV, SysTrig_5msSftyT0/SEV_ADI, SysTrig_5msSftyT0/ADI_CCI, CCI_DPN, SysTrig_5msSftyT0/DPN_End]
      timing-guarantees:
        latency timing constraint Deadline: latency-constraint-type=REACTION, scope=SysTrig_5msSftyT0, maximum={cse-code=0, cse-code-factor=3000}
      timing-requirements:
        periodic event triggering ActivationPattern: event=SysTrig_5msSftyT0/Start, period={cse-code=0, cse-code-factor=5000}
    SysTrig_5msT1  # This is a periodic event with 5ms recurrence and 5ms deadline.
      timing-descriptions:
        17 x td event complex:
          Start
          SEV  # System Event Validation: Due to a delay between the detection of the system event and the execution of the system event implementation the conditions for the system event might disappear. In this case, runnables called after this phase can be informed or even skipped. Note: This phase is available on any event. Warning: This phase shall be used by the event producer only !
          PST  # Preparation of System Transition: Acquisitions, related diagnoses and any computation needed to prepare the detection of a system transition are done.
          DST  # Detection of System Transition: Major system transitions are detected as soon as possible so that nominal computations benefit from the initialization, instead of being overwritten.
          ADI  # Acquisition and associated Diagnoses: Acquisitions (and diagnosis) have to be done early in the event in order to get the results ready for the complete event.
          CCI  # Cross-Checking of Inputs: Input data crosschecking, high level diagnostic and input limp home actions are performed.
          SYV  # SYstem Variables computation: System variables are computed based on ECU inputs to be used in a high number of functions.
          POR  # Preparation Of Requests: Request data are elaborated based on inputs, which need a lot of logics. A request is not subject to control loop.
          CBS  # Calculation of Basic Setpoints: Basic setpoints are calculated based on system variables and requests.
          CCS  # Calculation of Complex Setpoints: Complex setpoints are based on system variables, requests and other setpoints.
          CSC  # Calculation of Setpoint Corrections: Setpoint corrections are done to align them with other setpoints.
          ROS  # Realisation Of Setpoints: BSW is informed about new ASW data. Basically actuating of the HW is done here.
          PAD  # Post Acquisition of Data: Additional acquisitions which were not relevant until the ASW to BSW communication point are performed now.
          PPC  # Post Processing Calculations: Postprocessing is performed.
          CCM  # Calibration CoMmunication: Data are sent to the calibration and communication system.
          DPN  # Data Processing for Next cycle: Data needed for next event occurence or for other events are calculated. Computations that have no «internal deadline» are located here. The data produced here and consumed in the same event will have a delay of one period in the next occurence of the event.
          End
        17 x timing description event chain:
          Start_SEV: stimulus=SysTrig_5msT1/Start, response=SysTrig_5msT1/SEV, segment=SysTrig_5msT1/Start_SEV
          SEV_PST: stimulus=SysTrig_5msT1/SEV, response=SysTrig_5msT1/PST, segment=SysTrig_5msT1/SEV_PST
          PST_DST: stimulus=SysTrig_5msT1/PST, response=SysTrig_5msT1/DST, segment=SysTrig_5msT1/PST_DST
          DST_ADI: stimulus=SysTrig_5msT1/DST, response=SysTrig_5msT1/ADI, segment=SysTrig_5msT1/DST_ADI
          ADI_CCI: stimulus=SysTrig_5msT1/ADI, response=SysTrig_5msT1/CCI, segment=SysTrig_5msT1/ADI_CCI
          CCI_SYV: stimulus=SysTrig_5msT1/CCI, response=SysTrig_5msT1/SYV, segment=SysTrig_5msT1/CCI_SYV
          SYV_POR: stimulus=SysTrig_5msT1/SYV, response=SysTrig_5msT1/POR, segment=SysTrig_5msT1/SYV_POR
          POR_CBS: stimulus=SysTrig_5msT1/POR, response=SysTrig_5msT1/CBS, segment=SysTrig_5msT1/POR_CBS
          CBS_CCS: stimulus=SysTrig_5msT1/CBS, response=SysTrig_5msT1/CCS, segment=SysTrig_5msT1/CBS_CCS
          CCS_CSC: stimulus=SysTrig_5msT1/CCS, response=SysTrig_5msT1/CSC, segment=SysTrig_5msT1/CCS_CSC
          CSC_ROS: stimulus=SysTrig_5msT1/CSC, response=SysTrig_5msT1/ROS, segment=SysTrig_5msT1/CSC_ROS
          ROS_PAD: stimulus=SysTrig_5msT1/ROS, response=SysTrig_5msT1/PAD, segment=SysTrig_5msT1/ROS_PAD
          PAD_PPC: stimulus=SysTrig_5msT1/PAD, response=SysTrig_5msT1/PPC, segment=SysTrig_5msT1/PAD_PPC
          PPC_CCM: stimulus=SysTrig_5msT1/PPC, response=SysTrig_5msT1/CCM, segment=SysTrig_5msT1/PPC_CCM
          CCM_DPN: stimulus=SysTrig_5msT1/CCM, response=SysTrig_5msT1/DPN, segment=SysTrig_5msT1/CCM_DPN
          DPN_End: stimulus=SysTrig_5msT1/DPN, response=SysTrig_5msT1/End, segment=SysTrig_5msT1/DPN_End
          SysTrig_5msT1:
            stimulus=SysTrig_5msT1/Start
            response=SysTrig_5msT1/End
            segment=[SysTrig_5msT1/Start_SEV, SysTrig_5msT1/SEV_PST, SysTrig_5msT1/PST_DST, SysTrig_5msT1/DST_ADI, SysTrig_5msT1/ADI_CCI, SysTrig_5msT1/CCI_SYV, SysTrig_5msT1/SYV_POR, SysTrig_5msT1/POR_CBS, SysTrig_5msT1/CBS_CCS, SysTrig_5msT1/CCS_CSC, SysTrig_5msT1/CSC_ROS, SysTrig_5msT1/ROS_PAD, SysTrig_5msT1/PAD_PPC, SysTrig_5msT1/PPC_CCM, SysTrig_5msT1/CCM_DPN, SysTrig_5msT1/DPN_End]
      timing-guarantees:
        latency timing constraint Deadline: latency-constraint-type=REACTION, scope=SysTrig_5msT1, maximum={cse-code=0, cse-code-factor=5000}
      timing-requirements:
        periodic event triggering ActivationPattern: event=SysTrig_5msT1/Start, period={cse-code=0, cse-code-factor=5000}
    SysTrig_5msT2  # This is a periodic event with 5ms recurrence and a deadline greater than 5ms.
      timing-descriptions:
        15 x td event complex:
          Start
          SEV  # System Event Validation: Due to a delay between the detection of the system event and the execution of the system event implementation the conditions for the system event might disappear. In this case, runnables called after this phase can be informed or even skipped. Note: This phase is available on any event. Warning: This phase shall be used by the event producer only !
          ADI  # Acquisition and associated Diagnoses: Acquisitions (and diagnosis) have to be done early in the event in order to get the results ready for the complete event.
          CCI  # Cross-Checking of Inputs: Input data crosschecking, high level diagnostic and input limp home actions are performed.
          SYV  # SYstem Variables computation: System variables are computed based on ECU inputs to be used in a high number of functions.
          POR  # Preparation Of Requests: Request data are elaborated based on inputs, which need a lot of logics. A request is not subject to control loop.
          CBS  # Calculation of Basic Setpoints: Basic setpoints are calculated based on system variables and requests.
          CCS  # Calculation of Complex Setpoints: Complex setpoints are based on system variables, requests and other setpoints.
          CSC  # Calculation of Setpoint Corrections: Setpoint corrections are done to align them with other setpoints.
          ROS  # Realisation Of Setpoints: BSW is informed about new ASW data. Basically actuating of the HW is done here.
          PAD  # Post Acquisition of Data: Additional acquisitions which were not relevant until the ASW to BSW communication point are performed now.
          PPC  # Post Processing Calculations: Postprocessing is performed.
          CCM  # Calibration CoMmunication: Data are sent to the calibration and communication system.
          DPN  # Data Processing for Next cycle: Data needed for next event occurence or for other events are calculated. Computations that have no «internal deadline» are located here. The data produced here and consumed in the same event will have a delay of one period in the next occurence of the event.
          End
        15 x timing description event chain:
          Start_SEV: stimulus=SysTrig_5msT2/Start, response=SysTrig_5msT2/SEV, segment=SysTrig_5msT2/Start_SEV
          SEV_ADI: stimulus=SysTrig_5msT2/SEV, response=SysTrig_5msT2/ADI, segment=SysTrig_5msT2/SEV_ADI
          ADI_CCI: stimulus=SysTrig_5msT2/ADI, response=SysTrig_5msT2/CCI, segment=SysTrig_5msT2/ADI_CCI
          CCI_SYV: stimulus=SysTrig_5msT2/CCI, response=SysTrig_5msT2/SYV, segment=SysTrig_5msT2/CCI_SYV
          SYV_POR: stimulus=SysTrig_5msT2/SYV, response=SysTrig_5msT2/POR, segment=SysTrig_5msT2/SYV_POR
          POR_CBS: stimulus=SysTrig_5msT2/POR, response=SysTrig_5msT2/CBS, segment=SysTrig_5msT2/POR_CBS
          CBS_CCS: stimulus=SysTrig_5msT2/CBS, response=SysTrig_5msT2/CCS, segment=SysTrig_5msT2/CBS_CCS
          CCS_CSC: stimulus=SysTrig_5msT2/CCS, response=SysTrig_5msT2/CSC, segment=SysTrig_5msT2/CCS_CSC
          CSC_ROS: stimulus=SysTrig_5msT2/CSC, response=SysTrig_5msT2/ROS, segment=SysTrig_5msT2/CSC_ROS
          ROS_PAD: stimulus=SysTrig_5msT2/ROS, response=SysTrig_5msT2/PAD, segment=SysTrig_5msT2/ROS_PAD
          PAD_PPC: stimulus=SysTrig_5msT2/PAD, response=SysTrig_5msT2/PPC, segment=SysTrig_5msT2/PAD_PPC
          PPC_CCM: stimulus=SysTrig_5msT2/PPC, response=SysTrig_5msT2/CCM, segment=SysTrig_5msT2/PPC_CCM
          CCM_DPN: stimulus=SysTrig_5msT2/CCM, response=SysTrig_5msT2/DPN, segment=SysTrig_5msT2/CCM_DPN
          DPN_End: stimulus=SysTrig_5msT2/DPN, response=SysTrig_5msT2/End, segment=SysTrig_5msT2/DPN_End
          SysTrig_5msT2: stimulus=SysTrig_5msT2/Start, response=SysTrig_5msT2/End, segment=[SysTrig_5msT2/Start_SEV, SysTrig_5msT2/SEV_ADI, SysTrig_5msT2/ADI_CCI, SysTrig_5msT2/CCI_SYV, SysTrig_5msT2/SYV_POR, SysTrig_5msT2/POR_CBS, SysTrig_5msT2/CBS_CCS, SysTrig_5msT2/CCS_CSC, SysTrig_5msT2/CSC_ROS, SysTrig_5msT2/ROS_PAD, SysTrig_5msT2/PAD_PPC, SysTrig_5msT2/PPC_CCM, SysTrig_5msT2/CCM_DPN, SysTrig_5msT2/DPN_End]
      timing-guarantees:
        latency timing constraint Deadline: latency-constraint-type=REACTION, scope=SysTrig_5msT2, maximum={cse-code=0, cse-code-factor=10000}
      timing-requirements:
        periodic event triggering ActivationPattern: event=SysTrig_5msT2/Start, period={cse-code=0, cse-code-factor=5000}
    SysTrig_AngFlexCmbE0  # This is an engine position dependent event with flexible angular period and offset related to TDC0. It will be fired frequently (small period) at low engine speed. With increasing engine speed the period will also increase to meet the deadline and reduce CPU load.
      timing-descriptions:
        14 x td event complex:
          Start
          SEV  # System Event Validation: Due to a delay between the detection of the system event and the execution of the system event implementation the conditions for the system event might disappear. In this case, runnables called after this phase can be informed or even skipped. Note: This phase is available on any event. Warning: This phase shall be used by the event producer only !
          ADI  # Acquisition and associated Diagnoses: Acquisitions (and diagnosis) have to be done early in the event in order to get the results ready for the complete event.
          CCI  # Cross-Checking of Inputs: Input data crosschecking, high level diagnostic and input limp home actions are performed.
          SYV  # SYstem Variables computation: System variables are computed based on ECU inputs to be used in a high number of functions.
          POR  # Preparation Of Requests: Request data are elaborated based on inputs, which need a lot of logics. A request is not subject to control loop.
          CBS  # Calculation of Basic Setpoints: Basic setpoints are calculated based on system variables and requests.
          CCS  # Calculation of Complex Setpoints: Complex setpoints are based on system variables, requests and other setpoints.
          CSC  # Calculation of Setpoint Corrections: Setpoint corrections are done to align them with other setpoints.
          ROS  # Realisation Of Setpoints: BSW is informed about new ASW data. Basically actuating of the HW is done here.
          PAD  # Post Acquisition of Data: Additional acquisitions which were not relevant until the ASW to BSW communication point are performed now.
          CCM  # Calibration CoMmunication: Data are sent to the calibration and communication system.
          DPN  # Data Processing for Next cycle: Data needed for next event occurence or for other events are calculated. Computations that have no «internal deadline» are located here. The data produced here and consumed in the same event will have a delay of one period in the next occurence of the event.
          End
        14 x timing description event chain:
          Start_SEV: stimulus=SysTrig_AngFlexCmbE0/Start, response=SysTrig_AngFlexCmbE0/SEV, segment=SysTrig_AngFlexCmbE0/Start_SEV
          SEV_ADI: stimulus=SysTrig_AngFlexCmbE0/SEV, response=SysTrig_AngFlexCmbE0/ADI, segment=SysTrig_AngFlexCmbE0/SEV_ADI
          ADI_CCI: stimulus=SysTrig_AngFlexCmbE0/ADI, response=SysTrig_AngFlexCmbE0/CCI, segment=SysTrig_AngFlexCmbE0/ADI_CCI
          CCI_SYV: stimulus=SysTrig_AngFlexCmbE0/CCI, response=SysTrig_AngFlexCmbE0/SYV, segment=SysTrig_AngFlexCmbE0/CCI_SYV
          SYV_POR: stimulus=SysTrig_AngFlexCmbE0/SYV, response=SysTrig_AngFlexCmbE0/POR, segment=SysTrig_AngFlexCmbE0/SYV_POR
          POR_CBS: stimulus=SysTrig_AngFlexCmbE0/POR, response=SysTrig_AngFlexCmbE0/CBS, segment=SysTrig_AngFlexCmbE0/POR_CBS
          CBS_CCS: stimulus=SysTrig_AngFlexCmbE0/CBS, response=SysTrig_AngFlexCmbE0/CCS, segment=SysTrig_AngFlexCmbE0/CBS_CCS
          CCS_CSC: stimulus=SysTrig_AngFlexCmbE0/CCS, response=SysTrig_AngFlexCmbE0/CSC, segment=SysTrig_AngFlexCmbE0/CCS_CSC
          CSC_ROS: stimulus=SysTrig_AngFlexCmbE0/CSC, response=SysTrig_AngFlexCmbE0/ROS, segment=SysTrig_AngFlexCmbE0/CSC_ROS
          ROS_PAD: stimulus=SysTrig_AngFlexCmbE0/ROS, response=SysTrig_AngFlexCmbE0/PAD, segment=SysTrig_AngFlexCmbE0/ROS_PAD
          PAD_CCM: stimulus=SysTrig_AngFlexCmbE0/PAD, response=SysTrig_AngFlexCmbE0/CCM, segment=PAD_CCM
          CCM_DPN: stimulus=SysTrig_AngFlexCmbE0/CCM, response=SysTrig_AngFlexCmbE0/DPN, segment=SysTrig_AngFlexCmbE0/CCM_DPN
          DPN_End: stimulus=SysTrig_AngFlexCmbE0/DPN, response=SysTrig_AngFlexCmbE0/End, segment=SysTrig_AngFlexCmbE0/DPN_End
          SysTrig_AngFlexCmbE0:
            stimulus=SysTrig_AngFlexCmbE0/Start
            response=SysTrig_AngFlexCmbE0/End
            segment=[SysTrig_AngFlexCmbE0/Start_SEV, SysTrig_AngFlexCmbE0/SEV_ADI, SysTrig_AngFlexCmbE0/ADI_CCI, SysTrig_AngFlexCmbE0/CCI_SYV, SysTrig_AngFlexCmbE0/SYV_POR, SysTrig_AngFlexCmbE0/POR_CBS, SysTrig_AngFlexCmbE0/CBS_CCS, SysTrig_AngFlexCmbE0/CCS_CSC, SysTrig_AngFlexCmbE0/CSC_ROS, SysTrig_AngFlexCmbE0/ROS_PAD, PAD_CCM, SysTrig_AngFlexCmbE0/CCM_DPN, SysTrig_AngFlexCmbE0/DPN_End]
      timing-guarantees:
        latency timing constraint Deadline: latency-constraint-type=REACTION, scope=SysTrig_AngFlexCmbE0, maximum={cse-code=0, cse-code-factor=1000}
      timing-requirements:
        sporadic event triggering ActivationPattern: event=SysTrig_AngFlexCmbE0/Start, minimum-inter-arrival-time={cse-code=0, cse-code-factor=5000}, maximum-inter-arrival-time={cse-code=0, cse-code-factor=20000}
    SysTrig_CamEx1E1  # This is an engine dependent event with the camshaft signal recurrence of exhaust bank 1. The camshaft event period depends on the camshaft target wheel.
      timing-descriptions:
        14 x td event complex:
          Start
          SEV  # System Event Validation: Due to a delay between the detection of the system event and the execution of the system event implementation the conditions for the system event might disappear. In this case, runnables called after this phase can be informed or even skipped. Note: This phase is available on any event. Warning: This phase shall be used by the event producer only !
          ADI  # Acquisition and associated Diagnoses: Acquisitions (and diagnosis) have to be done early in the event in order to get the results ready for the complete event.
          CCI  # Cross-Checking of Inputs: Input data crosschecking, high level diagnostic and input limp home actions are performed.
          SYV  # SYstem Variables computation: System variables are computed based on ECU inputs to be used in a high number of functions.
          POR  # Preparation Of Requests: Request data are elaborated based on inputs, which need a lot of logics. A request is not subject to control loop.
          CBS  # Calculation of Basic Setpoints: Basic setpoints are calculated based on system variables and requests.
          CCS  # Calculation of Complex Setpoints: Complex setpoints are based on system variables, requests and other setpoints.
          CSC  # Calculation of Setpoint Corrections: Setpoint corrections are done to align them with other setpoints.
          ROS  # Realisation Of Setpoints: BSW is informed about new ASW data. Basically actuating of the HW is done here.
          PAD  # Post Acquisition of Data: Additional acquisitions which were not relevant until the ASW to BSW communication point are performed now.
          PPC  # Post Processing Calculations: Postprocessing is performed.
          DPN  # Data Processing for Next cycle: Data needed for next event occurence or for other events are calculated. Computations that have no «internal deadline» are located here. The data produced here and consumed in the same event will have a delay of one period in the next occurence of the event.
          End
        14 x timing description event chain:
          Start_SEV: stimulus=SysTrig_CamEx1E1/Start, response=SysTrig_CamEx1E1/SEV, segment=SysTrig_CamEx1E1/Start_SEV
          SEV_ADI: stimulus=SysTrig_CamEx1E1/SEV, response=SysTrig_CamEx1E1/ADI, segment=SysTrig_CamEx1E1/SEV_ADI
          ADI_CCI: stimulus=SysTrig_CamEx1E1/ADI, response=SysTrig_CamEx1E1/CCI, segment=SysTrig_CamEx1E1/ADI_CCI
          CCI_SYV: stimulus=SysTrig_CamEx1E1/CCI, response=SysTrig_CamEx1E1/SYV, segment=SysTrig_CamEx1E1/CCI_SYV
          SYV_POR: stimulus=SysTrig_CamEx1E1/SYV, response=SysTrig_CamEx1E1/POR, segment=SysTrig_CamEx1E1/SYV_POR
          POR_CBS: stimulus=SysTrig_CamEx1E1/POR, response=SysTrig_CamEx1E1/CBS, segment=SysTrig_CamEx1E1/POR_CBS
          CBS_CCS: stimulus=SysTrig_CamEx1E1/CBS, response=SysTrig_CamEx1E1/CCS, segment=SysTrig_CamEx1E1/CBS_CCS
          CCS_CSC: stimulus=SysTrig_CamEx1E1/CCS, response=SysTrig_CamEx1E1/CSC, segment=SysTrig_CamEx1E1/CCS_CSC
          CSC_ROS: stimulus=SysTrig_CamEx1E1/CSC, response=SysTrig_CamEx1E1/ROS, segment=SysTrig_CamEx1E1/CSC_ROS
          ROS_PAD: stimulus=SysTrig_CamEx1E1/ROS, response=SysTrig_CamEx1E1/PAD, segment=SysTrig_CamEx1E1/ROS_PAD
          PAD_PPC: stimulus=SysTrig_CamEx1E1/PAD, response=SysTrig_CamEx1E1/PPC, segment=SysTrig_CamEx1E1/PAD_PPC
          PPC_DPN: stimulus=SysTrig_CamEx1E1/PPC, response=SysTrig_CamEx1E1/DPN, segment=SysTrig_CamEx1E1/PPC_DPN
          DPN_End: stimulus=SysTrig_CamEx1E1/DPN, response=SysTrig_CamEx1E1/End, segment=SysTrig_CamEx1E1/DPN_End
          SysTrig_CamEx1E1:
            stimulus=SysTrig_CamEx1E1/Start
            response=SysTrig_CamEx1E1/End
            segment=[SysTrig_CamEx1E1/Start_SEV, SysTrig_CamEx1E1/SEV_ADI, SysTrig_CamEx1E1/ADI_CCI, SysTrig_CamEx1E1/CCI_SYV, SysTrig_CamEx1E1/SYV_POR, SysTrig_CamEx1E1/POR_CBS, SysTrig_CamEx1E1/CBS_CCS, SysTrig_CamEx1E1/CCS_CSC, SysTrig_CamEx1E1/CSC_ROS, SysTrig_CamEx1E1/ROS_PAD, SysTrig_CamEx1E1/PAD_PPC, SysTrig_CamEx1E1/PPC_DPN, SysTrig_CamEx1E1/DPN_End]
      timing-guarantees:
        latency timing constraint Deadline: latency-constraint-type=REACTION, scope=SysTrig_CamEx1E1, maximum={cse-code=0, cse-code-factor=500}
      timing-requirements:
        sporadic event triggering ActivationPattern: event=SysTrig_CamEx1E1/Start, minimum-inter-arrival-time={cse-code=0, cse-code-factor=500}, maximum-inter-arrival-time={cse-code=0, cse-code-factor=3000000}
    SysTrig_CamEx2E1  # This is an engine dependent event with the camshaft signal recurrence of exhaust bank 2. The camshaft event period depends on the camshaft target wheel.
      timing-descriptions:
        14 x td event complex:
          Start
          SEV  # System Event Validation: Due to a delay between the detection of the system event and the execution of the system event implementation the conditions for the system event might disappear. In this case, runnables called after this phase can be informed or even skipped. Note: This phase is available on any event. Warning: This phase shall be used by the event producer only !
          ADI  # Acquisition and associated Diagnoses: Acquisitions (and diagnosis) have to be done early in the event in order to get the results ready for the complete event.
          CCI  # Cross-Checking of Inputs: Input data crosschecking, high level diagnostic and input limp home actions are performed.
          SYV  # SYstem Variables computation: System variables are computed based on ECU inputs to be used in a high number of functions.
          POR  # Preparation Of Requests: Request data are elaborated based on inputs, which need a lot of logics. A request is not subject to control loop.
          CBS  # Calculation of Basic Setpoints: Basic setpoints are calculated based on system variables and requests.
          CCS  # Calculation of Complex Setpoints: Complex setpoints are based on system variables, requests and other setpoints.
          CSC  # Calculation of Setpoint Corrections: Setpoint corrections are done to align them with other setpoints.
          ROS  # Realisation Of Setpoints: BSW is informed about new ASW data. Basically actuating of the HW is done here.
          PAD  # Post Acquisition of Data: Additional acquisitions which were not relevant until the ASW to BSW communication point are performed now.
          PPC  # Post Processing Calculations: Postprocessing is performed.
          DPN  # Data Processing for Next cycle: Data needed for next event occurence or for other events are calculated. Computations that have no «internal deadline» are located here. The data produced here and consumed in the same event will have a delay of one period in the next occurence of the event.
          End
        14 x timing description event chain:
          Start_SEV: stimulus=SysTrig_CamEx2E1/Start, response=SysTrig_CamEx2E1/SEV, segment=SysTrig_CamEx2E1/Start_SEV
          SEV_ADI: stimulus=SysTrig_CamEx2E1/SEV, response=SysTrig_CamEx2E1/ADI, segment=SysTrig_CamEx2E1/SEV_ADI
          ADI_CCI: stimulus=SysTrig_CamEx2E1/ADI, response=SysTrig_CamEx2E1/CCI, segment=SysTrig_CamEx2E1/ADI_CCI
          CCI_SYV: stimulus=SysTrig_CamEx2E1/CCI, response=SysTrig_CamEx2E1/SYV, segment=SysTrig_CamEx2E1/CCI_SYV
          SYV_POR: stimulus=SysTrig_CamEx2E1/SYV, response=SysTrig_CamEx2E1/POR, segment=SysTrig_CamEx2E1/SYV_POR
          POR_CBS: stimulus=SysTrig_CamEx2E1/POR, response=SysTrig_CamEx2E1/CBS, segment=SysTrig_CamEx2E1/POR_CBS
          CBS_CCS: stimulus=SysTrig_CamEx2E1/CBS, response=SysTrig_CamEx2E1/CCS, segment=SysTrig_CamEx2E1/CBS_CCS
          CCS_CSC: stimulus=SysTrig_CamEx2E1/CCS, response=SysTrig_CamEx2E1/CSC, segment=SysTrig_CamEx2E1/CCS_CSC
          CSC_ROS: stimulus=SysTrig_CamEx2E1/CSC, response=SysTrig_CamEx2E1/ROS, segment=SysTrig_CamEx2E1/CSC_ROS
          ROS_PAD: stimulus=SysTrig_CamEx2E1/ROS, response=SysTrig_CamEx2E1/PAD, segment=SysTrig_CamEx2E1/ROS_PAD
          PAD_PPC: stimulus=SysTrig_CamEx2E1/PAD, response=SysTrig_CamEx2E1/PPC, segment=SysTrig_CamEx2E1/PAD_PPC
          PPC_DPN: stimulus=SysTrig_CamEx2E1/PPC, response=SysTrig_CamEx2E1/DPN, segment=SysTrig_CamEx2E1/PPC_DPN
          DPN_End: stimulus=SysTrig_CamEx2E1/DPN, response=SysTrig_CamEx2E1/End, segment=SysTrig_CamEx2E1/DPN_End
          SysTrig_CamEx2E1:
            stimulus=SysTrig_CamEx2E1/Start
            response=SysTrig_CamEx2E1/End
            segment=[SysTrig_CamEx2E1/Start_SEV, SysTrig_CamEx2E1/SEV_ADI, SysTrig_CamEx2E1/ADI_CCI, SysTrig_CamEx2E1/CCI_SYV, SysTrig_CamEx2E1/SYV_POR, SysTrig_CamEx2E1/POR_CBS, SysTrig_CamEx2E1/CBS_CCS, SysTrig_CamEx2E1/CCS_CSC, SysTrig_CamEx2E1/CSC_ROS, SysTrig_CamEx2E1/ROS_PAD, SysTrig_CamEx2E1/PAD_PPC, SysTrig_CamEx2E1/PPC_DPN, SysTrig_CamEx2E1/DPN_End]
      timing-guarantees:
        latency timing constraint Deadline: latency-constraint-type=REACTION, scope=SysTrig_CamEx2E1, maximum={cse-code=0, cse-code-factor=500}
      timing-requirements:
        sporadic event triggering ActivationPattern: event=SysTrig_CamEx2E1/Start, minimum-inter-arrival-time={cse-code=0, cse-code-factor=500}, maximum-inter-arrival-time={cse-code=0, cse-code-factor=3000000}
    SysTrig_CamIn1E1  # This is an engine dependent event with the camshaft signal recurrence of intake bank 1. The camshaft event period depends on the camshaft target wheel.
      timing-descriptions:
        14 x td event complex:
          Start
          SEV  # System Event Validation: Due to a delay between the detection of the system event and the execution of the system event implementation the conditions for the system event might disappear. In this case, runnables called after this phase can be informed or even skipped. Note: This phase is available on any event. Warning: This phase shall be used by the event producer only !
          ADI  # Acquisition and associated Diagnoses: Acquisitions (and diagnosis) have to be done early in the event in order to get the results ready for the complete event.
          CCI  # Cross-Checking of Inputs: Input data crosschecking, high level diagnostic and input limp home actions are performed.
          SYV  # SYstem Variables computation: System variables are computed based on ECU inputs to be used in a high number of functions.
          POR  # Preparation Of Requests: Request data are elaborated based on inputs, which need a lot of logics. A request is not subject to control loop.
          CBS  # Calculation of Basic Setpoints: Basic setpoints are calculated based on system variables and requests.
          CCS  # Calculation of Complex Setpoints: Complex setpoints are based on system variables, requests and other setpoints.
          CSC  # Calculation of Setpoint Corrections: Setpoint corrections are done to align them with other setpoints.
          ROS  # Realisation Of Setpoints: BSW is informed about new ASW data. Basically actuating of the HW is done here.
          PAD  # Post Acquisition of Data: Additional acquisitions which were not relevant until the ASW to BSW communication point are performed now.
          PPC  # Post Processing Calculations: Postprocessing is performed.
          DPN  # Data Processing for Next cycle: Data needed for next event occurence or for other events are calculated. Computations that have no «internal deadline» are located here. The data produced here and consumed in the same event will have a delay of one period in the next occurence of the event.
          End
        14 x timing description event chain:
          Start_SEV: stimulus=SysTrig_CamIn1E1/Start, response=SysTrig_CamIn1E1/SEV, segment=SysTrig_CamIn1E1/Start_SEV
          SEV_ADI: stimulus=SysTrig_CamIn1E1/SEV, response=SysTrig_CamIn1E1/ADI, segment=SysTrig_CamIn1E1/SEV_ADI
          ADI_CCI: stimulus=SysTrig_CamIn1E1/ADI, response=SysTrig_CamIn1E1/CCI, segment=SysTrig_CamIn1E1/ADI_CCI
          CCI_SYV: stimulus=SysTrig_CamIn1E1/CCI, response=SysTrig_CamIn1E1/SYV, segment=SysTrig_CamIn1E1/CCI_SYV
          SYV_POR: stimulus=SysTrig_CamIn1E1/SYV, response=SysTrig_CamIn1E1/POR, segment=SysTrig_CamIn1E1/SYV_POR
          POR_CBS: stimulus=SysTrig_CamIn1E1/POR, response=SysTrig_CamIn1E1/CBS, segment=SysTrig_CamIn1E1/POR_CBS
          CBS_CCS: stimulus=SysTrig_CamIn1E1/CBS, response=SysTrig_CamIn1E1/CCS, segment=SysTrig_CamIn1E1/CBS_CCS
          CCS_CSC: stimulus=SysTrig_CamIn1E1/CCS, response=SysTrig_CamIn1E1/CSC, segment=SysTrig_CamIn1E1/CCS_CSC
          CSC_ROS: stimulus=SysTrig_CamIn1E1/CSC, response=SysTrig_CamIn1E1/ROS, segment=SysTrig_CamIn1E1/CSC_ROS
          ROS_PAD: stimulus=SysTrig_CamIn1E1/ROS, response=SysTrig_CamIn1E1/PAD, segment=SysTrig_CamIn1E1/ROS_PAD
          PAD_PPC: stimulus=SysTrig_CamIn1E1/PAD, response=SysTrig_CamIn1E1/PPC, segment=SysTrig_CamIn1E1/PAD_PPC
          PPC_DPN: stimulus=SysTrig_CamIn1E1/PPC, response=SysTrig_CamIn1E1/DPN, segment=SysTrig_CamIn1E1/PPC_DPN
          DPN_End: stimulus=SysTrig_CamIn1E1/DPN, response=SysTrig_CamIn1E1/End, segment=SysTrig_CamIn1E1/DPN_End
          SysTrig_CamIn1E1:
            stimulus=SysTrig_CamIn1E1/Start
            response=SysTrig_CamIn1E1/End
            segment=[SysTrig_CamIn1E1/Start_SEV, SysTrig_CamIn1E1/SEV_ADI, SysTrig_CamIn1E1/ADI_CCI, SysTrig_CamIn1E1/CCI_SYV, SysTrig_CamIn1E1/SYV_POR, SysTrig_CamIn1E1/POR_CBS, SysTrig_CamIn1E1/CBS_CCS, SysTrig_CamIn1E1/CCS_CSC, SysTrig_CamIn1E1/CSC_ROS, SysTrig_CamIn1E1/ROS_PAD, SysTrig_CamIn1E1/PAD_PPC, SysTrig_CamIn1E1/PPC_DPN, SysTrig_CamIn1E1/DPN_End]
      timing-guarantees:
        latency timing constraint Deadline: latency-constraint-type=REACTION, scope=SysTrig_CamIn1E1, maximum={cse-code=0, cse-code-factor=500}
      timing-requirements:
        sporadic event triggering ActivationPattern: event=SysTrig_CamIn1E1/Start, minimum-inter-arrival-time={cse-code=0, cse-code-factor=500}, maximum-inter-arrival-time={cse-code=0, cse-code-factor=3000000}
    SysTrig_CamIn2E1  # This is an engine dependent event with the camshaft signal recurrence of intake bank 2. The camshaft event period depends on the camshaft target wheel.
      timing-descriptions:
        14 x td event complex:
          Start
          SEV  # System Event Validation: Due to a delay between the detection of the system event and the execution of the system event implementation the conditions for the system event might disappear. In this case, runnables called after this phase can be informed or even skipped. Note: This phase is available on any event. Warning: This phase shall be used by the event producer only !
          ADI  # Acquisition and associated Diagnoses: Acquisitions (and diagnosis) have to be done early in the event in order to get the results ready for the complete event.
          CCI  # Cross-Checking of Inputs: Input data crosschecking, high level diagnostic and input limp home actions are performed.
          SYV  # SYstem Variables computation: System variables are computed based on ECU inputs to be used in a high number of functions.
          POR  # Preparation Of Requests: Request data are elaborated based on inputs, which need a lot of logics. A request is not subject to control loop.
          CBS  # Calculation of Basic Setpoints: Basic setpoints are calculated based on system variables and requests.
          CCS  # Calculation of Complex Setpoints: Complex setpoints are based on system variables, requests and other setpoints.
          CSC  # Calculation of Setpoint Corrections: Setpoint corrections are done to align them with other setpoints.
          ROS  # Realisation Of Setpoints: BSW is informed about new ASW data. Basically actuating of the HW is done here.
          PAD  # Post Acquisition of Data: Additional acquisitions which were not relevant until the ASW to BSW communication point are performed now.
          PPC  # Post Processing Calculations: Postprocessing is performed.
          DPN  # Data Processing for Next cycle: Data needed for next event occurence or for other events are calculated. Computations that have no «internal deadline» are located here. The data produced here and consumed in the same event will have a delay of one period in the next occurence of the event.
          End
        14 x timing description event chain:
          Start_SEV: stimulus=SysTrig_CamIn2E1/Start, response=SysTrig_CamIn2E1/SEV, segment=SysTrig_CamIn2E1/Start_SEV
          SEV_ADI: stimulus=SysTrig_CamIn2E1/SEV, response=SysTrig_CamIn2E1/ADI, segment=SysTrig_CamIn2E1/SEV_ADI
          ADI_CCI: stimulus=SysTrig_CamIn2E1/ADI, response=SysTrig_CamIn2E1/CCI, segment=SysTrig_CamIn2E1/ADI_CCI
          CCI_SYV: stimulus=SysTrig_CamIn2E1/CCI, response=SysTrig_CamIn2E1/SYV, segment=SysTrig_CamIn2E1/CCI_SYV
          SYV_POR: stimulus=SysTrig_CamIn2E1/SYV, response=SysTrig_CamIn2E1/POR, segment=SysTrig_CamIn2E1/SYV_POR
          POR_CBS: stimulus=SysTrig_CamIn2E1/POR, response=SysTrig_CamIn2E1/CBS, segment=SysTrig_CamIn2E1/POR_CBS
          CBS_CCS: stimulus=SysTrig_CamIn2E1/CBS, response=SysTrig_CamIn2E1/CCS, segment=SysTrig_CamIn2E1/CBS_CCS
          CCS_CSC: stimulus=SysTrig_CamIn2E1/CCS, response=SysTrig_CamIn2E1/CSC, segment=SysTrig_CamIn2E1/CCS_CSC
          CSC_ROS: stimulus=SysTrig_CamIn2E1/CSC, response=SysTrig_CamIn2E1/ROS, segment=SysTrig_CamIn2E1/CSC_ROS
          ROS_PAD: stimulus=SysTrig_CamIn2E1/ROS, response=SysTrig_CamIn2E1/PAD, segment=SysTrig_CamIn2E1/ROS_PAD
          PAD_PPC: stimulus=SysTrig_CamIn2E1/PAD, response=SysTrig_CamIn2E1/PPC, segment=SysTrig_CamIn2E1/PAD_PPC
          PPC_DPN: stimulus=SysTrig_CamIn2E1/PPC, response=SysTrig_CamIn2E1/DPN, segment=SysTrig_CamIn2E1/PPC_DPN
          DPN_End: stimulus=SysTrig_CamIn2E1/DPN, response=SysTrig_CamIn2E1/End, segment=SysTrig_CamIn2E1/DPN_End
          SysTrig_CamIn2E1:
            stimulus=SysTrig_CamIn2E1/Start
            response=SysTrig_CamIn2E1/End
            segment=[SysTrig_CamIn2E1/Start_SEV, SysTrig_CamIn2E1/SEV_ADI, SysTrig_CamIn2E1/ADI_CCI, SysTrig_CamIn2E1/CCI_SYV, SysTrig_CamIn2E1/SYV_POR, SysTrig_CamIn2E1/POR_CBS, SysTrig_CamIn2E1/CBS_CCS, SysTrig_CamIn2E1/CCS_CSC, SysTrig_CamIn2E1/CSC_ROS, SysTrig_CamIn2E1/ROS_PAD, SysTrig_CamIn2E1/PAD_PPC, SysTrig_CamIn2E1/PPC_DPN, SysTrig_CamIn2E1/DPN_End]
      timing-guarantees:
        latency timing constraint Deadline: latency-constraint-type=REACTION, scope=SysTrig_CamIn2E1, maximum={cse-code=0, cse-code-factor=500}
      timing-requirements:
        sporadic event triggering ActivationPattern: event=SysTrig_CamIn2E1/Start, minimum-inter-arrival-time={cse-code=0, cse-code-factor=500}, maximum-inter-arrival-time={cse-code=0, cse-code-factor=3000000}
    SysTrig_DetCamE2  # This is an engine dependent event with camshaft active edge recurrence. The camshaft event period depends on the camshaft target wheel. This event is for detection and validation only, and will result in more events usable for all functions.
      timing-descriptions:
        14 x td event complex:
          Start
          SEV  # System Event Validation: Due to a delay between the detection of the system event and the execution of the system event implementation the conditions for the system event might disappear. In this case, runnables called after this phase can be informed or even skipped. Note: This phase is available on any event. Warning: This phase shall be used by the event producer only !
          ADI  # Acquisition and associated Diagnoses: Acquisitions (and diagnosis) have to be done early in the event in order to get the results ready for the complete event.
          CCI  # Cross-Checking of Inputs: Input data crosschecking, high level diagnostic and input limp home actions are performed.
          SYV  # SYstem Variables computation: System variables are computed based on ECU inputs to be used in a high number of functions.
          POR  # Preparation Of Requests: Request data are elaborated based on inputs, which need a lot of logics. A request is not subject to control loop.
          CBS  # Calculation of Basic Setpoints: Basic setpoints are calculated based on system variables and requests.
          CCS  # Calculation of Complex Setpoints: Complex setpoints are based on system variables, requests and other setpoints.
          CSC  # Calculation of Setpoint Corrections: Setpoint corrections are done to align them with other setpoints.
          ROS  # Realisation Of Setpoints: BSW is informed about new ASW data. Basically actuating of the HW is done here.
          PAD  # Post Acquisition of Data: Additional acquisitions which were not relevant until the ASW to BSW communication point are performed now.
          PPC  # Post Processing Calculations: Postprocessing is performed.
          DPN  # Data Processing for Next cycle: Data needed for next event occurence or for other events are calculated. Computations that have no «internal deadline» are located here. The data produced here and consumed in the same event will have a delay of one period in the next occurence of the event.
          End
        14 x timing description event chain:
          Start_SEV: stimulus=SysTrig_DetCamE2/Start, response=SysTrig_DetCamE2/SEV, segment=SysTrig_DetCamE2/Start_SEV
          SEV_ADI: stimulus=SysTrig_DetCamE2/SEV, response=SysTrig_DetCamE2/ADI, segment=SysTrig_DetCamE2/SEV_ADI
          ADI_CCI: stimulus=SysTrig_DetCamE2/ADI, response=SysTrig_DetCamE2/CCI, segment=SysTrig_DetCamE2/ADI_CCI
          CCI_SYV: stimulus=SysTrig_DetCamE2/CCI, response=SysTrig_DetCamE2/SYV, segment=SysTrig_DetCamE2/CCI_SYV
          SYV_POR: stimulus=SysTrig_DetCamE2/SYV, response=SysTrig_DetCamE2/POR, segment=SysTrig_DetCamE2/SYV_POR
          POR_CBS: stimulus=SysTrig_DetCamE2/POR, response=SysTrig_DetCamE2/CBS, segment=SysTrig_DetCamE2/POR_CBS
          CBS_CCS: stimulus=SysTrig_DetCamE2/CBS, response=SysTrig_DetCamE2/CCS, segment=SysTrig_DetCamE2/CBS_CCS
          CCS_CSC: stimulus=SysTrig_DetCamE2/CCS, response=SysTrig_DetCamE2/CSC, segment=SysTrig_DetCamE2/CCS_CSC
          CSC_ROS: stimulus=SysTrig_DetCamE2/CSC, response=SysTrig_DetCamE2/ROS, segment=SysTrig_DetCamE2/CSC_ROS
          ROS_PAD: stimulus=SysTrig_DetCamE2/ROS, response=SysTrig_DetCamE2/PAD, segment=SysTrig_DetCamE2/ROS_PAD
          PAD_PPC: stimulus=SysTrig_DetCamE2/PAD, response=SysTrig_DetCamE2/PPC, segment=SysTrig_DetCamE2/PAD_PPC
          PPC_DPN: stimulus=SysTrig_DetCamE2/PPC, response=SysTrig_DetCamE2/DPN, segment=SysTrig_DetCamE2/PPC_DPN
          DPN_End: stimulus=SysTrig_DetCamE2/DPN, response=SysTrig_DetCamE2/End, segment=SysTrig_DetCamE2/DPN_End
          SysTrig_DetCamE2:
            stimulus=SysTrig_DetCamE2/Start
            response=SysTrig_DetCamE2/End
            segment=[SysTrig_DetCamE2/Start_SEV, SysTrig_DetCamE2/SEV_ADI, SysTrig_DetCamE2/ADI_CCI, SysTrig_DetCamE2/CCI_SYV, SysTrig_DetCamE2/SYV_POR, SysTrig_DetCamE2/POR_CBS, SysTrig_DetCamE2/CBS_CCS, SysTrig_DetCamE2/CCS_CSC, SysTrig_DetCamE2/CSC_ROS, SysTrig_DetCamE2/ROS_PAD, SysTrig_DetCamE2/PAD_PPC, SysTrig_DetCamE2/PPC_DPN, SysTrig_DetCamE2/DPN_End]
      timing-guarantees:
        latency timing constraint Deadline: latency-constraint-type=REACTION, scope=SysTrig_DetCamE2, maximum={cse-code=0, cse-code-factor=500}
      timing-requirements:
        sporadic event triggering ActivationPattern: event=SysTrig_DetCamE2/Start, minimum-inter-arrival-time={cse-code=0, cse-code-factor=500}, maximum-inter-arrival-time={cse-code=0, cse-code-factor=3000000}
    SysTrig_DetEngRevE0  # This is an engine dependent event with one crankshaft revolution recurrence, i.e. 360 degrees on the crankshaft. This event is for detection and validation only, and will result in an event usable for all functions.
      timing-descriptions:
        16 x td event complex:
          Start
          SEV  # System Event Validation: Due to a delay between the detection of the system event and the execution of the system event implementation the conditions for the system event might disappear. In this case, runnables called after this phase can be informed or even skipped. Note: This phase is available on any event. Warning: This phase shall be used by the event producer only !
          PST  # Preparation of System Transition: Acquisitions, related diagnoses and any computation needed to prepare the detection of a system transition are done.
          DST  # Detection of System Transition: Major system transitions are detected as soon as possible so that nominal computations benefit from the initialization, instead of being overwritten.
          ADI  # Acquisition and associated Diagnoses: Acquisitions (and diagnosis) have to be done early in the event in order to get the results ready for the complete event.
          CCI  # Cross-Checking of Inputs: Input data crosschecking, high level diagnostic and input limp home actions are performed.
          SYV  # SYstem Variables computation: System variables are computed based on ECU inputs to be used in a high number of functions.
          POR  # Preparation Of Requests: Request data are elaborated based on inputs, which need a lot of logics. A request is not subject to control loop.
          CBS  # Calculation of Basic Setpoints: Basic setpoints are calculated based on system variables and requests.
          CCS  # Calculation of Complex Setpoints: Complex setpoints are based on system variables, requests and other setpoints.
          CSC  # Calculation of Setpoint Corrections: Setpoint corrections are done to align them with other setpoints.
          ROS  # Realisation Of Setpoints: BSW is informed about new ASW data. Basically actuating of the HW is done here.
          PAD  # Post Acquisition of Data: Additional acquisitions which were not relevant until the ASW to BSW communication point are performed now.
          PPC  # Post Processing Calculations: Postprocessing is performed.
          DPN  # Data Processing for Next cycle: Data needed for next event occurence or for other events are calculated. Computations that have no «internal deadline» are located here. The data produced here and consumed in the same event will have a delay of one period in the next occurence of the event.
          End
        16 x timing description event chain:
          Start_SEV: stimulus=SysTrig_DetEngRevE0/Start, response=SysTrig_DetEngRevE0/SEV, segment=SysTrig_DetEngRevE0/Start_SEV
          SEV_PST: stimulus=SysTrig_DetEngRevE0/SEV, response=SysTrig_DetEngRevE0/PST, segment=SysTrig_DetEngRevE0/SEV_PST
          PST_DST: stimulus=SysTrig_DetEngRevE0/PST, response=SysTrig_DetEngRevE0/DST, segment=SysTrig_DetEngRevE0/PST_DST
          DST_ADI: stimulus=SysTrig_DetEngRevE0/DST, response=SysTrig_DetEngRevE0/ADI, segment=SysTrig_DetEngRevE0/DST_ADI
          ADI_CCI: stimulus=SysTrig_DetEngRevE0/ADI, response=SysTrig_DetEngRevE0/CCI, segment=SysTrig_DetEngRevE0/ADI_CCI
          CCI_SYV: stimulus=SysTrig_DetEngRevE0/CCI, response=SysTrig_DetEngRevE0/SYV, segment=SysTrig_DetEngRevE0/CCI_SYV
          SYV_POR: stimulus=SysTrig_DetEngRevE0/SYV, response=SysTrig_DetEngRevE0/POR, segment=SysTrig_DetEngRevE0/SYV_POR
          POR_CBS: stimulus=SysTrig_DetEngRevE0/POR, response=SysTrig_DetEngRevE0/CBS, segment=SysTrig_DetEngRevE0/POR_CBS
          CBS_CCS: stimulus=SysTrig_DetEngRevE0/CBS, response=SysTrig_DetEngRevE0/CCS, segment=SysTrig_DetEngRevE0/CBS_CCS
          CCS_CSC: stimulus=SysTrig_DetEngRevE0/CCS, response=SysTrig_DetEngRevE0/CSC, segment=SysTrig_DetEngRevE0/CCS_CSC
          CSC_ROS: stimulus=SysTrig_DetEngRevE0/CSC, response=SysTrig_DetEngRevE0/ROS, segment=SysTrig_DetEngRevE0/CSC_ROS
          ROS_PAD: stimulus=SysTrig_DetEngRevE0/ROS, response=SysTrig_DetEngRevE0/PAD, segment=SysTrig_DetEngRevE0/ROS_PAD
          PAD_PPC: stimulus=SysTrig_DetEngRevE0/PAD, response=SysTrig_DetEngRevE0/PPC, segment=SysTrig_DetEngRevE0/PAD_PPC
          PPC_DPN: stimulus=SysTrig_DetEngRevE0/PPC, response=SysTrig_DetEngRevE0/DPN, segment=SysTrig_DetEngRevE0/PPC_DPN
          DPN_End: stimulus=SysTrig_DetEngRevE0/DPN, response=SysTrig_DetEngRevE0/End, segment=SysTrig_DetEngRevE0/DPN_End
          SysTrig_DetEngRevE0:
            stimulus=SysTrig_DetEngRevE0/Start
            response=SysTrig_DetEngRevE0/End
            segment=[SysTrig_DetEngRevE0/Start_SEV, SysTrig_DetEngRevE0/SEV_PST, SysTrig_DetEngRevE0/PST_DST, SysTrig_DetEngRevE0/DST_ADI, SysTrig_DetEngRevE0/ADI_CCI, SysTrig_DetEngRevE0/CCI_SYV, SysTrig_DetEngRevE0/SYV_POR, SysTrig_DetEngRevE0/POR_CBS, SysTrig_DetEngRevE0/CBS_CCS, SysTrig_DetEngRevE0/CCS_CSC, SysTrig_DetEngRevE0/CSC_ROS, SysTrig_DetEngRevE0/ROS_PAD, SysTrig_DetEngRevE0/PAD_PPC, SysTrig_DetEngRevE0/PPC_DPN, SysTrig_DetEngRevE0/DPN_End]
      timing-guarantees:
        latency timing constraint Deadline: latency-constraint-type=REACTION, scope=SysTrig_DetEngRevE0, maximum={cse-code=0, cse-code-factor=10000}
      timing-requirements:
        sporadic event triggering ActivationPattern: event=SysTrig_DetEngRevE0/Start, minimum-inter-arrival-time={cse-code=0, cse-code-factor=7000}, maximum-inter-arrival-time={cse-code=0, cse-code-factor=3000000}
    SysTrig_DetEpoSynE1  # This is an engine dependent event triggered for every event leading to a new information for engine synchronization. This event is for detection and validation only, and will result in an event usable for all functions.
      timing-descriptions:
        16 x td event complex:
          Start
          SEV  # System Event Validation: Due to a delay between the detection of the system event and the execution of the system event implementation the conditions for the system event might disappear. In this case, runnables called after this phase can be informed or even skipped. Note: This phase is available on any event. Warning: This phase shall be used by the event producer only !
          PST  # Preparation of System Transition: Acquisitions, related diagnoses and any computation needed to prepare the detection of a system transition are done.
          DST  # Detection of System Transition: Major system transitions are detected as soon as possible so that nominal computations benefit from the initialization, instead of being overwritten.
          ADI  # Acquisition and associated Diagnoses: Acquisitions (and diagnosis) have to be done early in the event in order to get the results ready for the complete event.
          CCI  # Cross-Checking of Inputs: Input data crosschecking, high level diagnostic and input limp home actions are performed.
          SYV  # SYstem Variables computation: System variables are computed based on ECU inputs to be used in a high number of functions.
          POR  # Preparation Of Requests: Request data are elaborated based on inputs, which need a lot of logics. A request is not subject to control loop.
          CBS  # Calculation of Basic Setpoints: Basic setpoints are calculated based on system variables and requests.
          CCS  # Calculation of Complex Setpoints: Complex setpoints are based on system variables, requests and other setpoints.
          CSC  # Calculation of Setpoint Corrections: Setpoint corrections are done to align them with other setpoints.
          ROS  # Realisation Of Setpoints: BSW is informed about new ASW data. Basically actuating of the HW is done here.
          PAD  # Post Acquisition of Data: Additional acquisitions which were not relevant until the ASW to BSW communication point are performed now.
          PPC  # Post Processing Calculations: Postprocessing is performed.
          DPN  # Data Processing for Next cycle: Data needed for next event occurence or for other events are calculated. Computations that have no «internal deadline» are located here. The data produced here and consumed in the same event will have a delay of one period in the next occurence of the event.
          End
        16 x timing description event chain:
          Start_SEV: stimulus=SysTrig_DetEpoSynE1/Start, response=SysTrig_DetEpoSynE1/SEV, segment=SysTrig_DetEpoSynE1/Start_SEV
          SEV_PST: stimulus=SysTrig_DetEpoSynE1/SEV, response=SysTrig_DetEpoSynE1/PST, segment=SysTrig_DetEpoSynE1/SEV_PST
          PST_DST: stimulus=SysTrig_DetEpoSynE1/PST, response=SysTrig_DetEpoSynE1/DST, segment=SysTrig_DetEpoSynE1/PST_DST
          DST_ADI: stimulus=SysTrig_DetEpoSynE1/DST, response=SysTrig_DetEpoSynE1/ADI, segment=SysTrig_DetEpoSynE1/DST_ADI
          ADI_CCI: stimulus=SysTrig_DetEpoSynE1/ADI, response=SysTrig_DetEpoSynE1/CCI, segment=SysTrig_DetEpoSynE1/ADI_CCI
          CCI_SYV: stimulus=SysTrig_DetEpoSynE1/CCI, response=SysTrig_DetEpoSynE1/SYV, segment=SysTrig_DetEpoSynE1/CCI_SYV
          SYV_POR: stimulus=SysTrig_DetEpoSynE1/SYV, response=SysTrig_DetEpoSynE1/POR, segment=SysTrig_DetEpoSynE1/SYV_POR
          POR_CBS: stimulus=SysTrig_DetEpoSynE1/POR, response=SysTrig_DetEpoSynE1/CBS, segment=SysTrig_DetEpoSynE1/POR_CBS
          CBS_CCS: stimulus=SysTrig_DetEpoSynE1/CBS, response=SysTrig_DetEpoSynE1/CCS, segment=SysTrig_DetEpoSynE1/CBS_CCS
          CCS_CSC: stimulus=SysTrig_DetEpoSynE1/CCS, response=SysTrig_DetEpoSynE1/CSC, segment=SysTrig_DetEpoSynE1/CCS_CSC
          CSC_ROS: stimulus=SysTrig_DetEpoSynE1/CSC, response=SysTrig_DetEpoSynE1/ROS, segment=SysTrig_DetEpoSynE1/CSC_ROS
          ROS_PAD: stimulus=SysTrig_DetEpoSynE1/ROS, response=SysTrig_DetEpoSynE1/PAD, segment=SysTrig_DetEpoSynE1/ROS_PAD
          PAD_PPC: stimulus=SysTrig_DetEpoSynE1/PAD, response=SysTrig_DetEpoSynE1/PPC, segment=SysTrig_DetEpoSynE1/PAD_PPC
          PPC_DPN: stimulus=SysTrig_DetEpoSynE1/PPC, response=SysTrig_DetEpoSynE1/DPN, segment=SysTrig_DetEpoSynE1/PPC_DPN
          DPN_End: stimulus=SysTrig_DetEpoSynE1/DPN, response=SysTrig_DetEpoSynE1/End, segment=SysTrig_DetEpoSynE1/DPN_End
          SysTrig_DetEpoSynE1:
            stimulus=SysTrig_DetEpoSynE1/Start
            response=SysTrig_DetEpoSynE1/End
            segment=[SysTrig_DetEpoSynE1/Start_SEV, SysTrig_DetEpoSynE1/SEV_PST, SysTrig_DetEpoSynE1/PST_DST, SysTrig_DetEpoSynE1/DST_ADI, SysTrig_DetEpoSynE1/ADI_CCI, SysTrig_DetEpoSynE1/CCI_SYV, SysTrig_DetEpoSynE1/SYV_POR, SysTrig_DetEpoSynE1/POR_CBS, SysTrig_DetEpoSynE1/CBS_CCS, SysTrig_DetEpoSynE1/CCS_CSC, SysTrig_DetEpoSynE1/CSC_ROS, SysTrig_DetEpoSynE1/ROS_PAD, SysTrig_DetEpoSynE1/PAD_PPC, SysTrig_DetEpoSynE1/PPC_DPN, SysTrig_DetEpoSynE1/DPN_End]
      timing-guarantees:
        latency timing constraint Deadline: latency-constraint-type=REACTION, scope=SysTrig_DetEpoSynE1, maximum={cse-code=0, cse-code-factor=10000}
      timing-requirements:
        sporadic event triggering ActivationPattern: event=SysTrig_DetEpoSynE1/Start, minimum-inter-arrival-time={cse-code=0, cse-code-factor=7000}, maximum-inter-arrival-time={cse-code=0, cse-code-factor=3000000}
    SysTrig_DetHalfSegE1  # This is an engine dependent event with segment recurrence at the mid of the segment to detect and validate the SysTrig_HalfSegE1. Warning: This event might be skipped at high engine speed depending on project configuration.
      timing-descriptions:
        16 x td event complex:
          Start
          SEV  # System Event Validation: Due to a delay between the detection of the system event and the execution of the system event implementation the conditions for the system event might disappear. In this case, runnables called after this phase can be informed or even skipped. Note: This phase is available on any event. Warning: This phase shall be used by the event producer only !
          PST  # Preparation of System Transition: Acquisitions, related diagnoses and any computation needed to prepare the detection of a system transition are done.
          DST  # Detection of System Transition: Major system transitions are detected as soon as possible so that nominal computations benefit from the initialization, instead of being overwritten.
          ADI  # Acquisition and associated Diagnoses: Acquisitions (and diagnosis) have to be done early in the event in order to get the results ready for the complete event.
          CCI  # Cross-Checking of Inputs: Input data crosschecking, high level diagnostic and input limp home actions are performed.
          SYV  # SYstem Variables computation: System variables are computed based on ECU inputs to be used in a high number of functions.
          POR  # Preparation Of Requests: Request data are elaborated based on inputs, which need a lot of logics. A request is not subject to control loop.
          CBS  # Calculation of Basic Setpoints: Basic setpoints are calculated based on system variables and requests.
          CCS  # Calculation of Complex Setpoints: Complex setpoints are based on system variables, requests and other setpoints.
          CSC  # Calculation of Setpoint Corrections: Setpoint corrections are done to align them with other setpoints.
          ROS  # Realisation Of Setpoints: BSW is informed about new ASW data. Basically actuating of the HW is done here.
          PAD  # Post Acquisition of Data: Additional acquisitions which were not relevant until the ASW to BSW communication point are performed now.
          PPC  # Post Processing Calculations: Postprocessing is performed.
          DPN  # Data Processing for Next cycle: Data needed for next event occurence or for other events are calculated. Computations that have no «internal deadline» are located here. The data produced here and consumed in the same event will have a delay of one period in the next occurence of the event.
          End
        16 x timing description event chain:
          Start_SEV: stimulus=SysTrig_DetHalfSegE1/Start, response=SysTrig_DetHalfSegE1/SEV, segment=SysTrig_DetHalfSegE1/Start_SEV
          SEV_PST: stimulus=SysTrig_DetHalfSegE1/SEV, response=SysTrig_DetHalfSegE1/PST, segment=SysTrig_DetHalfSegE1/SEV_PST
          PST_DST: stimulus=SysTrig_DetHalfSegE1/PST, response=SysTrig_DetHalfSegE1/DST, segment=SysTrig_DetHalfSegE1/PST_DST
          DST_ADI: stimulus=SysTrig_DetHalfSegE1/DST, response=SysTrig_DetHalfSegE1/ADI, segment=SysTrig_DetHalfSegE1/DST_ADI
          ADI_CCI: stimulus=SysTrig_DetHalfSegE1/ADI, response=SysTrig_DetHalfSegE1/CCI, segment=SysTrig_DetHalfSegE1/ADI_CCI
          CCI_SYV: stimulus=SysTrig_DetHalfSegE1/CCI, response=SysTrig_DetHalfSegE1/SYV, segment=SysTrig_DetHalfSegE1/CCI_SYV
          SYV_POR: stimulus=SysTrig_DetHalfSegE1/SYV, response=SysTrig_DetHalfSegE1/POR, segment=SysTrig_DetHalfSegE1/SYV_POR
          POR_CBS: stimulus=SysTrig_DetHalfSegE1/POR, response=SysTrig_DetHalfSegE1/CBS, segment=SysTrig_DetHalfSegE1/POR_CBS
          CBS_CCS: stimulus=SysTrig_DetHalfSegE1/CBS, response=SysTrig_DetHalfSegE1/CCS, segment=SysTrig_DetHalfSegE1/CBS_CCS
          CCS_CSC: stimulus=SysTrig_DetHalfSegE1/CCS, response=SysTrig_DetHalfSegE1/CSC, segment=SysTrig_DetHalfSegE1/CCS_CSC
          CSC_ROS: stimulus=SysTrig_DetHalfSegE1/CSC, response=SysTrig_DetHalfSegE1/ROS, segment=SysTrig_DetHalfSegE1/CSC_ROS
          ROS_PAD: stimulus=SysTrig_DetHalfSegE1/ROS, response=SysTrig_DetHalfSegE1/PAD, segment=SysTrig_DetHalfSegE1/ROS_PAD
          PAD_PPC: stimulus=SysTrig_DetHalfSegE1/PAD, response=SysTrig_DetHalfSegE1/PPC, segment=SysTrig_DetHalfSegE1/PAD_PPC
          PPC_DPN: stimulus=SysTrig_DetHalfSegE1/PPC, response=SysTrig_DetHalfSegE1/DPN, segment=SysTrig_DetHalfSegE1/PPC_DPN
          DPN_End: stimulus=SysTrig_DetHalfSegE1/DPN, response=SysTrig_DetHalfSegE1/End, segment=SysTrig_DetHalfSegE1/DPN_End
          SysTrig_DetHalfSegE1:
            stimulus=SysTrig_DetHalfSegE1/Start
            response=SysTrig_DetHalfSegE1/End
            segment=[SysTrig_DetHalfSegE1/Start_SEV, SysTrig_DetHalfSegE1/SEV_PST, SysTrig_DetHalfSegE1/PST_DST, SysTrig_DetHalfSegE1/DST_ADI, SysTrig_DetHalfSegE1/ADI_CCI, SysTrig_DetHalfSegE1/CCI_SYV, SysTrig_DetHalfSegE1/SYV_POR, SysTrig_DetHalfSegE1/POR_CBS, SysTrig_DetHalfSegE1/CBS_CCS, SysTrig_DetHalfSegE1/CCS_CSC, SysTrig_DetHalfSegE1/CSC_ROS, SysTrig_DetHalfSegE1/ROS_PAD, SysTrig_DetHalfSegE1/PAD_PPC, SysTrig_DetHalfSegE1/PPC_DPN, SysTrig_DetHalfSegE1/DPN_End]
      timing-guarantees:
        latency timing constraint Deadline: latency-constraint-type=REACTION, scope=SysTrig_DetHalfSegE1, maximum={cse-code=0, cse-code-factor=5000}
      timing-requirements:
        sporadic event triggering ActivationPattern: event=SysTrig_DetHalfSegE1/Start, minimum-inter-arrival-time={cse-code=0, cse-code-factor=2000}, maximum-inter-arrival-time={cse-code=0, cse-code-factor=2000000}
    SysTrig_DetSegE1  # This is an engine dependent event with segment recurrence at the beginning of a segment to detect and validate the segment event. This event is for detection and validation only, and will result in an event usable for all functions.
      timing-descriptions:
        16 x td event complex:
          Start
          SEV  # System Event Validation: Due to a delay between the detection of the system event and the execution of the system event implementation the conditions for the system event might disappear. In this case, runnables called after this phase can be informed or even skipped. Note: This phase is available on any event. Warning: This phase shall be used by the event producer only !
          PST  # Preparation of System Transition: Acquisitions, related diagnoses and any computation needed to prepare the detection of a system transition are done.
          DST  # Detection of System Transition: Major system transitions are detected as soon as possible so that nominal computations benefit from the initialization, instead of being overwritten.
          ADI  # Acquisition and associated Diagnoses: Acquisitions (and diagnosis) have to be done early in the event in order to get the results ready for the complete event.
          CCI  # Cross-Checking of Inputs: Input data crosschecking, high level diagnostic and input limp home actions are performed.
          SYV  # SYstem Variables computation: System variables are computed based on ECU inputs to be used in a high number of functions.
          POR  # Preparation Of Requests: Request data are elaborated based on inputs, which need a lot of logics. A request is not subject to control loop.
          CBS  # Calculation of Basic Setpoints: Basic setpoints are calculated based on system variables and requests.
          CCS  # Calculation of Complex Setpoints: Complex setpoints are based on system variables, requests and other setpoints.
          CSC  # Calculation of Setpoint Corrections: Setpoint corrections are done to align them with other setpoints.
          ROS  # Realisation Of Setpoints: BSW is informed about new ASW data. Basically actuating of the HW is done here.
          PAD  # Post Acquisition of Data: Additional acquisitions which were not relevant until the ASW to BSW communication point are performed now.
          PPC  # Post Processing Calculations: Postprocessing is performed.
          DPN  # Data Processing for Next cycle: Data needed for next event occurence or for other events are calculated. Computations that have no «internal deadline» are located here. The data produced here and consumed in the same event will have a delay of one period in the next occurence of the event.
          End
        16 x timing description event chain:
          Start_SEV: stimulus=SysTrig_DetSegE1/Start, response=SysTrig_DetSegE1/SEV, segment=SysTrig_DetSegE1/Start_SEV
          SEV_PST: stimulus=SysTrig_DetSegE1/SEV, response=SysTrig_DetSegE1/PST, segment=SysTrig_DetSegE1/SEV_PST
          PST_DST: stimulus=SysTrig_DetSegE1/PST, response=SysTrig_DetSegE1/DST, segment=SysTrig_DetSegE1/PST_DST
          DST_ADI: stimulus=SysTrig_DetSegE1/DST, response=SysTrig_DetSegE1/ADI, segment=SysTrig_DetSegE1/DST_ADI
          ADI_CCI: stimulus=SysTrig_DetSegE1/ADI, response=SysTrig_DetSegE1/CCI, segment=SysTrig_DetSegE1/ADI_CCI
          CCI_SYV: stimulus=SysTrig_DetSegE1/CCI, response=SysTrig_DetSegE1/SYV, segment=SysTrig_DetSegE1/CCI_SYV
          SYV_POR: stimulus=SysTrig_DetSegE1/SYV, response=SysTrig_DetSegE1/POR, segment=SysTrig_DetSegE1/SYV_POR
          POR_CBS: stimulus=SysTrig_DetSegE1/POR, response=SysTrig_DetSegE1/CBS, segment=SysTrig_DetSegE1/POR_CBS
          CBS_CCS: stimulus=SysTrig_DetSegE1/CBS, response=SysTrig_DetSegE1/CCS, segment=SysTrig_DetSegE1/CBS_CCS
          CCS_CSC: stimulus=SysTrig_DetSegE1/CCS, response=SysTrig_DetSegE1/CSC, segment=SysTrig_DetSegE1/CCS_CSC
          CSC_ROS: stimulus=SysTrig_DetSegE1/CSC, response=SysTrig_DetSegE1/ROS, segment=SysTrig_DetSegE1/CSC_ROS
          ROS_PAD: stimulus=SysTrig_DetSegE1/ROS, response=SysTrig_DetSegE1/PAD, segment=SysTrig_DetSegE1/ROS_PAD
          PAD_PPC: stimulus=SysTrig_DetSegE1/PAD, response=SysTrig_DetSegE1/PPC, segment=SysTrig_DetSegE1/PAD_PPC
          PPC_DPN: stimulus=SysTrig_DetSegE1/PPC, response=SysTrig_DetSegE1/DPN, segment=SysTrig_DetSegE1/PPC_DPN
          DPN_End: stimulus=SysTrig_DetSegE1/DPN, response=SysTrig_DetSegE1/End, segment=SysTrig_DetSegE1/DPN_End
          SysTrig_DetSegE1:
            stimulus=SysTrig_DetSegE1/Start
            response=SysTrig_DetSegE1/End
            segment=[SysTrig_DetSegE1/Start_SEV, SysTrig_DetSegE1/SEV_PST, SysTrig_DetSegE1/PST_DST, SysTrig_DetSegE1/DST_ADI, SysTrig_DetSegE1/ADI_CCI, SysTrig_DetSegE1/CCI_SYV, SysTrig_DetSegE1/SYV_POR, SysTrig_DetSegE1/POR_CBS, SysTrig_DetSegE1/CBS_CCS, SysTrig_DetSegE1/CCS_CSC, SysTrig_DetSegE1/CSC_ROS, SysTrig_DetSegE1/ROS_PAD, SysTrig_DetSegE1/PAD_PPC, SysTrig_DetSegE1/PPC_DPN, SysTrig_DetSegE1/DPN_End]
      timing-guarantees:
        latency timing constraint Deadline: latency-constraint-type=REACTION, scope=SysTrig_DetSegE1, maximum={cse-code=0, cse-code-factor=5000}
      timing-requirements:
        sporadic event triggering ActivationPattern: event=SysTrig_DetSegE1/Start, minimum-inter-arrival-time={cse-code=0, cse-code-factor=2000}, maximum-inter-arrival-time={cse-code=0, cse-code-factor=2000000}
    SysTrig_EngBackPredE0  # This event is fired typically 24° before TDC in order to predict a future backward rotation. It is fired only at low engine speed (below approx. 1500 rpm). Its deadline is 24° (typically 4 crankshaft teeth), so roughly 3ms at 1500 rpm. If a backward rotation is predicted, a SysTran_ExitSyn event is fired.
      timing-descriptions:
        6 x td event complex:
          Start
          SEV  # System Event Validation: Due to a delay between the detection of the system event and the execution of the system event implementation the conditions for the system event might disappear. In this case, runnables called after this phase can be informed or even skipped. Note: This phase is available on any event. Warning: This phase shall be used by the event producer only !
          PST  # Preparation of System Transition: Acquisitions, related diagnoses and any computation needed to prepare the detection of a system transition are done.
          DST  # Detection of System Transition: Major system transitions are detected as soon as possible so that nominal computations benefit from the initialization, instead of being overwritten.
          DPN  # Data Processing for Next cycle: Data needed for next event occurence or for other events are calculated. Computations that have no «internal deadline» are located here. The data produced here and consumed in the same event will have a delay of one period in the next occurence of the event.
          End
        6 x timing description event chain:
          Start_SEV: stimulus=SysTrig_EngBackPredE0/Start, response=SysTrig_EngBackPredE0/SEV, segment=SysTrig_EngBackPredE0/Start_SEV
          SEV_PST: stimulus=SysTrig_EngBackPredE0/SEV, response=SysTrig_EngBackPredE0/PST, segment=SysTrig_EngBackPredE0/SEV_PST
          PST_DST: stimulus=SysTrig_EngBackPredE0/PST, response=SysTrig_EngBackPredE0/DST, segment=SysTrig_EngBackPredE0/PST_DST
          DST_DPN: stimulus=SysTrig_EngBackPredE0/DST, response=SysTrig_EngBackPredE0/DPN, segment=SysTrig_EngBackPredE0/DST_DPN
          DPN_End: stimulus=SysTrig_EngBackPredE0/DPN, response=SysTrig_EngBackPredE0/End, segment=SysTrig_EngBackPredE0/DPN_End
          SysTrig_EngBackPredE0: stimulus=SysTrig_EngBackPredE0/Start, response=SysTrig_EngBackPredE0/End, segment=[SysTrig_EngBackPredE0/Start_SEV, SysTrig_EngBackPredE0/SEV_PST, SysTrig_EngBackPredE0/PST_DST, SysTrig_EngBackPredE0/DST_DPN, SysTrig_EngBackPredE0/DPN_End]
      timing-guarantees:
        latency timing constraint Deadline: latency-constraint-type=REACTION, scope=SysTrig_EngBackPredE0, maximum={cse-code=0, cse-code-factor=3000}
      timing-requirements:
        sporadic event triggering ActivationPattern: event=SysTrig_EngBackPredE0/Start, minimum-inter-arrival-time={cse-code=0, cse-code-factor=10000}, maximum-inter-arrival-time={cse-code=0, cse-code-factor=2000000}
    SysTrig_EngRevE0  # This is an engine dependent event with one crankshaft revolution recurrence, i.e. 360 degrees on the crankshaft.
      timing-descriptions:
        15 x td event complex:
          Start
          SEV  # System Event Validation: Due to a delay between the detection of the system event and the execution of the system event implementation the conditions for the system event might disappear. In this case, runnables called after this phase can be informed or even skipped. Note: This phase is available on any event. Warning: This phase shall be used by the event producer only !
          ADI  # Acquisition and associated Diagnoses: Acquisitions (and diagnosis) have to be done early in the event in order to get the results ready for the complete event.
          CCI  # Cross-Checking of Inputs: Input data crosschecking, high level diagnostic and input limp home actions are performed.
          SYV  # SYstem Variables computation: System variables are computed based on ECU inputs to be used in a high number of functions.
          POR  # Preparation Of Requests: Request data are elaborated based on inputs, which need a lot of logics. A request is not subject to control loop.
          CBS  # Calculation of Basic Setpoints: Basic setpoints are calculated based on system variables and requests.
          CCS  # Calculation of Complex Setpoints: Complex setpoints are based on system variables, requests and other setpoints.
          CSC  # Calculation of Setpoint Corrections: Setpoint corrections are done to align them with other setpoints.
          ROS  # Realisation Of Setpoints: BSW is informed about new ASW data. Basically actuating of the HW is done here.
          PAD  # Post Acquisition of Data: Additional acquisitions which were not relevant until the ASW to BSW communication point are performed now.
          PPC  # Post Processing Calculations: Postprocessing is performed.
          CCM  # Calibration CoMmunication: Data are sent to the calibration and communication system.
          DPN  # Data Processing for Next cycle: Data needed for next event occurence or for other events are calculated. Computations that have no «internal deadline» are located here. The data produced here and consumed in the same event will have a delay of one period in the next occurence of the event.
          End
        15 x timing description event chain:
          Start_SEV: stimulus=SysTrig_EngRevE0/Start, response=SysTrig_EngRevE0/SEV, segment=SysTrig_EngRevE0/Start_SEV
          SEV_ADI: stimulus=SysTrig_EngRevE0/SEV, response=SysTrig_EngRevE0/ADI, segment=SysTrig_EngRevE0/SEV_ADI
          ADI_CCI: stimulus=SysTrig_EngRevE0/ADI, response=SysTrig_EngRevE0/CCI, segment=SysTrig_EngRevE0/ADI_CCI
          CCI_SYV: stimulus=SysTrig_EngRevE0/CCI, response=SysTrig_EngRevE0/SYV, segment=SysTrig_EngRevE0/CCI_SYV
          SYV_POR: stimulus=SysTrig_EngRevE0/SYV, response=SysTrig_EngRevE0/POR, segment=SysTrig_EngRevE0/SYV_POR
          POR_CBS: stimulus=SysTrig_EngRevE0/POR, response=SysTrig_EngRevE0/CBS, segment=SysTrig_EngRevE0/POR_CBS
          CBS_CCS: stimulus=SysTrig_EngRevE0/CBS, response=SysTrig_EngRevE0/CCS, segment=SysTrig_EngRevE0/CBS_CCS
          CCS_CSC: stimulus=SysTrig_EngRevE0/CCS, response=SysTrig_EngRevE0/CSC, segment=SysTrig_EngRevE0/CCS_CSC
          CSC_ROS: stimulus=SysTrig_EngRevE0/CSC, response=SysTrig_EngRevE0/ROS, segment=SysTrig_EngRevE0/CSC_ROS
          ROS_PAD: stimulus=SysTrig_EngRevE0/ROS, response=SysTrig_EngRevE0/PAD, segment=SysTrig_EngRevE0/ROS_PAD
          PAD_PPC: stimulus=SysTrig_EngRevE0/PAD, response=SysTrig_EngRevE0/PPC, segment=SysTrig_EngRevE0/PAD_PPC
          PPC_CCM: stimulus=SysTrig_EngRevE0/PPC, response=SysTrig_EngRevE0/CCM, segment=SysTrig_EngRevE0/PPC_CCM
          CCM_DPN: stimulus=SysTrig_EngRevE0/CCM, response=SysTrig_EngRevE0/DPN, segment=SysTrig_EngRevE0/CCM_DPN
          DPN_End: stimulus=SysTrig_EngRevE0/DPN, response=SysTrig_EngRevE0/End, segment=SysTrig_EngRevE0/DPN_End
          SysTrig_EngRevE0:
            stimulus=SysTrig_EngRevE0/Start
            response=SysTrig_EngRevE0/End
            segment=[SysTrig_EngRevE0/Start_SEV, SysTrig_EngRevE0/SEV_ADI, SysTrig_EngRevE0/ADI_CCI, SysTrig_EngRevE0/CCI_SYV, SysTrig_EngRevE0/SYV_POR, SysTrig_EngRevE0/POR_CBS, SysTrig_EngRevE0/CBS_CCS, SysTrig_EngRevE0/CCS_CSC, SysTrig_EngRevE0/CSC_ROS, SysTrig_EngRevE0/ROS_PAD, SysTrig_EngRevE0/PAD_PPC, SysTrig_EngRevE0/PPC_CCM, SysTrig_EngRevE0/CCM_DPN, SysTrig_EngRevE0/DPN_End]
      timing-guarantees:
        latency timing constraint Deadline: latency-constraint-type=REACTION, scope=SysTrig_EngRevE0, maximum={cse-code=0, cse-code-factor=10000}
      timing-requirements:
        sporadic event triggering ActivationPattern: event=SysTrig_EngRevE0/Start, minimum-inter-arrival-time={cse-code=0, cse-code-factor=7000}, maximum-inter-arrival-time={cse-code=0, cse-code-factor=3000000}
    SysTrig_Fod  # Absolute field intensity measurment buffer is ready for evaluation. The event is fired by the foreign object detection basic software driver for the application software.
      timing-descriptions:
        9 x td event complex:
          Start
          SEV  # System Event Validation: Due to a delay between the detection of the system event and the execution of the system event implementation the conditions for the system event might disappear. In this case, runnables called after this phase can be informed or even skipped. Note: This phase is available on any event. Warning: This phase shall be used by the event producer only !
          ADI  # Acquisition and associated Diagnoses: Acquisitions (and diagnosis) have to be done early in the event in order to get the results ready for the complete event.
          CCI  # Cross-Checking of Inputs: Input data crosschecking, high level diagnostic and input limp home actions are performed.
          SYV  # SYstem Variables computation: System variables are computed based on ECU inputs to be used in a high number of functions.
          PPC  # Post Processing Calculations: Postprocessing is performed.
          CCM  # Calibration CoMmunication: Data are sent to the calibration and communication system.
          DPN  # Data Processing for Next cycle: Data needed for next event occurence or for other events are calculated. Computations that have no «internal deadline» are located here. The data produced here and consumed in the same event will have a delay of one period in the next occurence of the event.
          End
        9 x timing description event chain:
          Start_SEV: stimulus=SysTrig_Fod/Start, response=SysTrig_Fod/SEV, segment=SysTrig_Fod/Start_SEV
          SEV_ADI: stimulus=SysTrig_Fod/SEV, response=SysTrig_Fod/ADI, segment=SysTrig_Fod/SEV_ADI
          ADI_CCI: stimulus=SysTrig_Fod/ADI, response=SysTrig_Fod/CCI, segment=SysTrig_Fod/ADI_CCI
          CCI_SYV: stimulus=SysTrig_Fod/CCI, response=SysTrig_Fod/SYV, segment=SysTrig_Fod/CCI_SYV
          SYV_PPC: stimulus=SysTrig_Fod/SYV, response=SysTrig_Fod/PPC, segment=SysTrig_Fod/SYV_PPC
          PPC_CCM: stimulus=SysTrig_Fod/PPC, response=SysTrig_Fod/CCM, segment=SysTrig_Fod/PPC_CCM
          CCM_DPN: stimulus=SysTrig_Fod/CCM, response=SysTrig_Fod/DPN, segment=SysTrig_Fod/CCM_DPN
          DPN_End: stimulus=SysTrig_Fod/DPN, response=SysTrig_Fod/End, segment=SysTrig_Fod/DPN_End
          SysTrig_Fod: stimulus=SysTrig_Fod/Start, response=SysTrig_Fod/End, segment=[SysTrig_Fod/Start_SEV, SysTrig_Fod/SEV_ADI, SysTrig_Fod/ADI_CCI, SysTrig_Fod/CCI_SYV, SysTrig_Fod/SYV_PPC, SysTrig_Fod/PPC_CCM, SysTrig_Fod/CCM_DPN, SysTrig_Fod/DPN_End]
      timing-guarantees:
        latency timing constraint Deadline: latency-constraint-type=REACTION, scope=SysTrig_Fod, maximum={cse-code=0, cse-code-factor=4000}
      timing-requirements:
        sporadic event triggering ActivationPattern: event=SysTrig_Fod/Start, minimum-inter-arrival-time={cse-code=0, cse-code-factor=1000}, maximum-inter-arrival-time={cse-code=0, cse-code-factor=10000}
    SysTrig_FodDif  # Differential field intensity measurement buffer is ready for evaluation. The event is fired by the foreign object detection basic software driver for the application software.
      timing-descriptions:
        9 x td event complex:
          Start
          SEV  # System Event Validation: Due to a delay between the detection of the system event and the execution of the system event implementation the conditions for the system event might disappear. In this case, runnables called after this phase can be informed or even skipped. Note: This phase is available on any event. Warning: This phase shall be used by the event producer only !
          ADI  # Acquisition and associated Diagnoses: Acquisitions (and diagnosis) have to be done early in the event in order to get the results ready for the complete event.
          CCI  # Cross-Checking of Inputs: Input data crosschecking, high level diagnostic and input limp home actions are performed.
          SYV  # SYstem Variables computation: System variables are computed based on ECU inputs to be used in a high number of functions.
          PPC  # Post Processing Calculations: Postprocessing is performed.
          CCM  # Calibration CoMmunication: Data are sent to the calibration and communication system.
          DPN  # Data Processing for Next cycle: Data needed for next event occurence or for other events are calculated. Computations that have no «internal deadline» are located here. The data produced here and consumed in the same event will have a delay of one period in the next occurence of the event.
          End
        9 x timing description event chain:
          Start_SEV: stimulus=SysTrig_FodDif/Start, response=SysTrig_FodDif/SEV, segment=SysTrig_FodDif/Start_SEV
          SEV_ADI: stimulus=SysTrig_FodDif/SEV, response=SysTrig_FodDif/ADI, segment=SysTrig_FodDif/SEV_ADI
          ADI_CCI: stimulus=SysTrig_FodDif/ADI, response=SysTrig_FodDif/CCI, segment=SysTrig_FodDif/ADI_CCI
          CCI_SYV: stimulus=SysTrig_FodDif/CCI, response=SysTrig_FodDif/SYV, segment=SysTrig_FodDif/CCI_SYV
          SYV_PPC: stimulus=SysTrig_FodDif/SYV, response=SysTrig_FodDif/PPC, segment=SysTrig_FodDif/SYV_PPC
          PPC_CCM: stimulus=SysTrig_FodDif/PPC, response=SysTrig_FodDif/CCM, segment=SysTrig_FodDif/PPC_CCM
          CCM_DPN: stimulus=SysTrig_FodDif/CCM, response=SysTrig_FodDif/DPN, segment=SysTrig_FodDif/CCM_DPN
          DPN_End: stimulus=SysTrig_FodDif/DPN, response=SysTrig_FodDif/End, segment=SysTrig_FodDif/DPN_End
          SysTrig_FodDif: stimulus=SysTrig_FodDif/Start, response=SysTrig_FodDif/End, segment=[SysTrig_FodDif/Start_SEV, SysTrig_FodDif/SEV_ADI, SysTrig_FodDif/ADI_CCI, SysTrig_FodDif/CCI_SYV, SysTrig_FodDif/SYV_PPC, SysTrig_FodDif/PPC_CCM, SysTrig_FodDif/CCM_DPN, SysTrig_FodDif/DPN_End]
      timing-guarantees:
        latency timing constraint Deadline: latency-constraint-type=REACTION, scope=SysTrig_FodDif, maximum={cse-code=0, cse-code-factor=4000}
      timing-requirements:
        sporadic event triggering ActivationPattern: event=SysTrig_FodDif/Start, minimum-inter-arrival-time={cse-code=0, cse-code-factor=1000}, maximum-inter-arrival-time={cse-code=0, cse-code-factor=10000}
    SysTrig_FrCycF1  # This event is intended for flexray communication modules, which shall be triggered once per flexray cycle, if the flexray bus is synchronized. Additionally it shall be also triggered cyclically with a configured flexray cycle duration, if there is no bus synchronization at flexray startup phase or in case of flexray bus problems.
      timing-descriptions:
        5 x td event complex:
          Start
          SEV  # System Event Validation: Due to a delay between the detection of the system event and the execution of the system event implementation the conditions for the system event might disappear. In this case, runnables called after this phase can be informed or even skipped. Note: This phase is available on any event. Warning: This phase shall be used by the event producer only !
          CCM  # Calibration CoMmunication: Data are sent to the calibration and communication system.
          DPN  # Data Processing for Next cycle: Data needed for next event occurence or for other events are calculated. Computations that have no «internal deadline» are located here. The data produced here and consumed in the same event will have a delay of one period in the next occurence of the event.
          End
        5 x timing description event chain:
          Start_SEV: stimulus=SysTrig_FrCycF1/Start, response=SysTrig_FrCycF1/SEV, segment=SysTrig_FrCycF1/Start_SEV
          SEV_CCM: stimulus=SysTrig_FrCycF1/SEV, response=SysTrig_FrCycF1/CCM, segment=SysTrig_FrCycF1/SEV_CCM
          CCM_DPN: stimulus=SysTrig_FrCycF1/CCM, response=SysTrig_FrCycF1/DPN, segment=SysTrig_FrCycF1/CCM_DPN
          DPN_End: stimulus=SysTrig_FrCycF1/DPN, response=SysTrig_FrCycF1/End, segment=SysTrig_FrCycF1/DPN_End
          SysTrig_FrCycF1: stimulus=SysTrig_FrCycF1/Start, response=SysTrig_FrCycF1/End, segment=[SysTrig_FrCycF1/Start_SEV, SysTrig_FrCycF1/SEV_CCM, SysTrig_FrCycF1/CCM_DPN, SysTrig_FrCycF1/DPN_End]
      timing-guarantees:
        latency timing constraint Deadline: latency-constraint-type=REACTION, scope=SysTrig_FrCycF1, maximum={cse-code=0, cse-code-factor=5000}
      timing-requirements:
        periodic event triggering ActivationPattern: event=SysTrig_FrCycF1/Start, period={cse-code=0, cse-code-factor=5000}
    SysTrig_FrSegF1  # This event is intended for flexray communication modules, which shall be triggered within a defined time window of a flexray cycle. The event is executed only, if the flexray bus is synchronized.
      timing-descriptions:
        5 x td event complex:
          Start
          SEV  # System Event Validation: Due to a delay between the detection of the system event and the execution of the system event implementation the conditions for the system event might disappear. In this case, runnables called after this phase can be informed or even skipped. Note: This phase is available on any event. Warning: This phase shall be used by the event producer only !
          CCM  # Calibration CoMmunication: Data are sent to the calibration and communication system.
          DPN  # Data Processing for Next cycle: Data needed for next event occurence or for other events are calculated. Computations that have no «internal deadline» are located here. The data produced here and consumed in the same event will have a delay of one period in the next occurence of the event.
          End
        5 x timing description event chain:
          Start_SEV: stimulus=SysTrig_FrSegF1/Start, response=SysTrig_FrSegF1/SEV, segment=SysTrig_FrSegF1/Start_SEV
          SEV_CCM: stimulus=SysTrig_FrSegF1/SEV, response=SysTrig_FrSegF1/CCM, segment=SysTrig_FrSegF1/SEV_CCM
          CCM_DPN: stimulus=SysTrig_FrSegF1/CCM, response=SysTrig_FrSegF1/DPN, segment=SysTrig_FrSegF1/CCM_DPN
          DPN_End: stimulus=SysTrig_FrSegF1/DPN, response=SysTrig_FrSegF1/End, segment=SysTrig_FrSegF1/DPN_End
          SysTrig_FrSegF1: stimulus=SysTrig_FrSegF1/Start, response=SysTrig_FrSegF1/End, segment=[SysTrig_FrSegF1/Start_SEV, SysTrig_FrSegF1/SEV_CCM, SysTrig_FrSegF1/CCM_DPN, SysTrig_FrSegF1/DPN_End]
      timing-guarantees:
        latency timing constraint Deadline: latency-constraint-type=REACTION, scope=SysTrig_FrSegF1, maximum={cse-code=0, cse-code-factor=2500}
      timing-requirements:
        periodic event triggering ActivationPattern: event=SysTrig_FrSegF1/Start, period={cse-code=0, cse-code-factor=2500}
    SysTrig_HalfSegE1  # This is an engine dependent event with segment recurrence at the mid of the segment. Warning: This event might be skipped at high engine speed depending on project configuration.
      timing-descriptions:
        14 x td event complex:
          Start
          SEV  # System Event Validation: Due to a delay between the detection of the system event and the execution of the system event implementation the conditions for the system event might disappear. In this case, runnables called after this phase can be informed or even skipped. Note: This phase is available on any event. Warning: This phase shall be used by the event producer only !
          ADI  # Acquisition and associated Diagnoses: Acquisitions (and diagnosis) have to be done early in the event in order to get the results ready for the complete event.
          CCI  # Cross-Checking of Inputs: Input data crosschecking, high level diagnostic and input limp home actions are performed.
          SYV  # SYstem Variables computation: System variables are computed based on ECU inputs to be used in a high number of functions.
          POR  # Preparation Of Requests: Request data are elaborated based on inputs, which need a lot of logics. A request is not subject to control loop.
          CBS  # Calculation of Basic Setpoints: Basic setpoints are calculated based on system variables and requests.
          CCS  # Calculation of Complex Setpoints: Complex setpoints are based on system variables, requests and other setpoints.
          CSC  # Calculation of Setpoint Corrections: Setpoint corrections are done to align them with other setpoints.
          ROS  # Realisation Of Setpoints: BSW is informed about new ASW data. Basically actuating of the HW is done here.
          PAD  # Post Acquisition of Data: Additional acquisitions which were not relevant until the ASW to BSW communication point are performed now.
          PPC  # Post Processing Calculations: Postprocessing is performed.
          DPN  # Data Processing for Next cycle: Data needed for next event occurence or for other events are calculated. Computations that have no «internal deadline» are located here. The data produced here and consumed in the same event will have a delay of one period in the next occurence of the event.
          End
        14 x timing description event chain:
          Start_SEV: stimulus=SysTrig_HalfSegE1/Start, response=SysTrig_HalfSegE1/SEV, segment=SysTrig_HalfSegE1/Start_SEV
          SEV_ADI: stimulus=SysTrig_HalfSegE1/SEV, response=SysTrig_HalfSegE1/ADI, segment=SysTrig_HalfSegE1/SEV_ADI
          ADI_CCI: stimulus=SysTrig_HalfSegE1/ADI, response=SysTrig_HalfSegE1/CCI, segment=SysTrig_HalfSegE1/ADI_CCI
          CCI_SYV: stimulus=SysTrig_HalfSegE1/CCI, response=SysTrig_HalfSegE1/SYV, segment=SysTrig_HalfSegE1/CCI_SYV
          SYV_POR: stimulus=SysTrig_HalfSegE1/SYV, response=SysTrig_HalfSegE1/POR, segment=SysTrig_HalfSegE1/SYV_POR
          POR_CBS: stimulus=SysTrig_HalfSegE1/POR, response=SysTrig_HalfSegE1/CBS, segment=SysTrig_HalfSegE1/POR_CBS
          CBS_CCS: stimulus=SysTrig_HalfSegE1/CBS, response=SysTrig_HalfSegE1/CCS, segment=SysTrig_HalfSegE1/CBS_CCS
          CCS_CSC: stimulus=SysTrig_HalfSegE1/CCS, response=SysTrig_HalfSegE1/CSC, segment=SysTrig_HalfSegE1/CCS_CSC
          CSC_ROS: stimulus=SysTrig_HalfSegE1/CSC, response=SysTrig_HalfSegE1/ROS, segment=SysTrig_HalfSegE1/CSC_ROS
          ROS_PAD: stimulus=SysTrig_HalfSegE1/ROS, response=SysTrig_HalfSegE1/PAD, segment=SysTrig_HalfSegE1/ROS_PAD
          PAD_PPC: stimulus=SysTrig_HalfSegE1/PAD, response=SysTrig_HalfSegE1/PPC, segment=SysTrig_HalfSegE1/PAD_PPC
          PPC_DPN: stimulus=SysTrig_HalfSegE1/PPC, response=SysTrig_HalfSegE1/DPN, segment=SysTrig_HalfSegE1/PPC_DPN
          DPN_End: stimulus=SysTrig_HalfSegE1/DPN, response=SysTrig_HalfSegE1/End, segment=SysTrig_HalfSegE1/DPN_End
          SysTrig_HalfSegE1:
            stimulus=SysTrig_HalfSegE1/Start
            response=SysTrig_HalfSegE1/End
            segment=[SysTrig_HalfSegE1/Start_SEV, SysTrig_HalfSegE1/SEV_ADI, SysTrig_HalfSegE1/ADI_CCI, SysTrig_HalfSegE1/CCI_SYV, SysTrig_HalfSegE1/SYV_POR, SysTrig_HalfSegE1/POR_CBS, SysTrig_HalfSegE1/CBS_CCS, SysTrig_HalfSegE1/CCS_CSC, SysTrig_HalfSegE1/CSC_ROS, SysTrig_HalfSegE1/ROS_PAD, SysTrig_HalfSegE1/PAD_PPC, SysTrig_HalfSegE1/PPC_DPN, SysTrig_HalfSegE1/DPN_End]
      timing-guarantees:
        latency timing constraint Deadline: latency-constraint-type=REACTION, scope=SysTrig_HalfSegE1, maximum={cse-code=0, cse-code-factor=5000}
      timing-requirements:
        sporadic event triggering ActivationPattern: event=SysTrig_HalfSegE1/Start, minimum-inter-arrival-time={cse-code=0, cse-code-factor=2000}, maximum-inter-arrival-time={cse-code=0, cse-code-factor=2000000}
    SysTrig_InjE0  # This event is fired by the injection driver to notify the application software that certain jobs or periods are finished.
      timing-descriptions:
        13 x td event complex:
          Start
          SEV  # System Event Validation: Due to a delay between the detection of the system event and the execution of the system event implementation the conditions for the system event might disappear. In this case, runnables called after this phase can be informed or even skipped. Note: This phase is available on any event. Warning: This phase shall be used by the event producer only !
          ADI  # Acquisition and associated Diagnoses: Acquisitions (and diagnosis) have to be done early in the event in order to get the results ready for the complete event.
          CCI  # Cross-Checking of Inputs: Input data crosschecking, high level diagnostic and input limp home actions are performed.
          SYV  # SYstem Variables computation: System variables are computed based on ECU inputs to be used in a high number of functions.
          POR  # Preparation Of Requests: Request data are elaborated based on inputs, which need a lot of logics. A request is not subject to control loop.
          CBS  # Calculation of Basic Setpoints: Basic setpoints are calculated based on system variables and requests.
          CCS  # Calculation of Complex Setpoints: Complex setpoints are based on system variables, requests and other setpoints.
          CSC  # Calculation of Setpoint Corrections: Setpoint corrections are done to align them with other setpoints.
          ROS  # Realisation Of Setpoints: BSW is informed about new ASW data. Basically actuating of the HW is done here.
          PAD  # Post Acquisition of Data: Additional acquisitions which were not relevant until the ASW to BSW communication point are performed now.
          DPN  # Data Processing for Next cycle: Data needed for next event occurence or for other events are calculated. Computations that have no «internal deadline» are located here. The data produced here and consumed in the same event will have a delay of one period in the next occurence of the event.
          End
        13 x timing description event chain:
          Start_SEV: stimulus=SysTrig_InjE0/Start, response=SysTrig_InjE0/SEV, segment=SysTrig_InjE0/Start_SEV
          SEV_ADI: stimulus=SysTrig_InjE0/SEV, response=SysTrig_InjE0/ADI, segment=SysTrig_InjE0/SEV_ADI
          ADI_CCI: stimulus=SysTrig_InjE0/ADI, response=SysTrig_InjE0/CCI, segment=SysTrig_InjE0/ADI_CCI
          CCI_SYV: stimulus=SysTrig_InjE0/CCI, response=SysTrig_InjE0/SYV, segment=SysTrig_InjE0/CCI_SYV
          SYV_POR: stimulus=SysTrig_InjE0/SYV, response=SysTrig_InjE0/POR, segment=SysTrig_InjE0/SYV_POR
          POR_CBS: stimulus=SysTrig_InjE0/POR, response=SysTrig_InjE0/CBS, segment=SysTrig_InjE0/POR_CBS
          CBS_CCS: stimulus=SysTrig_InjE0/CBS, response=SysTrig_InjE0/CCS, segment=SysTrig_InjE0/CBS_CCS
          CCS_CSC: stimulus=SysTrig_InjE0/CCS, response=SysTrig_InjE0/CSC, segment=SysTrig_InjE0/CCS_CSC
          CSC_ROS: stimulus=SysTrig_InjE0/CSC, response=SysTrig_InjE0/ROS, segment=SysTrig_InjE0/CSC_ROS
          ROS_PAD: stimulus=SysTrig_InjE0/ROS, response=SysTrig_InjE0/PAD, segment=SysTrig_InjE0/ROS_PAD
          PAD_DPN: stimulus=SysTrig_InjE0/PAD, response=SysTrig_InjE0/DPN, segment=PAD_DPN
          DPN_End: stimulus=SysTrig_InjE0/DPN, response=SysTrig_InjE0/End, segment=SysTrig_InjE0/DPN_End
          SysTrig_InjE0: stimulus=SysTrig_InjE0/Start, response=SysTrig_InjE0/End, segment=[SysTrig_InjE0/Start_SEV, SysTrig_InjE0/SEV_ADI, SysTrig_InjE0/ADI_CCI, SysTrig_InjE0/CCI_SYV, SysTrig_InjE0/SYV_POR, SysTrig_InjE0/POR_CBS, SysTrig_InjE0/CBS_CCS, SysTrig_InjE0/CCS_CSC, SysTrig_InjE0/CSC_ROS, SysTrig_InjE0/ROS_PAD, PAD_DPN, SysTrig_InjE0/DPN_End]
      timing-guarantees:
        latency timing constraint Deadline: latency-constraint-type=REACTION, scope=SysTrig_InjE0, maximum={cse-code=0, cse-code-factor=830}
      timing-requirements:
        sporadic event triggering ActivationPattern: event=SysTrig_InjE0/Start, minimum-inter-arrival-time={cse-code=0, cse-code-factor=2000}, maximum-inter-arrival-time={cse-code=0, cse-code-factor=2000000}
    SysTrig_InjSftyE2  # This event is fired by the injection driver to notify safety functions that certain jobs or periods are finished.
      timing-descriptions:
        12 x td event complex:
          Start
          SEV  # System Event Validation: Due to a delay between the detection of the system event and the execution of the system event implementation the conditions for the system event might disappear. In this case, runnables called after this phase can be informed or even skipped. Note: This phase is available on any event. Warning: This phase shall be used by the event producer only !
          ADI  # Acquisition and associated Diagnoses: Acquisitions (and diagnosis) have to be done early in the event in order to get the results ready for the complete event.
          CCI  # Cross-Checking of Inputs: Input data crosschecking, high level diagnostic and input limp home actions are performed.
          SYV  # SYstem Variables computation: System variables are computed based on ECU inputs to be used in a high number of functions.
          POR  # Preparation Of Requests: Request data are elaborated based on inputs, which need a lot of logics. A request is not subject to control loop.
          CBS  # Calculation of Basic Setpoints: Basic setpoints are calculated based on system variables and requests.
          CCS  # Calculation of Complex Setpoints: Complex setpoints are based on system variables, requests and other setpoints.
          CSC  # Calculation of Setpoint Corrections: Setpoint corrections are done to align them with other setpoints.
          ROS  # Realisation Of Setpoints: BSW is informed about new ASW data. Basically actuating of the HW is done here.
          DPN  # Data Processing for Next cycle: Data needed for next event occurence or for other events are calculated. Computations that have no «internal deadline» are located here. The data produced here and consumed in the same event will have a delay of one period in the next occurence of the event.
          End
        12 x timing description event chain:
          Start_SEV: stimulus=SysTrig_InjSftyE2/Start, response=SysTrig_InjSftyE2/SEV, segment=SysTrig_InjSftyE2/Start_SEV
          SEV_ADI: stimulus=SysTrig_InjSftyE2/SEV, response=SysTrig_InjSftyE2/ADI, segment=SysTrig_InjSftyE2/SEV_ADI
          ADI_CCI: stimulus=SysTrig_InjSftyE2/ADI, response=SysTrig_InjSftyE2/CCI, segment=SysTrig_InjSftyE2/ADI_CCI
          CCI_SYV: stimulus=SysTrig_InjSftyE2/CCI, response=SysTrig_InjSftyE2/SYV, segment=SysTrig_InjSftyE2/CCI_SYV
          SYV_POR: stimulus=SysTrig_InjSftyE2/SYV, response=SysTrig_InjSftyE2/POR, segment=SysTrig_InjSftyE2/SYV_POR
          POR_CBS: stimulus=SysTrig_InjSftyE2/POR, response=SysTrig_InjSftyE2/CBS, segment=SysTrig_InjSftyE2/POR_CBS
          CBS_CCS: stimulus=SysTrig_InjSftyE2/CBS, response=SysTrig_InjSftyE2/CCS, segment=SysTrig_InjSftyE2/CBS_CCS
          CCS_CSC: stimulus=SysTrig_InjSftyE2/CCS, response=SysTrig_InjSftyE2/CSC, segment=SysTrig_InjSftyE2/CCS_CSC
          CSC_ROS: stimulus=SysTrig_InjSftyE2/CSC, response=SysTrig_InjSftyE2/ROS, segment=SysTrig_InjSftyE2/CSC_ROS
          ROS_DPN: stimulus=SysTrig_InjSftyE2/ROS, response=SysTrig_InjSftyE2/DPN, segment=ROS_DPN
          DPN_End: stimulus=SysTrig_InjSftyE2/DPN, response=SysTrig_InjSftyE2/End, segment=SysTrig_InjSftyE2/DPN_End
          SysTrig_InjSftyE2: stimulus=SysTrig_InjSftyE2/Start, response=SysTrig_InjSftyE2/End, segment=[SysTrig_InjSftyE2/Start_SEV, SysTrig_InjSftyE2/SEV_ADI, SysTrig_InjSftyE2/ADI_CCI, SysTrig_InjSftyE2/CCI_SYV, SysTrig_InjSftyE2/SYV_POR, SysTrig_InjSftyE2/POR_CBS, SysTrig_InjSftyE2/CBS_CCS, SysTrig_InjSftyE2/CCS_CSC, SysTrig_InjSftyE2/CSC_ROS, ROS_DPN, SysTrig_InjSftyE2/DPN_End]
      timing-guarantees:
        latency timing constraint Deadline: latency-constraint-type=REACTION, scope=SysTrig_InjSftyE2, maximum={cse-code=0, cse-code-factor=10000}
      timing-requirements:
        sporadic event triggering ActivationPattern: event=SysTrig_InjSftyE2/Start, minimum-inter-arrival-time={cse-code=0, cse-code-factor=2000}, maximum-inter-arrival-time={cse-code=0, cse-code-factor=1000000000}
    SysTrig_KnkWinEndE0  # This is event occurs at the end of each knock sensor measurement window.
      timing-descriptions:
        5 x td event complex:
          Start
          SEV  # System Event Validation: Due to a delay between the detection of the system event and the execution of the system event implementation the conditions for the system event might disappear. In this case, runnables called after this phase can be informed or even skipped. Note: This phase is available on any event. Warning: This phase shall be used by the event producer only !
          ADI  # Acquisition and associated Diagnoses: Acquisitions (and diagnosis) have to be done early in the event in order to get the results ready for the complete event.
          DPN  # Data Processing for Next cycle: Data needed for next event occurence or for other events are calculated. Computations that have no «internal deadline» are located here. The data produced here and consumed in the same event will have a delay of one period in the next occurence of the event.
          End
        5 x timing description event chain:
          Start_SEV: stimulus=SysTrig_KnkWinEndE0/Start, response=SysTrig_KnkWinEndE0/SEV, segment=SysTrig_KnkWinEndE0/Start_SEV
          SEV_ADI: stimulus=SysTrig_KnkWinEndE0/SEV, response=SysTrig_KnkWinEndE0/ADI, segment=SysTrig_KnkWinEndE0/SEV_ADI
          ADI_DPN: stimulus=SysTrig_KnkWinEndE0/ADI, response=SysTrig_KnkWinEndE0/DPN, segment=ADI_DPN
          DPN_End: stimulus=SysTrig_KnkWinEndE0/DPN, response=SysTrig_KnkWinEndE0/End, segment=SysTrig_KnkWinEndE0/DPN_End
          SysTrig_KnkWinEndE0: stimulus=SysTrig_KnkWinEndE0/Start, response=SysTrig_KnkWinEndE0/End, segment=[SysTrig_KnkWinEndE0/Start_SEV, SysTrig_KnkWinEndE0/SEV_ADI, ADI_DPN, SysTrig_KnkWinEndE0/DPN_End]
      timing-guarantees:
        latency timing constraint Deadline: latency-constraint-type=REACTION, scope=SysTrig_KnkWinEndE0, maximum={cse-code=0, cse-code-factor=830}
      timing-requirements:
        sporadic event triggering ActivationPattern: event=SysTrig_KnkWinEndE0/Start, minimum-inter-arrival-time={cse-code=0, cse-code-factor=2000}, maximum-inter-arrival-time={cse-code=0, cse-code-factor=2000000}
    SysTrig_Lod  # Radar sensor measurement buffer is ready for evaluation. The event is fired by the living object detection basic software driver for the application software.
      timing-descriptions:
        9 x td event complex:
          Start
          SEV  # System Event Validation: Due to a delay between the detection of the system event and the execution of the system event implementation the conditions for the system event might disappear. In this case, runnables called after this phase can be informed or even skipped. Note: This phase is available on any event. Warning: This phase shall be used by the event producer only !
          ADI  # Acquisition and associated Diagnoses: Acquisitions (and diagnosis) have to be done early in the event in order to get the results ready for the complete event.
          CCI  # Cross-Checking of Inputs: Input data crosschecking, high level diagnostic and input limp home actions are performed.
          SYV  # SYstem Variables computation: System variables are computed based on ECU inputs to be used in a high number of functions.
          PPC  # Post Processing Calculations: Postprocessing is performed.
          CCM  # Calibration CoMmunication: Data are sent to the calibration and communication system.
          DPN  # Data Processing for Next cycle: Data needed for next event occurence or for other events are calculated. Computations that have no «internal deadline» are located here. The data produced here and consumed in the same event will have a delay of one period in the next occurence of the event.
          End
        9 x timing description event chain:
          Start_SEV: stimulus=SysTrig_Lod/Start, response=SysTrig_Lod/SEV, segment=SysTrig_Lod/Start_SEV
          SEV_ADI: stimulus=SysTrig_Lod/SEV, response=SysTrig_Lod/ADI, segment=SysTrig_Lod/SEV_ADI
          ADI_CCI: stimulus=SysTrig_Lod/ADI, response=SysTrig_Lod/CCI, segment=SysTrig_Lod/ADI_CCI
          CCI_SYV: stimulus=SysTrig_Lod/CCI, response=SysTrig_Lod/SYV, segment=SysTrig_Lod/CCI_SYV
          SYV_PPC: stimulus=SysTrig_Lod/SYV, response=SysTrig_Lod/PPC, segment=SysTrig_Lod/SYV_PPC
          PPC_CCM: stimulus=SysTrig_Lod/PPC, response=SysTrig_Lod/CCM, segment=SysTrig_Lod/PPC_CCM
          CCM_DPN: stimulus=SysTrig_Lod/CCM, response=SysTrig_Lod/DPN, segment=SysTrig_Lod/CCM_DPN
          DPN_End: stimulus=SysTrig_Lod/DPN, response=SysTrig_Lod/End, segment=SysTrig_Lod/DPN_End
          SysTrig_Lod: stimulus=SysTrig_Lod/Start, response=SysTrig_Lod/End, segment=[SysTrig_Lod/Start_SEV, SysTrig_Lod/SEV_ADI, SysTrig_Lod/ADI_CCI, SysTrig_Lod/CCI_SYV, SysTrig_Lod/SYV_PPC, SysTrig_Lod/PPC_CCM, SysTrig_Lod/CCM_DPN, SysTrig_Lod/DPN_End]
      timing-guarantees:
        latency timing constraint Deadline: latency-constraint-type=REACTION, scope=SysTrig_Lod, maximum={cse-code=0, cse-code-factor=4000}
      timing-requirements:
        sporadic event triggering ActivationPattern: event=SysTrig_Lod/Start, minimum-inter-arrival-time={cse-code=0, cse-code-factor=1000}, maximum-inter-arrival-time={cse-code=0, cse-code-factor=10000}
    SysTrig_RxMcrpA1  # This event is fired by MCPC functionality when a message is received. The event will process the received information and trigger the sending of the response.
      timing-descriptions:
        5 x td event complex:
          Start
          SEV  # System Event Validation: Due to a delay between the detection of the system event and the execution of the system event implementation the conditions for the system event might disappear. In this case, runnables called after this phase can be informed or even skipped. Note: This phase is available on any event. Warning: This phase shall be used by the event producer only !
          CCM  # Calibration CoMmunication: Data are sent to the calibration and communication system.
          DPN  # Data Processing for Next cycle: Data needed for next event occurence or for other events are calculated. Computations that have no «internal deadline» are located here. The data produced here and consumed in the same event will have a delay of one period in the next occurence of the event.
          End
        5 x timing description event chain:
          Start_SEV: stimulus=SysTrig_RxMcrpA1/Start, response=SysTrig_RxMcrpA1/SEV, segment=SysTrig_RxMcrpA1/Start_SEV
          SEV_CCM: stimulus=SysTrig_RxMcrpA1/SEV, response=SysTrig_RxMcrpA1/CCM, segment=SysTrig_RxMcrpA1/SEV_CCM
          CCM_DPN: stimulus=SysTrig_RxMcrpA1/CCM, response=SysTrig_RxMcrpA1/DPN, segment=SysTrig_RxMcrpA1/CCM_DPN
          DPN_End: stimulus=SysTrig_RxMcrpA1/DPN, response=SysTrig_RxMcrpA1/End, segment=SysTrig_RxMcrpA1/DPN_End
          SysTrig_RxMcrpA1: stimulus=SysTrig_RxMcrpA1/Start, response=SysTrig_RxMcrpA1/End, segment=[SysTrig_RxMcrpA1/Start_SEV, SysTrig_RxMcrpA1/SEV_CCM, SysTrig_RxMcrpA1/CCM_DPN, SysTrig_RxMcrpA1/DPN_End]
      timing-guarantees:
        latency timing constraint Deadline: latency-constraint-type=REACTION, scope=SysTrig_RxMcrpA1, maximum={cse-code=0, cse-code-factor=300}
      timing-requirements:
        sporadic event triggering ActivationPattern: event=SysTrig_RxMcrpA1/Start, minimum-inter-arrival-time={cse-code=0, cse-code-factor=300}, maximum-inter-arrival-time={cse-code=0, cse-code-factor=1000000000}
    SysTrig_SegE1  # This is an engine dependent event with segment recurrence at the beginning of a segment.
      timing-descriptions:
        17 x td event complex:
          Start
          SEV  # System Event Validation: Due to a delay between the detection of the system event and the execution of the system event implementation the conditions for the system event might disappear. In this case, runnables called after this phase can be informed or even skipped. Note: This phase is available on any event. Warning: This phase shall be used by the event producer only !
          PST  # Preparation of System Transition: Acquisitions, related diagnoses and any computation needed to prepare the detection of a system transition are done.
          DST  # Detection of System Transition: Major system transitions are detected as soon as possible so that nominal computations benefit from the initialization, instead of being overwritten.
          ADI  # Acquisition and associated Diagnoses: Acquisitions (and diagnosis) have to be done early in the event in order to get the results ready for the complete event.
          CCI  # Cross-Checking of Inputs: Input data crosschecking, high level diagnostic and input limp home actions are performed.
          SYV  # SYstem Variables computation: System variables are computed based on ECU inputs to be used in a high number of functions.
          POR  # Preparation Of Requests: Request data are elaborated based on inputs, which need a lot of logics. A request is not subject to control loop.
          CBS  # Calculation of Basic Setpoints: Basic setpoints are calculated based on system variables and requests.
          CCS  # Calculation of Complex Setpoints: Complex setpoints are based on system variables, requests and other setpoints.
          CSC  # Calculation of Setpoint Corrections: Setpoint corrections are done to align them with other setpoints.
          ROS  # Realisation Of Setpoints: BSW is informed about new ASW data. Basically actuating of the HW is done here.
          PAD  # Post Acquisition of Data: Additional acquisitions which were not relevant until the ASW to BSW communication point are performed now.
          PPC  # Post Processing Calculations: Postprocessing is performed.
          CCM  # Calibration CoMmunication: Data are sent to the calibration and communication system.
          DPN  # Data Processing for Next cycle: Data needed for next event occurence or for other events are calculated. Computations that have no «internal deadline» are located here. The data produced here and consumed in the same event will have a delay of one period in the next occurence of the event.
          End
        17 x timing description event chain:
          Start_SEV: stimulus=SysTrig_SegE1/Start, response=SysTrig_SegE1/SEV, segment=SysTrig_SegE1/Start_SEV
          SEV_PST: stimulus=SysTrig_SegE1/SEV, response=SysTrig_SegE1/PST, segment=SysTrig_SegE1/SEV_PST
          PST_DST: stimulus=SysTrig_SegE1/PST, response=SysTrig_SegE1/DST, segment=SysTrig_SegE1/PST_DST
          DST_ADI: stimulus=SysTrig_SegE1/DST, response=SysTrig_SegE1/ADI, segment=SysTrig_SegE1/DST_ADI
          ADI_CCI: stimulus=SysTrig_SegE1/ADI, response=SysTrig_SegE1/CCI, segment=SysTrig_SegE1/ADI_CCI
          CCI_SYV: stimulus=SysTrig_SegE1/CCI, response=SysTrig_SegE1/SYV, segment=SysTrig_SegE1/CCI_SYV
          SYV_POR: stimulus=SysTrig_SegE1/SYV, response=SysTrig_SegE1/POR, segment=SysTrig_SegE1/SYV_POR
          POR_CBS: stimulus=SysTrig_SegE1/POR, response=SysTrig_SegE1/CBS, segment=SysTrig_SegE1/POR_CBS
          CBS_CCS: stimulus=SysTrig_SegE1/CBS, response=SysTrig_SegE1/CCS, segment=SysTrig_SegE1/CBS_CCS
          CCS_CSC: stimulus=SysTrig_SegE1/CCS, response=SysTrig_SegE1/CSC, segment=SysTrig_SegE1/CCS_CSC
          CSC_ROS: stimulus=SysTrig_SegE1/CSC, response=SysTrig_SegE1/ROS, segment=SysTrig_SegE1/CSC_ROS
          ROS_PAD: stimulus=SysTrig_SegE1/ROS, response=SysTrig_SegE1/PAD, segment=SysTrig_SegE1/ROS_PAD
          PAD_PPC: stimulus=SysTrig_SegE1/PAD, response=SysTrig_SegE1/PPC, segment=SysTrig_SegE1/PAD_PPC
          PPC_CCM: stimulus=SysTrig_SegE1/PPC, response=SysTrig_SegE1/CCM, segment=SysTrig_SegE1/PPC_CCM
          CCM_DPN: stimulus=SysTrig_SegE1/CCM, response=SysTrig_SegE1/DPN, segment=SysTrig_SegE1/CCM_DPN
          DPN_End: stimulus=SysTrig_SegE1/DPN, response=SysTrig_SegE1/End, segment=SysTrig_SegE1/DPN_End
          SysTrig_SegE1:
            stimulus=SysTrig_SegE1/Start
            response=SysTrig_SegE1/End
            segment=[SysTrig_SegE1/Start_SEV, SysTrig_SegE1/SEV_PST, SysTrig_SegE1/PST_DST, SysTrig_SegE1/DST_ADI, SysTrig_SegE1/ADI_CCI, SysTrig_SegE1/CCI_SYV, SysTrig_SegE1/SYV_POR, SysTrig_SegE1/POR_CBS, SysTrig_SegE1/CBS_CCS, SysTrig_SegE1/CCS_CSC, SysTrig_SegE1/CSC_ROS, SysTrig_SegE1/ROS_PAD, SysTrig_SegE1/PAD_PPC, SysTrig_SegE1/PPC_CCM, SysTrig_SegE1/CCM_DPN, SysTrig_SegE1/DPN_End]
      timing-guarantees:
        latency timing constraint Deadline: latency-constraint-type=REACTION, scope=SysTrig_SegE1, maximum={cse-code=0, cse-code-factor=5000}
      timing-requirements:
        sporadic event triggering ActivationPattern: event=SysTrig_SegE1/Start, minimum-inter-arrival-time={cse-code=0, cse-code-factor=2000}, maximum-inter-arrival-time={cse-code=0, cse-code-factor=2000000}
    SysTrig_TxMcrpA1  # This event is fired by MCPC functionality.
      timing-descriptions:
        5 x td event complex:
          Start
          SEV  # System Event Validation: Due to a delay between the detection of the system event and the execution of the system event implementation the conditions for the system event might disappear. In this case, runnables called after this phase can be informed or even skipped. Note: This phase is available on any event. Warning: This phase shall be used by the event producer only !
          CCM  # Calibration CoMmunication: Data are sent to the calibration and communication system.
          DPN  # Data Processing for Next cycle: Data needed for next event occurence or for other events are calculated. Computations that have no «internal deadline» are located here. The data produced here and consumed in the same event will have a delay of one period in the next occurence of the event.
          End
        5 x timing description event chain:
          Start_SEV: stimulus=SysTrig_TxMcrpA1/Start, response=SysTrig_TxMcrpA1/SEV, segment=SysTrig_TxMcrpA1/Start_SEV
          SEV_CCM: stimulus=SysTrig_TxMcrpA1/SEV, response=SysTrig_TxMcrpA1/CCM, segment=SysTrig_TxMcrpA1/SEV_CCM
          CCM_DPN: stimulus=SysTrig_TxMcrpA1/CCM, response=SysTrig_TxMcrpA1/DPN, segment=SysTrig_TxMcrpA1/CCM_DPN
          DPN_End: stimulus=SysTrig_TxMcrpA1/DPN, response=SysTrig_TxMcrpA1/End, segment=SysTrig_TxMcrpA1/DPN_End
          SysTrig_TxMcrpA1: stimulus=SysTrig_TxMcrpA1/Start, response=SysTrig_TxMcrpA1/End, segment=[SysTrig_TxMcrpA1/Start_SEV, SysTrig_TxMcrpA1/SEV_CCM, SysTrig_TxMcrpA1/CCM_DPN, SysTrig_TxMcrpA1/DPN_End]
      timing-guarantees:
        latency timing constraint Deadline: latency-constraint-type=REACTION, scope=SysTrig_TxMcrpA1, maximum={cse-code=0, cse-code-factor=300}
      timing-requirements:
        sporadic event triggering ActivationPattern: event=SysTrig_TxMcrpA1/Start, minimum-inter-arrival-time={cse-code=0, cse-code-factor=300}, maximum-inter-arrival-time={cse-code=0, cse-code-factor=10000}
